AUTOSAR XML (schema 00050)
package /AUTOSAR_Ocu/BswModuleDescriptions
  bsw module description Ocu: module-id=125
    provided-entrys:
      Emios_Ocu_Ip_IrqHandler
      Ocu_DeInit
      Ocu_DisableNotification
      Ocu_EnableNotification
      Ocu_GetCounter
      Ocu_GetVersionInfo
      Ocu_Init
      Ocu_SetAbsoluteThreshold
      Ocu_SetClockMode
      Ocu_SetPinAction
      Ocu_SetPinState
      Ocu_SetRelativeThreshold
      Ocu_StartChannel
      Ocu_StopChannel
    bsw internal behavior InternalBehavior_0
      8 x exclusive area:
        OCU_EXCLUSIVE_AREA_{00..07}
      14 x bsw called entity:
        Emios_Ocu_Ip_IrqHandler: can-enter-exclusive-area=OCU_EXCLUSIVE_AREA_07, implemented-entry=Emios_Ocu_Ip_IrqHandler
        Ocu_DeInit: implemented-entry=Ocu_DeInit
        Ocu_DisableNotification: implemented-entry=Ocu_DisableNotification
        Ocu_EnableNotification: implemented-entry=Ocu_EnableNotification
        Ocu_GetCounter: implemented-entry=Ocu_GetCounter
        Ocu_GetVersionInfo: implemented-entry=Ocu_GetVersionInfo
        Ocu_Init: implemented-entry=Ocu_Init
        Ocu_SetAbsoluteThreshold: can-enter-exclusive-area=OCU_EXCLUSIVE_AREA_05, implemented-entry=Ocu_SetAbsoluteThreshold
        Ocu_SetClockMode: can-enter-exclusive-area=OCU_EXCLUSIVE_AREA_06, implemented-entry=Ocu_SetClockMode
        Ocu_SetPinAction: can-enter-exclusive-area=OCU_EXCLUSIVE_AREA_02, implemented-entry=Ocu_SetPinAction
        Ocu_SetPinState: can-enter-exclusive-area=OCU_EXCLUSIVE_AREA_03, implemented-entry=Ocu_SetPinState
        Ocu_SetRelativeThreshold: can-enter-exclusive-area=OCU_EXCLUSIVE_AREA_04, implemented-entry=Ocu_SetRelativeThreshold
        Ocu_StartChannel: can-enter-exclusive-area=OCU_EXCLUSIVE_AREA_00, implemented-entry=Ocu_StartChannel
        Ocu_StopChannel: can-enter-exclusive-area=OCU_EXCLUSIVE_AREA_01, implemented-entry=Ocu_StopChannel
package /AUTOSAR_Ocu/BswModuleEntrys
  14 x bsw module entry, all with is-synchronous=true, call-type=REGULAR, execution-context=UNSPECIFIED, sw-service-impl-policy=STANDARD:
    Emios_Ocu_Ip_IrqHandler: service-id=0x7c, is-reentrant=false
    Ocu_DeInit: service-id=0x01, is-reentrant=false
    Ocu_DisableNotification: service-id=0x0a, is-reentrant=false
    Ocu_EnableNotification: service-id=0x0b, is-reentrant=false
    Ocu_GetCounter: service-id=0x06, is-reentrant=true
    Ocu_GetVersionInfo: service-id=0x09, is-reentrant=true
    Ocu_Init: service-id=0x00, is-reentrant=false
    Ocu_SetAbsoluteThreshold: service-id=0x07, is-reentrant=false
    Ocu_SetClockMode: service-id=0x7b, is-reentrant=false
    Ocu_SetPinAction: service-id=0x05, is-reentrant=false
    Ocu_SetPinState: service-id=0x04, is-reentrant=false
    Ocu_SetRelativeThreshold: service-id=0x08, is-reentrant=false
    Ocu_StartChannel: service-id=0x02, is-reentrant=false
    Ocu_StopChannel: service-id=0x03, is-reentrant=false
package /Ocu_TS_T40D34M30I0R0/Implementations
  bsw implementation BswImplementation_0: programming-language=C, sw-version=3.0.0, vendor-id=43, ar-release-version=4.7.0, behavior=InternalBehavior_0, vendor-specific-module-def=Ocu
    code-descriptors:
      code Files
        artifact-descriptors:
          short-label=config::Ocu.xdm, category=SWCFG
          short-label=doc::RTD_OCU_IM.pdf, category=SWDOC
          short-label=doc::RTD_OCU_UM.pdf, category=SWDOC
          short-label=examples::EBT::S32K358::Ocu_Example_S32K358::generate::epc::BaseNXP.xdm, category=SWCFG
          short-label=examples::EBT::S32K358::Ocu_Example_S32K358::generate::epc::Dem.xdm, category=SWCFG
          short-label=examples::EBT::S32K358::Ocu_Example_S32K358::generate::epc::Dio.xdm, category=SWCFG
          short-label=examples::EBT::S32K358::Ocu_Example_S32K358::generate::epc::EcuC.xdm, category=SWCFG
          short-label=examples::EBT::S32K358::Ocu_Example_S32K358::generate::epc::Mcl.xdm, category=SWCFG
          short-label=examples::EBT::S32K358::Ocu_Example_S32K358::generate::epc::Mcu.xdm, category=SWCFG
          short-label=examples::EBT::S32K358::Ocu_Example_S32K358::generate::epc::Ocu.xdm, category=SWCFG
          short-label=examples::EBT::S32K358::Ocu_Example_S32K358::generate::epc::Platform.xdm, category=SWCFG
          short-label=examples::EBT::S32K358::Ocu_Example_S32K358::generate::epc::Port.xdm, category=SWCFG
          short-label=examples::EBT::S32K358::Ocu_Example_S32K358::generate::epc::Resource.xdm, category=SWCFG
          short-label=examples::EBT::S32K358::Ocu_Example_S32K358::include::check_example.h, category=SWHDR
          short-label=examples::EBT::S32K358::Ocu_Example_S32K358::src::main.c, category=SWSRC
          short-label=examples::EBT::S32K358::Ocu_Example_S32K358::TresosProject::Ocu_Example_S32K358::.prefs::preferences.xdm, category=SWCFG
          short-label=examples::EBT::S32K358::Ocu_Example_S32K358::TresosProject::Ocu_Example_S32K358::config::BaseNXP.xdm, category=SWCFG
          short-label=examples::EBT::S32K358::Ocu_Example_S32K358::TresosProject::Ocu_Example_S32K358::config::Dem.xdm, category=SWCFG
          short-label=examples::EBT::S32K358::Ocu_Example_S32K358::TresosProject::Ocu_Example_S32K358::config::Dio.xdm, category=SWCFG
          short-label=examples::EBT::S32K358::Ocu_Example_S32K358::TresosProject::Ocu_Example_S32K358::config::EcuC.xdm, category=SWCFG
          short-label=examples::EBT::S32K358::Ocu_Example_S32K358::TresosProject::Ocu_Example_S32K358::config::Mcl.xdm, category=SWCFG
          short-label=examples::EBT::S32K358::Ocu_Example_S32K358::TresosProject::Ocu_Example_S32K358::config::Mcu.xdm, category=SWCFG
          short-label=examples::EBT::S32K358::Ocu_Example_S32K358::TresosProject::Ocu_Example_S32K358::config::Ocu.xdm, category=SWCFG
          short-label=examples::EBT::S32K358::Ocu_Example_S32K358::TresosProject::Ocu_Example_S32K358::config::Platform.xdm, category=SWCFG
          short-label=examples::EBT::S32K358::Ocu_Example_S32K358::TresosProject::Ocu_Example_S32K358::config::Port.xdm, category=SWCFG
          short-label=examples::EBT::S32K358::Ocu_Example_S32K358::TresosProject::Ocu_Example_S32K358::config::Resource.xdm, category=SWCFG
          short-label=examples::EBT::S32K396::Ocu_Example_S32K396::generate::epc::BaseNXP.xdm, category=SWCFG
          short-label=examples::EBT::S32K396::Ocu_Example_S32K396::generate::epc::Dem.xdm, category=SWCFG
          short-label=examples::EBT::S32K396::Ocu_Example_S32K396::generate::epc::Dio.xdm, category=SWCFG
          short-label=examples::EBT::S32K396::Ocu_Example_S32K396::generate::epc::EcuC.xdm, category=SWCFG
          short-label=examples::EBT::S32K396::Ocu_Example_S32K396::generate::epc::Mcl.xdm, category=SWCFG
          short-label=examples::EBT::S32K396::Ocu_Example_S32K396::generate::epc::Mcu.xdm, category=SWCFG
          short-label=examples::EBT::S32K396::Ocu_Example_S32K396::generate::epc::Ocu.xdm, category=SWCFG
          short-label=examples::EBT::S32K396::Ocu_Example_S32K396::generate::epc::Platform.xdm, category=SWCFG
          short-label=examples::EBT::S32K396::Ocu_Example_S32K396::generate::epc::Port.xdm, category=SWCFG
          short-label=examples::EBT::S32K396::Ocu_Example_S32K396::generate::epc::Resource.xdm, category=SWCFG
          short-label=examples::EBT::S32K396::Ocu_Example_S32K396::include::check_example.h, category=SWHDR
          short-label=examples::EBT::S32K396::Ocu_Example_S32K396::src::main.c, category=SWSRC
          short-label=examples::EBT::S32K396::Ocu_Example_S32K396::TresosProject::Ocu_Example_S32K396::.prefs::preferences.xdm, category=SWCFG
          short-label=examples::EBT::S32K396::Ocu_Example_S32K396::TresosProject::Ocu_Example_S32K396::config::BaseNXP.xdm, category=SWCFG
          short-label=examples::EBT::S32K396::Ocu_Example_S32K396::TresosProject::Ocu_Example_S32K396::config::Dem.xdm, category=SWCFG
          short-label=examples::EBT::S32K396::Ocu_Example_S32K396::TresosProject::Ocu_Example_S32K396::config::Dio.xdm, category=SWCFG
          short-label=examples::EBT::S32K396::Ocu_Example_S32K396::TresosProject::Ocu_Example_S32K396::config::EcuC.xdm, category=SWCFG
          short-label=examples::EBT::S32K396::Ocu_Example_S32K396::TresosProject::Ocu_Example_S32K396::config::Mcl.xdm, category=SWCFG
          short-label=examples::EBT::S32K396::Ocu_Example_S32K396::TresosProject::Ocu_Example_S32K396::config::Mcu.xdm, category=SWCFG
          short-label=examples::EBT::S32K396::Ocu_Example_S32K396::TresosProject::Ocu_Example_S32K396::config::Ocu.xdm, category=SWCFG
          short-label=examples::EBT::S32K396::Ocu_Example_S32K396::TresosProject::Ocu_Example_S32K396::config::Platform.xdm, category=SWCFG
          short-label=examples::EBT::S32K396::Ocu_Example_S32K396::TresosProject::Ocu_Example_S32K396::config::Port.xdm, category=SWCFG
          short-label=examples::EBT::S32K396::Ocu_Example_S32K396::TresosProject::Ocu_Example_S32K396::config::Resource.xdm, category=SWCFG
          short-label=examples::EBT::S32K3XX::Ocu_Example_S32K344::generate::epc::BaseNXP.xdm, category=SWCFG
          short-label=examples::EBT::S32K3XX::Ocu_Example_S32K344::generate::epc::Dem.xdm, category=SWCFG
          short-label=examples::EBT::S32K3XX::Ocu_Example_S32K344::generate::epc::Dio.xdm, category=SWCFG
          short-label=examples::EBT::S32K3XX::Ocu_Example_S32K344::generate::epc::EcuC.xdm, category=SWCFG
          short-label=examples::EBT::S32K3XX::Ocu_Example_S32K344::generate::epc::Mcl.xdm, category=SWCFG
          short-label=examples::EBT::S32K3XX::Ocu_Example_S32K344::generate::epc::Mcu.xdm, category=SWCFG
          short-label=examples::EBT::S32K3XX::Ocu_Example_S32K344::generate::epc::Ocu.xdm, category=SWCFG
          short-label=examples::EBT::S32K3XX::Ocu_Example_S32K344::generate::epc::Platform.xdm, category=SWCFG
          short-label=examples::EBT::S32K3XX::Ocu_Example_S32K344::generate::epc::Port.xdm, category=SWCFG
          short-label=examples::EBT::S32K3XX::Ocu_Example_S32K344::generate::epc::Resource.xdm, category=SWCFG
          short-label=examples::EBT::S32K3XX::Ocu_Example_S32K344::include::check_example.h, category=SWHDR
          short-label=examples::EBT::S32K3XX::Ocu_Example_S32K344::src::main.c, category=SWSRC
          short-label=examples::EBT::S32K3XX::Ocu_Example_S32K344::TresosProject::Ocu_Example_S32K344::.prefs::preferences.xdm, category=SWCFG
          short-label=examples::EBT::S32K3XX::Ocu_Example_S32K344::TresosProject::Ocu_Example_S32K344::config::BaseNXP.xdm, category=SWCFG
          short-label=examples::EBT::S32K3XX::Ocu_Example_S32K344::TresosProject::Ocu_Example_S32K344::config::Dem.xdm, category=SWCFG
          short-label=examples::EBT::S32K3XX::Ocu_Example_S32K344::TresosProject::Ocu_Example_S32K344::config::Dio.xdm, category=SWCFG
          short-label=examples::EBT::S32K3XX::Ocu_Example_S32K344::TresosProject::Ocu_Example_S32K344::config::EcuC.xdm, category=SWCFG
          short-label=examples::EBT::S32K3XX::Ocu_Example_S32K344::TresosProject::Ocu_Example_S32K344::config::Mcl.xdm, category=SWCFG
          short-label=examples::EBT::S32K3XX::Ocu_Example_S32K344::TresosProject::Ocu_Example_S32K344::config::Mcu.xdm, category=SWCFG
          short-label=examples::EBT::S32K3XX::Ocu_Example_S32K344::TresosProject::Ocu_Example_S32K344::config::Ocu.xdm, category=SWCFG
          short-label=examples::EBT::S32K3XX::Ocu_Example_S32K344::TresosProject::Ocu_Example_S32K344::config::Platform.xdm, category=SWCFG
          short-label=examples::EBT::S32K3XX::Ocu_Example_S32K344::TresosProject::Ocu_Example_S32K344::config::Port.xdm, category=SWCFG
          short-label=examples::EBT::S32K3XX::Ocu_Example_S32K344::TresosProject::Ocu_Example_S32K344::config::Resource.xdm, category=SWCFG
          short-label=examples::S32DS::S32K358::eMios_Ocu_Ip_Example_S32K358::include::check_example.h, category=SWHDR
          short-label=examples::S32DS::S32K358::eMios_Ocu_Ip_Example_S32K358::Project_Settings::Startup_Code::exceptions.c, category=SWSRC
          short-label=examples::S32DS::S32K358::eMios_Ocu_Ip_Example_S32K358::Project_Settings::Startup_Code::nvic.c, category=SWSRC
          short-label=examples::S32DS::S32K358::eMios_Ocu_Ip_Example_S32K358::Project_Settings::Startup_Code::startup.c, category=SWSRC
          short-label=examples::S32DS::S32K358::eMios_Ocu_Ip_Example_S32K358::Project_Settings::Startup_Code::system.c, category=SWSRC
          short-label=examples::S32DS::S32K358::eMios_Ocu_Ip_Example_S32K358::src::main.c, category=SWSRC
          short-label=examples::S32DS::S32K358::Ocu_Example_S32K358::include::check_example.h, category=SWHDR
          short-label=examples::S32DS::S32K358::Ocu_Example_S32K358::Project_Settings::Startup_Code::exceptions.c, category=SWSRC
          short-label=examples::S32DS::S32K358::Ocu_Example_S32K358::Project_Settings::Startup_Code::nvic.c, category=SWSRC
          short-label=examples::S32DS::S32K358::Ocu_Example_S32K358::Project_Settings::Startup_Code::startup.c, category=SWSRC
          short-label=examples::S32DS::S32K358::Ocu_Example_S32K358::Project_Settings::Startup_Code::system.c, category=SWSRC
          short-label=examples::S32DS::S32K358::Ocu_Example_S32K358::src::main.c, category=SWSRC
          short-label=examples::S32DS::S32K396::eMios_Ocu_Ip_Example_S32K396::include::check_example.h, category=SWHDR
          short-label=examples::S32DS::S32K396::eMios_Ocu_Ip_Example_S32K396::Project_Settings::Startup_Code::exceptions.c, category=SWSRC
          short-label=examples::S32DS::S32K396::eMios_Ocu_Ip_Example_S32K396::Project_Settings::Startup_Code::nvic.c, category=SWSRC
          short-label=examples::S32DS::S32K396::eMios_Ocu_Ip_Example_S32K396::Project_Settings::Startup_Code::startup.c, category=SWSRC
          short-label=examples::S32DS::S32K396::eMios_Ocu_Ip_Example_S32K396::Project_Settings::Startup_Code::system.c, category=SWSRC
          short-label=examples::S32DS::S32K396::eMios_Ocu_Ip_Example_S32K396::src::main.c, category=SWSRC
          short-label=examples::S32DS::S32K396::Ocu_Example_S32K396::include::check_example.h, category=SWHDR
          short-label=examples::S32DS::S32K396::Ocu_Example_S32K396::Project_Settings::Startup_Code::exceptions.c, category=SWSRC
          short-label=examples::S32DS::S32K396::Ocu_Example_S32K396::Project_Settings::Startup_Code::nvic.c, category=SWSRC
          short-label=examples::S32DS::S32K396::Ocu_Example_S32K396::Project_Settings::Startup_Code::startup.c, category=SWSRC
          short-label=examples::S32DS::S32K396::Ocu_Example_S32K396::Project_Settings::Startup_Code::system.c, category=SWSRC
          short-label=examples::S32DS::S32K396::Ocu_Example_S32K396::src::main.c, category=SWSRC
          short-label=examples::S32DS::S32K3XX::eMios_Ocu_Ip_Example_S32K344::include::check_example.h, category=SWHDR
          short-label=examples::S32DS::S32K3XX::eMios_Ocu_Ip_Example_S32K344::Project_Settings::Startup_Code::exceptions.c, category=SWSRC
          short-label=examples::S32DS::S32K3XX::eMios_Ocu_Ip_Example_S32K344::Project_Settings::Startup_Code::nvic.c, category=SWSRC
          short-label=examples::S32DS::S32K3XX::eMios_Ocu_Ip_Example_S32K344::Project_Settings::Startup_Code::startup.c, category=SWSRC
          short-label=examples::S32DS::S32K3XX::eMios_Ocu_Ip_Example_S32K344::Project_Settings::Startup_Code::system.c, category=SWSRC
          short-label=examples::S32DS::S32K3XX::eMios_Ocu_Ip_Example_S32K344::src::main.c, category=SWSRC
          short-label=examples::S32DS::S32K3XX::Ocu_Example_S32K344::include::check_example.h, category=SWHDR
          short-label=examples::S32DS::S32K3XX::Ocu_Example_S32K344::Project_Settings::Startup_Code::exceptions.c, category=SWSRC
          short-label=examples::S32DS::S32K3XX::Ocu_Example_S32K344::Project_Settings::Startup_Code::nvic.c, category=SWSRC
          short-label=examples::S32DS::S32K3XX::Ocu_Example_S32K344::Project_Settings::Startup_Code::startup.c, category=SWSRC
          short-label=examples::S32DS::S32K3XX::Ocu_Example_S32K344::Project_Settings::Startup_Code::system.c, category=SWSRC
          short-label=examples::S32DS::S32K3XX::Ocu_Example_S32K344::src::main.c, category=SWSRC
          short-label=include::Emios_Ocu_Ip.h, category=SWHDR
          short-label=include::Emios_Ocu_Ip_HwAccess.h, category=SWHDR
          short-label=include::Emios_Ocu_Ip_Irq.h, category=SWHDR
          short-label=include::Emios_Ocu_Ip_TrustedFunctions.h, category=SWHDR
          short-label=include::Emios_Ocu_Ip_Types.h, category=SWHDR
          short-label=include::Ocu.h, category=SWHDR
          short-label=include::Ocu_EnvCfg.h, category=SWHDR
          short-label=include::Ocu_Ipw.h, category=SWHDR
          short-label=include::Ocu_Ipw_Types.h, category=SWHDR
          short-label=include::Ocu_Irq.h, category=SWHDR
          short-label=include::Ocu_Types.h, category=SWHDR
          short-label=src::Emios_Ocu_Ip.c, category=SWSRC
          short-label=src::Emios_Ocu_Ip_Irq.c, category=SWSRC
          short-label=src::Ocu.c, category=SWSRC
          short-label=src::Ocu_Ipw.c, category=SWSRC
    4 x compiler:
      DIAB_Compiler:
        name=Windriver Diab
        options=-tARMCORTEXM7MG:simple -mthumb -std=c99 -Oz -g -fstandalone-debug -Wstrict-prototypes -Wsign-compare -Wdouble-promotion -Wunknown-pragmas -Wundef -Wextra -Wall -pedantic -Werror=implicit-function-declaration -fno-common -fno-signed-char -fno-trigraphs -V -c -DS32K3XX -D $ (DERIVATIVE) -DDIAB -DUSE_SW_VECTOR_MODE -DD_CACHE_ENABLE -DI_CACHE_ENABLE -DENABLE_FPU -DMCAL_ENABLE_USER_MODE_SUPPORT
        vendor=Windriver
        version=Wind River Diab Compiler v7.0.4
      GCC_Compiler:
        name=GCC Compiler
        options=-mcpu=cortex-m7 -mthumb -mlittle-endian -mfpu=fpv5-sp-d16 -mfloat-abi=hard -std=c99 -Os -ggdb3 -Wall -Wextra -pedantic -Wstrict-prototypes -Wundef -Wunused -Werror=implicit-function-declaration -Wsign-compare -Wdouble-promotion -fno-short-enums -funsigned-char -funsigned-bitfields -fno-common -fstack-usage -fdump-ipa-all -c -DS32K3XX -D $ (DERIVATIVE) -DGCC -DUSE_SW_VECTOR_MODE -DD_CACHE_ENABLE -DI_CACHE_ENABLE -DENABLE_FPU -DMCAL_ENABLE_USER_MODE_SUPPORT --sysroot=$(NEWLIB_DIR) -specs=nano.specs -specs=nosys.specs
        vendor=GCC Systems
        version=NXP GCC 10.2.0 20200723
      GHS_Compiler:
        name=Green Hills
        options=-cpu=cortexm7 -thumb -fpu=vfpv5_d16 -fsingle -C99 --ghstd=last -Osize --gnu_asm -dual_debug -G -keeptempfiles -Wimplicit-int -Wshadow -Wtrigraphs -Wundef --unsigned_chars --unsigned_fields --no_commons --no_exceptions --no_slash_comment --prototype_errors --incorrect_pragma_warnings -c -DS32K3XX -D $ (DERIVATIVE) -DGHS -DUSE_SW_VECTOR_MODE -DD_CACHE_ENABLE -DI_CACHE_ENABLE -DENABLE_FPU -DMCAL_ENABLE_USER_MODE_SUPPORT
        vendor=Green Hills
        version=Green Hills Multi 7.1.6d / Compiler 2021.1.4
      IAR_Compiler:
        name=IAR Compiler
        options=--cpu Cortex-M7 --cpu_mode thumb --endian little --fpu VFPv5-SP -e -Ohz --debug --no_clustering --no_mem_idioms --do_explicit_zero_opt_in_named_sections --require_prototypes --no_wrap_diagnostics --diag_suppress Pa050 -DS32K3XX -D $ (DERIVATIVE) -DIAR -DUSE_SW_VECTOR_MODE -DD_CACHE_ENABLE -DI_CACHE_ENABLE -DENABLE_FPU -DMCAL_ENABLE_USER_MODE_SUPPORT
        vendor=IAR Systems
        version=IAR ANSI C/C++ Compiler v.8.50.10 (safety version)
    generated-artifacts:
      12 x dependency on artifact:
        Emios_Ocu_Ip_PBcfg_h: artifact-descriptor={short-label=generate_PB::include::Emios_Ocu_Ip_PBcfg.h, category=SWHDR}, usages=EXECUTE
        Ocu_Ipw_PBcfg_h: artifact-descriptor={short-label=generate_PB::include::Ocu_Ipw_PBcfg.h, category=SWHDR}, usages=EXECUTE
        Ocu_PBcfg_h: artifact-descriptor={short-label=generate_PB::include::Ocu_PBcfg.h, category=SWHDR}, usages=EXECUTE
        Emios_Ocu_Ip_PBcfg_c: artifact-descriptor={short-label=generate_PB::src::Emios_Ocu_Ip_PBcfg.c, category=SWSRC}, usages=EXECUTE
        Ocu_Ipw_PBcfg_c: artifact-descriptor={short-label=generate_PB::src::Ocu_Ipw_PBcfg.c, category=SWSRC}, usages=EXECUTE
        Ocu_PBcfg_c: artifact-descriptor={short-label=generate_PB::src::Ocu_PBcfg.c, category=SWSRC}, usages=EXECUTE
        Emios_Ocu_Ip_Cfg_h: artifact-descriptor={short-label=generate_PC::include::Emios_Ocu_Ip_Cfg.h, category=SWHDR}, usages=COMPILE
        Emios_Ocu_Ip_CfgDefines_h: artifact-descriptor={short-label=generate_PC::include::Emios_Ocu_Ip_CfgDefines.h, category=SWHDR}, usages=COMPILE
        Ocu_Cfg_h: artifact-descriptor={short-label=generate_PC::include::Ocu_Cfg.h, category=SWHDR}, usages=COMPILE
        Ocu_CfgDefines_h: artifact-descriptor={short-label=generate_PC::include::Ocu_CfgDefines.h, category=SWHDR}, usages=COMPILE
        Ocu_Ipw_Cfg_h: artifact-descriptor={short-label=generate_PC::include::Ocu_Ipw_Cfg.h, category=SWHDR}, usages=COMPILE
        Ocu_Ipw_CfgDefines_h: artifact-descriptor={short-label=generate_PC::include::Ocu_Ipw_CfgDefines.h, category=SWHDR}, usages=COMPILE
    4 x linker:
      DIAB_Linker: name=Windriver Diab, options=-e Reset_Handler linker_script_file.dld -m30 -Xstack-usage -Xpreprocess-lecl -Llibrary_path -lc -lm -tARMCORTEXM7MG:simple, vendor=Windriver, version=Wind River Diab Compiler v7.0.4
      GCC_Linker: name=GCC Compiler, options=-Wl,-Map,filename -T linkerfile --entry=Reset_Handler -nostartfiles -mcpu=cortexm7 -mthumb -mfpu=fpv5-sp-d16 -mfloat-abi=hard -mlittle-endian -ggdb3 -lc -lm -lgcc -specs=nano.specs -specs=nosys.specs, vendor=GCC Systems, version=NXP GCC 10.2.0 20200723
      GHS_Linker: name=Green Hills, options=-e Reset_Handler -T linker_script_file.ld -map -keepmap -Mn -delete -ignore_debug_references -Llibrary_path -larch -lstartup -lind_sd -v -keep=C40_Ip_AccessCode -nostartfiles, vendor=Green Hills, version=Green Hills Multi 7.1.6d / Compiler 2021.1.4
      IAR_Linker: name=IAR Compiler, options=--map filename --config linkerfile --cpu=Cortex-M7 --fpu VFPv5-SP --entry _start --enable_stack_usage --skip_dynamic_initialization --no_wrap_diagnostics, vendor=IAR Systems, version=IAR ANSI C/C++ Compiler v.8.50.10 (safety version)
    resource consumption ResourceConsumption
      8 x memory section:
        OCU_CODE: alignment=UNSPECIFIED, sw-addrmethod=CODE, symbol=CODE
        OCU_CONFIG_DATA_UNSPECIFIED: alignment=UNSPECIFIED, sw-addrmethod=CONFIG_DATA, symbol=CONFIG_DATA_UNSPECIFIED
        OCU_CONST_UNSPECIFIED: alignment=UNSPECIFIED, sw-addrmethod=CONST, symbol=CONST_UNSPECIFIED
        OCU_VAR_CLEARED_32: alignment=32, sw-addrmethod=VAR_CLEARED, symbol=VAR_CLEARED_32
        OCU_VAR_CLEARED_8: alignment=8, sw-addrmethod=VAR_CLEARED, symbol=VAR_CLEARED_8
        OCU_VAR_CLEARED_BOOLEAN: alignment=BOOLEAN, sw-addrmethod=VAR_CLEARED, symbol=VAR_CLEARED_BOOLEAN
        OCU_VAR_CLEARED_UNSPECIFIED: alignment=UNSPECIFIED, sw-addrmethod=VAR_CLEARED, symbol=VAR_CLEARED_UNSPECIFIED
        OCU_VAR_INIT_UNSPECIFIED: alignment=UNSPECIFIED, sw-addrmethod=VAR_INIT, symbol=VAR_INIT_UNSPECIFIED
