AUTOSAR XML (schema 00050)
package /AUTOSAR_Dpga/BswModuleDescriptions
  bsw module description Dpga: module-id=255, provided-entrys=Dpga_Isr
    bsw internal behavior InternalBehavior_0
      bsw interrupt entity Dpga_Isr: implemented-entry=Dpga_Isr, interrupt-category=CAT-2, interrupt-source=Hardware
package /AUTOSAR_Dpga/BswModuleEntrys
  bsw module entry Dpga_Isr: service-id=0, is-reentrant=false, is-synchronous=true, call-type=INTERRUPT, execution-context=INTERRUPT-CAT-2, sw-service-impl-policy=STANDARD
package /Dpga_TS_T40D34M30I0R0/Implementations
  bsw implementation BswImplementation_0: programming-language=C, sw-version=3.0.0, vendor-id=43, ar-release-version=4.7.0, behavior=InternalBehavior_0, vendor-specific-module-def=Dpga
    code-descriptors:
      code Files
        artifact-descriptors:
          short-label=config::Dpga.xdm, category=SWCFG
          short-label=doc::RTD_DPGA_IM.pdf, category=SWDOC
          short-label=doc::RTD_DPGA_UM.pdf, category=SWDOC
          short-label=examples::EBT::S32M276::Dpga_example_S32M276::generate::epc::Ae.xdm, category=SWCFG
          short-label=examples::EBT::S32M276::Dpga_example_S32M276::generate::epc::BaseNXP.xdm, category=SWCFG
          short-label=examples::EBT::S32M276::Dpga_example_S32M276::generate::epc::Dpga.xdm, category=SWCFG
          short-label=examples::EBT::S32M276::Dpga_example_S32M276::generate::epc::EcuC.xdm, category=SWCFG
          short-label=examples::EBT::S32M276::Dpga_example_S32M276::generate::epc::Mcu.xdm, category=SWCFG
          short-label=examples::EBT::S32M276::Dpga_example_S32M276::generate::epc::Port.xdm, category=SWCFG
          short-label=examples::EBT::S32M276::Dpga_example_S32M276::generate::epc::Resource.xdm, category=SWCFG
          short-label=examples::EBT::S32M276::Dpga_example_S32M276::generate::epc::Spi.xdm, category=SWCFG
          short-label=examples::EBT::S32M276::Dpga_example_S32M276::include::check_example.h, category=SWHDR
          short-label=examples::EBT::S32M276::Dpga_example_S32M276::src::main.c, category=SWSRC
          short-label=examples::EBT::S32M276::Dpga_example_S32M276::TresosProject::Dpga_example_S32M276::.prefs::preferences.xdm, category=SWCFG
          short-label=examples::EBT::S32M276::Dpga_example_S32M276::TresosProject::Dpga_example_S32M276::config::Ae.xdm, category=SWCFG
          short-label=examples::EBT::S32M276::Dpga_example_S32M276::TresosProject::Dpga_example_S32M276::config::BaseNXP.xdm, category=SWCFG
          short-label=examples::EBT::S32M276::Dpga_example_S32M276::TresosProject::Dpga_example_S32M276::config::Dpga.xdm, category=SWCFG
          short-label=examples::EBT::S32M276::Dpga_example_S32M276::TresosProject::Dpga_example_S32M276::config::EcuC.xdm, category=SWCFG
          short-label=examples::EBT::S32M276::Dpga_example_S32M276::TresosProject::Dpga_example_S32M276::config::Mcu.xdm, category=SWCFG
          short-label=examples::EBT::S32M276::Dpga_example_S32M276::TresosProject::Dpga_example_S32M276::config::Port.xdm, category=SWCFG
          short-label=examples::EBT::S32M276::Dpga_example_S32M276::TresosProject::Dpga_example_S32M276::config::Resource.xdm, category=SWCFG
          short-label=examples::EBT::S32M276::Dpga_example_S32M276::TresosProject::Dpga_example_S32M276::config::Spi.xdm, category=SWCFG
          short-label=examples::S32DS::S32M276::Dpga_example_S32M276::include::check_example.h, category=SWHDR
          short-label=examples::S32DS::S32M276::Dpga_example_S32M276::Project_Settings::Startup_Code::exceptions.c, category=SWSRC
          short-label=examples::S32DS::S32M276::Dpga_example_S32M276::Project_Settings::Startup_Code::nvic.c, category=SWSRC
          short-label=examples::S32DS::S32M276::Dpga_example_S32M276::Project_Settings::Startup_Code::startup.c, category=SWSRC
          short-label=examples::S32DS::S32M276::Dpga_example_S32M276::Project_Settings::Startup_Code::system.c, category=SWSRC
          short-label=examples::S32DS::S32M276::Dpga_example_S32M276::src::main.c, category=SWSRC
          short-label=examples::S32DS::S32M276::Dpga_Ip_example_S32M276::include::check_example.h, category=SWHDR
          short-label=examples::S32DS::S32M276::Dpga_Ip_example_S32M276::Project_Settings::Startup_Code::exceptions.c, category=SWSRC
          short-label=examples::S32DS::S32M276::Dpga_Ip_example_S32M276::Project_Settings::Startup_Code::nvic.c, category=SWSRC
          short-label=examples::S32DS::S32M276::Dpga_Ip_example_S32M276::Project_Settings::Startup_Code::startup.c, category=SWSRC
          short-label=examples::S32DS::S32M276::Dpga_Ip_example_S32M276::Project_Settings::Startup_Code::system.c, category=SWSRC
          short-label=examples::S32DS::S32M276::Dpga_Ip_example_S32M276::src::main.c, category=SWSRC
          short-label=include::CDD_Dpga.h, category=SWHDR
          short-label=include::CDD_Dpga_Types.h, category=SWHDR
          short-label=include::Dpga_Ip.h, category=SWHDR
          short-label=include::Dpga_Ip_Types.h, category=SWHDR
          short-label=src::CDD_Dpga.c, category=SWSRC
          short-label=src::Dpga_Ip.c, category=SWSRC
          short-label=src::Dpga_Ip_Isr.c, category=SWSRC
    4 x compiler:
      DIAB_Compiler:
        name=Windriver Diab
        options=-tARMCORTEXM7MG:simple -mthumb -std=c99 -Oz -g -fstandalone-debug -Wstrict-prototypes -Wsign-compare -Wdouble-promotion -Wunknown-pragmas -Wundef -Wextra -Wall -pedantic -Werror=implicit-function-declaration -fno-common -fno-signed-char -fno-trigraphs -V -c -DS32K3XX -D $ (DERIVATIVE) -DDIAB -DUSE_SW_VECTOR_MODE -DD_CACHE_ENABLE -DI_CACHE_ENABLE -DENABLE_FPU -DMCAL_ENABLE_USER_MODE_SUPPORT
        vendor=Windriver
        version=Wind River Diab Compiler v7.0.4
      GCC_Compiler:
        name=GCC Compiler
        options=-mcpu=cortex-m7 -mthumb -mlittle-endian -mfpu=fpv5-sp-d16 -mfloat-abi=hard -std=c99 -Os -ggdb3 -Wall -Wextra -pedantic -Wstrict-prototypes -Wundef -Wunused -Werror=implicit-function-declaration -Wsign-compare -Wdouble-promotion -fno-short-enums -funsigned-char -funsigned-bitfields -fno-common -fstack-usage -fdump-ipa-all -c -DS32K3XX -D $ (DERIVATIVE) -DGCC -DUSE_SW_VECTOR_MODE -DD_CACHE_ENABLE -DI_CACHE_ENABLE -DENABLE_FPU -DMCAL_ENABLE_USER_MODE_SUPPORT --sysroot=$(NEWLIB_DIR) -specs=nano.specs -specs=nosys.specs
        vendor=GCC Systems
        version=NXP GCC 10.2.0 20200723
      GHS_Compiler:
        name=Green Hills
        options=-cpu=cortexm7 -thumb -fpu=vfpv5_d16 -fsingle -C99 --ghstd=last -Osize --gnu_asm -dual_debug -G -keeptempfiles -Wimplicit-int -Wshadow -Wtrigraphs -Wundef --unsigned_chars --unsigned_fields --no_commons --no_exceptions --no_slash_comment --prototype_errors --incorrect_pragma_warnings -c -DS32K3XX -D $ (DERIVATIVE) -DGHS -DUSE_SW_VECTOR_MODE -DD_CACHE_ENABLE -DI_CACHE_ENABLE -DENABLE_FPU -DMCAL_ENABLE_USER_MODE_SUPPORT
        vendor=Green Hills
        version=Green Hills Multi 7.1.6d / Compiler 2021.1.4
      IAR_Compiler:
        name=IAR Compiler
        options=--cpu Cortex-M7 --cpu_mode thumb --endian little --fpu VFPv5-SP -e -Ohz --debug --no_clustering --no_mem_idioms --do_explicit_zero_opt_in_named_sections --require_prototypes --no_wrap_diagnostics --diag_suppress Pa050 -DS32K3XX -D $ (DERIVATIVE) -DIAR -DUSE_SW_VECTOR_MODE -DD_CACHE_ENABLE -DI_CACHE_ENABLE -DENABLE_FPU -DMCAL_ENABLE_USER_MODE_SUPPORT
        vendor=IAR Systems
        version=IAR ANSI C/C++ Compiler v.8.50.10 (safety version)
    generated-artifacts:
      9 x dependency on artifact:
        CDD_Dpga_PBcfg_h: artifact-descriptor={short-label=generate_PB::include::CDD_Dpga_PBcfg.h, category=SWHDR}, usages=EXECUTE
        Dpga_Ip_PBcfg_h: artifact-descriptor={short-label=generate_PB::include::Dpga_Ip_PBcfg.h, category=SWHDR}, usages=EXECUTE
        CDD_Dpga_PBcfg_c: artifact-descriptor={short-label=generate_PB::src::CDD_Dpga_PBcfg.c, category=SWSRC}, usages=EXECUTE
        Dpga_Ip_PBcfg_c: artifact-descriptor={short-label=generate_PB::src::Dpga_Ip_PBcfg.c, category=SWSRC}, usages=EXECUTE
        CDD_Dpga_Cfg_h: artifact-descriptor={short-label=generate_PC::include::CDD_Dpga_Cfg.h, category=SWHDR}, usages=COMPILE
        CDD_Dpga_CfgDefines_h: artifact-descriptor={short-label=generate_PC::include::CDD_Dpga_CfgDefines.h, category=SWHDR}, usages=COMPILE
        Dpga_Ip_Cfg_h: artifact-descriptor={short-label=generate_PC::include::Dpga_Ip_Cfg.h, category=SWHDR}, usages=COMPILE
        Dpga_Ip_CfgDefines_h: artifact-descriptor={short-label=generate_PC::include::Dpga_Ip_CfgDefines.h, category=SWHDR}, usages=COMPILE
        CDD_Dpga_Cfg_c: artifact-descriptor={short-label=generate_PC::src::CDD_Dpga_Cfg.c, category=SWSRC}, usages=COMPILE
    4 x linker:
      DIAB_Linker: name=Windriver Diab, options=-e Reset_Handler linker_script_file.dld -m30 -Xstack-usage -Xpreprocess-lecl -Llibrary_path -lc -lm -tARMCORTEXM7MG:simple, vendor=Windriver, version=Wind River Diab Compiler v7.0.4
      GCC_Linker: name=GCC Compiler, options=-Wl,-Map,filename -T linkerfile --entry=Reset_Handler -nostartfiles -mcpu=cortexm7 -mthumb -mfpu=fpv5-sp-d16 -mfloat-abi=hard -mlittle-endian -ggdb3 -lc -lm -lgcc -specs=nano.specs -specs=nosys.specs, vendor=GCC Systems, version=NXP GCC 10.2.0 20200723
      GHS_Linker: name=Green Hills, options=-e Reset_Handler -T linker_script_file.ld -map -keepmap -Mn -delete -ignore_debug_references -Llibrary_path -larch -lstartup -lind_sd -v -keep=C40_Ip_AccessCode -nostartfiles, vendor=Green Hills, version=Green Hills Multi 7.1.6d / Compiler 2021.1.4
      IAR_Linker: name=IAR Compiler, options=--map filename --config linkerfile --cpu=Cortex-M7 --fpu VFPv5-SP --entry _start --enable_stack_usage --skip_dynamic_initialization --no_wrap_diagnostics, vendor=IAR Systems, version=IAR ANSI C/C++ Compiler v.8.50.10 (safety version)
    resource consumption ResourceConsumption
      6 x memory section:
        DPGA_CODE: alignment=UNSPECIFIED, sw-addrmethod=CODE, symbol=CODE
        DPGA_CONFIG_DATA_UNSPECIFIED: alignment=UNSPECIFIED, sw-addrmethod=CONFIG_DATA, symbol=CONFIG_DATA_UNSPECIFIED
        DPGA_CONST_UNSPECIFIED: alignment=UNSPECIFIED, sw-addrmethod=CONST, symbol=CONST_UNSPECIFIED
        DPGA_VAR_CLEARED_BOOLEAN: alignment=BOOLEAN, sw-addrmethod=VAR_CLEARED, symbol=VAR_CLEARED_BOOLEAN
        DPGA_VAR_CLEARED_UNSPECIFIED: alignment=UNSPECIFIED, sw-addrmethod=VAR_CLEARED, symbol=VAR_CLEARED_UNSPECIFIED
        DPGA_VAR_INIT_UNSPECIFIED: alignment=UNSPECIFIED, sw-addrmethod=VAR_INIT, symbol=VAR_INIT_UNSPECIFIED
