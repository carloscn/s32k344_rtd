AUTOSAR XML (schema 00050)
package /AUTOSAR_Gdu/BswModuleDescriptions
  bsw module description Gdu: module-id=123
    provided-entrys:
      Gdu_AdjustSlewRate
      Gdu_GetStatus
      Gdu_GetVersionInfo
      Gdu_Init
      Gdu_OffStateDiagnostics
      Gdu_ReadDelayMeasurement
      Gdu_SetMode
      Gdu_SetSafeState
      Gdu_StartDelayMeasurement
      Gdu_SwIrefTrimming
      Gdu_FaultProtection
      Gdu_Ip_Irq_ISR
    bsw internal behavior InternalBehavior_0
      10 x bsw called entity:
        Gdu_AdjustSlewRate: implemented-entry=Gdu_AdjustSlewRate
        Gdu_GetStatus: implemented-entry=Gdu_GetStatus
        Gdu_GetVersionInfo: implemented-entry=Gdu_GetVersionInfo
        Gdu_Init: implemented-entry=Gdu_Init
        Gdu_OffStateDiagnostics: implemented-entry=Gdu_OffStateDiagnostics
        Gdu_ReadDelayMeasurement: implemented-entry=Gdu_ReadDelayMeasurement
        Gdu_SetMode: implemented-entry=Gdu_SetMode
        Gdu_SetSafeState: implemented-entry=Gdu_SetSafeState
        Gdu_StartDelayMeasurement: implemented-entry=Gdu_StartDelayMeasurement
        Gdu_SwIrefTrimming: implemented-entry=Gdu_SwIrefTrimming
      bsw interrupt entity Gdu_FaultProtection: implemented-entry=Gdu_FaultProtection, interrupt-category=CAT-2, interrupt-source=Hardware
      bsw interrupt entity Gdu_Ip_Irq_ISR: implemented-entry=Gdu_Ip_Irq_ISR, interrupt-category=CAT-2, interrupt-source=Hardware
package /AUTOSAR_Gdu/BswModuleEntrys
  12 x bsw module entry, all with is-synchronous=true, sw-service-impl-policy=STANDARD:
    Gdu_AdjustSlewRate: service-id=0x06, is-reentrant=false, call-type=REGULAR, execution-context=UNSPECIFIED
    Gdu_GetStatus: service-id=0x03, is-reentrant=false, call-type=REGULAR, execution-context=UNSPECIFIED
    Gdu_GetVersionInfo: service-id=0x09, is-reentrant=true, call-type=REGULAR, execution-context=UNSPECIFIED
    Gdu_Init: service-id=0x00, is-reentrant=false, call-type=REGULAR, execution-context=UNSPECIFIED
    Gdu_OffStateDiagnostics: service-id=0x08, is-reentrant=false, call-type=REGULAR, execution-context=UNSPECIFIED
    Gdu_ReadDelayMeasurement: service-id=0x05, is-reentrant=false, call-type=REGULAR, execution-context=UNSPECIFIED
    Gdu_SetMode: service-id=0x01, is-reentrant=false, call-type=REGULAR, execution-context=UNSPECIFIED
    Gdu_SetSafeState: service-id=0x02, is-reentrant=false, call-type=REGULAR, execution-context=UNSPECIFIED
    Gdu_StartDelayMeasurement: service-id=0x04, is-reentrant=false, call-type=REGULAR, execution-context=UNSPECIFIED
    Gdu_SwIrefTrimming: service-id=0x07, is-reentrant=false, call-type=REGULAR, execution-context=UNSPECIFIED
    Gdu_FaultProtection: service-id=0, is-reentrant=false, call-type=INTERRUPT, execution-context=INTERRUPT-CAT-2
    Gdu_Ip_Irq_ISR: service-id=0, is-reentrant=false, call-type=INTERRUPT, execution-context=INTERRUPT-CAT-2
package /Gdu_TS_T40D34M30I0R0/Implementations
  bsw implementation BswImplementation_0: programming-language=C, sw-version=3.0.0, vendor-id=43, ar-release-version=4.7.0, behavior=InternalBehavior_0, vendor-specific-module-def=Gdu
    code-descriptors:
      code Files
        artifact-descriptors:
          short-label=config::Gdu.xdm, category=SWCFG
          short-label=doc::RTD_GDU_IM.pdf, category=SWDOC
          short-label=doc::RTD_GDU_UM.pdf, category=SWDOC
          short-label=EBT::Gdu.xdm, category=SWCFG
          short-label=examples::EBT::S32M276::Gdu_Example_EBT_S32M276::generate::epc::Ae.xdm, category=SWCFG
          short-label=examples::EBT::S32M276::Gdu_Example_EBT_S32M276::generate::epc::BaseNXP.xdm, category=SWCFG
          short-label=examples::EBT::S32M276::Gdu_Example_EBT_S32M276::generate::epc::EcuC.xdm, category=SWCFG
          short-label=examples::EBT::S32M276::Gdu_Example_EBT_S32M276::generate::epc::Gdu.xdm, category=SWCFG
          short-label=examples::EBT::S32M276::Gdu_Example_EBT_S32M276::generate::epc::Mcu.xdm, category=SWCFG
          short-label=examples::EBT::S32M276::Gdu_Example_EBT_S32M276::generate::epc::Os.xdm, category=SWCFG
          short-label=examples::EBT::S32M276::Gdu_Example_EBT_S32M276::generate::epc::Platform.xdm, category=SWCFG
          short-label=examples::EBT::S32M276::Gdu_Example_EBT_S32M276::generate::epc::Port.xdm, category=SWCFG
          short-label=examples::EBT::S32M276::Gdu_Example_EBT_S32M276::generate::epc::Resource.xdm, category=SWCFG
          short-label=examples::EBT::S32M276::Gdu_Example_EBT_S32M276::generate::epc::Spi.xdm, category=SWCFG
          short-label=examples::EBT::S32M276::Gdu_Example_EBT_S32M276::include::check_example.h, category=SWHDR
          short-label=examples::EBT::S32M276::Gdu_Example_EBT_S32M276::src::main.c, category=SWSRC
          short-label=examples::EBT::S32M276::Gdu_Example_EBT_S32M276::TresosProject::Gdu_Example_EBT_S32M276::.prefs::preferences.xdm, category=SWCFG
          short-label=examples::EBT::S32M276::Gdu_Example_EBT_S32M276::TresosProject::Gdu_Example_EBT_S32M276::config::Ae.xdm, category=SWCFG
          short-label=examples::EBT::S32M276::Gdu_Example_EBT_S32M276::TresosProject::Gdu_Example_EBT_S32M276::config::BaseNXP.xdm, category=SWCFG
          short-label=examples::EBT::S32M276::Gdu_Example_EBT_S32M276::TresosProject::Gdu_Example_EBT_S32M276::config::EcuC.xdm, category=SWCFG
          short-label=examples::EBT::S32M276::Gdu_Example_EBT_S32M276::TresosProject::Gdu_Example_EBT_S32M276::config::Gdu.xdm, category=SWCFG
          short-label=examples::EBT::S32M276::Gdu_Example_EBT_S32M276::TresosProject::Gdu_Example_EBT_S32M276::config::Mcu.xdm, category=SWCFG
          short-label=examples::EBT::S32M276::Gdu_Example_EBT_S32M276::TresosProject::Gdu_Example_EBT_S32M276::config::Os.xdm, category=SWCFG
          short-label=examples::EBT::S32M276::Gdu_Example_EBT_S32M276::TresosProject::Gdu_Example_EBT_S32M276::config::Platform.xdm, category=SWCFG
          short-label=examples::EBT::S32M276::Gdu_Example_EBT_S32M276::TresosProject::Gdu_Example_EBT_S32M276::config::Port.xdm, category=SWCFG
          short-label=examples::EBT::S32M276::Gdu_Example_EBT_S32M276::TresosProject::Gdu_Example_EBT_S32M276::config::Resource.xdm, category=SWCFG
          short-label=examples::EBT::S32M276::Gdu_Example_EBT_S32M276::TresosProject::Gdu_Example_EBT_S32M276::config::Spi.xdm, category=SWCFG
          short-label=examples::S32DS::S32M276::Gdu_Example_DS_S32M276::include::check_example.h, category=SWHDR
          short-label=examples::S32DS::S32M276::Gdu_Example_DS_S32M276::Project_Settings::Startup_Code::exceptions.c, category=SWSRC
          short-label=examples::S32DS::S32M276::Gdu_Example_DS_S32M276::Project_Settings::Startup_Code::nvic.c, category=SWSRC
          short-label=examples::S32DS::S32M276::Gdu_Example_DS_S32M276::Project_Settings::Startup_Code::startup.c, category=SWSRC
          short-label=examples::S32DS::S32M276::Gdu_Example_DS_S32M276::Project_Settings::Startup_Code::system.c, category=SWSRC
          short-label=examples::S32DS::S32M276::Gdu_Example_DS_S32M276::src::main.c, category=SWSRC
          short-label=include::CDD_Gdu.h, category=SWHDR
          short-label=include::CDD_Gdu_Types.h, category=SWHDR
          short-label=include::Gdu_Ip.h, category=SWHDR
          short-label=include::Gdu_Ip_Irq.h, category=SWHDR
          short-label=include::Gdu_Ip_Types.h, category=SWHDR
          short-label=src::CDD_Gdu.c, category=SWSRC
          short-label=src::Gdu_Ip.c, category=SWSRC
          short-label=src::Gdu_Ip_Irq.c, category=SWSRC
    4 x compiler:
      DIAB_Compiler:
        name=Windriver Diab
        options=-tARMCORTEXM7MG:simple -mthumb -std=c99 -Oz -g -fstandalone-debug -Wstrict-prototypes -Wsign-compare -Wdouble-promotion -Wunknown-pragmas -Wundef -Wextra -Wall -pedantic -Werror=implicit-function-declaration -fno-common -fno-signed-char -fno-trigraphs -V -c -DS32K3XX -D $ (DERIVATIVE) -DDIAB -DUSE_SW_VECTOR_MODE -DD_CACHE_ENABLE -DI_CACHE_ENABLE -DENABLE_FPU -DMCAL_ENABLE_USER_MODE_SUPPORT
        vendor=Windriver
        version=Wind River Diab Compiler v7.0.4
      GCC_Compiler:
        name=GCC Compiler
        options=-mcpu=cortex-m7 -mthumb -mlittle-endian -mfpu=fpv5-sp-d16 -mfloat-abi=hard -std=c99 -Os -ggdb3 -Wall -Wextra -pedantic -Wstrict-prototypes -Wundef -Wunused -Werror=implicit-function-declaration -Wsign-compare -Wdouble-promotion -fno-short-enums -funsigned-char -funsigned-bitfields -fno-common -fstack-usage -fdump-ipa-all -c -DS32K3XX -D $ (DERIVATIVE) -DGCC -DUSE_SW_VECTOR_MODE -DD_CACHE_ENABLE -DI_CACHE_ENABLE -DENABLE_FPU -DMCAL_ENABLE_USER_MODE_SUPPORT --sysroot=$(NEWLIB_DIR) -specs=nano.specs -specs=nosys.specs
        vendor=GCC Systems
        version=NXP GCC 10.2.0 20200723
      GHS_Compiler:
        name=Green Hills
        options=-cpu=cortexm7 -thumb -fpu=vfpv5_d16 -fsingle -C99 --ghstd=last -Osize --gnu_asm -dual_debug -G -keeptempfiles -Wimplicit-int -Wshadow -Wtrigraphs -Wundef --unsigned_chars --unsigned_fields --no_commons --no_exceptions --no_slash_comment --prototype_errors --incorrect_pragma_warnings -c -DS32K3XX -D $ (DERIVATIVE) -DGHS -DUSE_SW_VECTOR_MODE -DD_CACHE_ENABLE -DI_CACHE_ENABLE -DENABLE_FPU -DMCAL_ENABLE_USER_MODE_SUPPORT
        vendor=Green Hills
        version=Green Hills Multi 7.1.6d / Compiler 2021.1.4
      IAR_Compiler:
        name=IAR Compiler
        options=--cpu Cortex-M7 --cpu_mode thumb --endian little --fpu VFPv5-SP -e -Ohz --debug --no_clustering --no_mem_idioms --do_explicit_zero_opt_in_named_sections --require_prototypes --no_wrap_diagnostics --diag_suppress Pa050 -DS32K3XX -D $ (DERIVATIVE) -DIAR -DUSE_SW_VECTOR_MODE -DD_CACHE_ENABLE -DI_CACHE_ENABLE -DENABLE_FPU -DMCAL_ENABLE_USER_MODE_SUPPORT
        vendor=IAR Systems
        version=IAR ANSI C/C++ Compiler v.8.50.10 (safety version)
    generated-artifacts:
      8 x dependency on artifact:
        CDD_Gdu_PBcfg_h: artifact-descriptor={short-label=generate_PB::include::CDD_Gdu_PBcfg.h, category=SWHDR}, usages=EXECUTE
        Gdu_Ip_PBcfg_h: artifact-descriptor={short-label=generate_PB::include::Gdu_Ip_PBcfg.h, category=SWHDR}, usages=EXECUTE
        CDD_Gdu_PBcfg_c: artifact-descriptor={short-label=generate_PB::src::CDD_Gdu_PBcfg.c, category=SWSRC}, usages=EXECUTE
        Gdu_Ip_PBcfg_c: artifact-descriptor={short-label=generate_PB::src::Gdu_Ip_PBcfg.c, category=SWSRC}, usages=EXECUTE
        CDD_Gdu_Cfg_h: artifact-descriptor={short-label=generate_PC::include::CDD_Gdu_Cfg.h, category=SWHDR}, usages=COMPILE
        CDD_Gdu_CfgDefines_h: artifact-descriptor={short-label=generate_PC::include::CDD_Gdu_CfgDefines.h, category=SWHDR}, usages=COMPILE
        Gdu_Ip_Cfg_h: artifact-descriptor={short-label=generate_PC::include::Gdu_Ip_Cfg.h, category=SWHDR}, usages=COMPILE
        Gdu_Ip_CfgDefines_h: artifact-descriptor={short-label=generate_PC::include::Gdu_Ip_CfgDefines.h, category=SWHDR}, usages=COMPILE
    4 x linker:
      DIAB_Linker: name=Windriver Diab, options=-e Reset_Handler linker_script_file.dld -m30 -Xstack-usage -Xpreprocess-lecl -Llibrary_path -lc -lm -tARMCORTEXM7MG:simple, vendor=Windriver, version=Wind River Diab Compiler v7.0.4
      GCC_Linker: name=GCC Compiler, options=-Wl,-Map,filename -T linkerfile --entry=Reset_Handler -nostartfiles -mcpu=cortexm7 -mthumb -mfpu=fpv5-sp-d16 -mfloat-abi=hard -mlittle-endian -ggdb3 -lc -lm -lgcc -specs=nano.specs -specs=nosys.specs, vendor=GCC Systems, version=NXP GCC 10.2.0 20200723
      GHS_Linker: name=Green Hills, options=-e Reset_Handler -T linker_script_file.ld -map -keepmap -Mn -delete -ignore_debug_references -Llibrary_path -larch -lstartup -lind_sd -v -keep=C40_Ip_AccessCode -nostartfiles, vendor=Green Hills, version=Green Hills Multi 7.1.6d / Compiler 2021.1.4
      IAR_Linker: name=IAR Compiler, options=--map filename --config linkerfile --cpu=Cortex-M7 --fpu VFPv5-SP --entry _start --enable_stack_usage --skip_dynamic_initialization --no_wrap_diagnostics, vendor=IAR Systems, version=IAR ANSI C/C++ Compiler v.8.50.10 (safety version)
    resource consumption ResourceConsumption
      5 x memory section:
        GDU_CODE: alignment=UNSPECIFIED, sw-addrmethod=CODE, symbol=CODE
        GDU_CONFIG_DATA_UNSPECIFIED: alignment=UNSPECIFIED, sw-addrmethod=CONFIG_DATA, symbol=CONFIG_DATA_UNSPECIFIED
        GDU_VAR_CLEARED_16: alignment=16, sw-addrmethod=VAR_CLEARED, symbol=VAR_CLEARED_16
        GDU_VAR_CLEARED_BOOLEAN: alignment=BOOLEAN, sw-addrmethod=VAR_CLEARED, symbol=VAR_CLEARED_BOOLEAN
        GDU_VAR_CLEARED_UNSPECIFIED: alignment=UNSPECIFIED, sw-addrmethod=VAR_CLEARED, symbol=VAR_CLEARED_UNSPECIFIED
