AUTOSAR XML (schema 00050)
package /AUTOSAR_Zipwire/BswModuleDescriptions
  bsw module description Zipwire: module-id=255
    provided-entrys:
      Zipwire_DeInit
      Zipwire_GetChannelStatus
      Zipwire_Init
      Zipwire_Read
      Zipwire_ReadBlocking
      Zipwire_ReadDma
      Zipwire_ReadDmaBlocking
      Zipwire_RequestId
      Zipwire_StreamWrite
      Zipwire_Trigger
      Zipwire_Write
      Zipwire_WriteBlocking
      Zipwire_WriteDma
      Zipwire_WriteDmaBlocking
    bsw internal behavior InternalBehavior_0
      14 x bsw called entity:
        Zipwire_DeInit: implemented-entry=Zipwire_DeInit
        Zipwire_GetChannelStatus: implemented-entry=Zipwire_GetChannelStatus
        Zipwire_Init: implemented-entry=Zipwire_Init
        Zipwire_Read: implemented-entry=Zipwire_Read
        Zipwire_ReadBlocking: implemented-entry=Zipwire_ReadBlocking
        Zipwire_ReadDma: implemented-entry=Zipwire_ReadDma
        Zipwire_ReadDmaBlocking: implemented-entry=Zipwire_ReadDmaBlocking
        Zipwire_RequestId: implemented-entry=Zipwire_RequestId
        Zipwire_StreamWrite: implemented-entry=Zipwire_StreamWrite
        Zipwire_Trigger: implemented-entry=Zipwire_Trigger
        Zipwire_Write: implemented-entry=Zipwire_Write
        Zipwire_WriteBlocking: implemented-entry=Zipwire_WriteBlocking
        Zipwire_WriteDma: implemented-entry=Zipwire_WriteDma
        Zipwire_WriteDmaBlocking: implemented-entry=Zipwire_WriteDmaBlocking
package /AUTOSAR_Zipwire/BswModuleEntrys
  14 x bsw module entry, all with call-type=REGULAR, execution-context=UNSPECIFIED, sw-service-impl-policy=STANDARD:
    Zipwire_DeInit: service-id=0x01, is-reentrant=false, is-synchronous=true
    Zipwire_GetChannelStatus: service-id=0x0c, is-reentrant=true, is-synchronous=true
    Zipwire_Init: service-id=0x00, is-reentrant=false, is-synchronous=true
    Zipwire_Read: service-id=0x02, is-reentrant=true, is-synchronous=false
    Zipwire_ReadBlocking: service-id=0x03, is-reentrant=true, is-synchronous=true
    Zipwire_ReadDma: service-id=0x04, is-reentrant=true, is-synchronous=false
    Zipwire_ReadDmaBlocking: service-id=0x05, is-reentrant=true, is-synchronous=true
    Zipwire_RequestId: service-id=0x0c, is-reentrant=true, is-synchronous=true
    Zipwire_StreamWrite: service-id=0x0a, is-reentrant=true, is-synchronous=true
    Zipwire_Trigger: service-id=0x0d, is-reentrant=true, is-synchronous=true
    Zipwire_Write: service-id=0x06, is-reentrant=true, is-synchronous=false
    Zipwire_WriteBlocking: service-id=0x07, is-reentrant=true, is-synchronous=true
    Zipwire_WriteDma: service-id=0x08, is-reentrant=true, is-synchronous=false
    Zipwire_WriteDmaBlocking: service-id=0x09, is-reentrant=true, is-synchronous=true
package /Zipwire_TS_T40D34M30I0R0/Implementations
  bsw implementation BswImplementation_0: programming-language=C, sw-version=3.0.0, vendor-id=43, ar-release-version=4.7.0, behavior=InternalBehavior_0, vendor-specific-module-def=Zipwire
    code-descriptors:
      code Files
        artifact-descriptors:
          short-label=config::Zipwire.xdm, category=SWCFG
          short-label=doc::RTD_ZIPWIRE_IM.pdf, category=SWDOC
          short-label=doc::RTD_ZIPWIRE_UM.pdf, category=SWDOC
          short-label=examples::EBT::S32K396::Zipwire_Example_Master_S32K396::generate::epc::BaseNXP.xdm, category=SWCFG
          short-label=examples::EBT::S32K396::Zipwire_Example_Master_S32K396::generate::epc::Mcu.xdm, category=SWCFG
          short-label=examples::EBT::S32K396::Zipwire_Example_Master_S32K396::generate::epc::Platform.xdm, category=SWCFG
          short-label=examples::EBT::S32K396::Zipwire_Example_Master_S32K396::generate::epc::Port.xdm, category=SWCFG
          short-label=examples::EBT::S32K396::Zipwire_Example_Master_S32K396::generate::epc::Resource.xdm, category=SWCFG
          short-label=examples::EBT::S32K396::Zipwire_Example_Master_S32K396::generate::epc::Zipwire.xdm, category=SWCFG
          short-label=examples::EBT::S32K396::Zipwire_Example_Master_S32K396::include::check_example.h, category=SWHDR
          short-label=examples::EBT::S32K396::Zipwire_Example_Master_S32K396::src::main.c, category=SWSRC
          short-label=examples::EBT::S32K396::Zipwire_Example_Master_S32K396::TresosProject::Zipwire_Example_Master_S32K396::.prefs::preferences.xdm, category=SWCFG
          short-label=examples::EBT::S32K396::Zipwire_Example_Master_S32K396::TresosProject::Zipwire_Example_Master_S32K396::config::BaseNXP.xdm, category=SWCFG
          short-label=examples::EBT::S32K396::Zipwire_Example_Master_S32K396::TresosProject::Zipwire_Example_Master_S32K396::config::EcuC.xdm, category=SWCFG
          short-label=examples::EBT::S32K396::Zipwire_Example_Master_S32K396::TresosProject::Zipwire_Example_Master_S32K396::config::Mcu.xdm, category=SWCFG
          short-label=examples::EBT::S32K396::Zipwire_Example_Master_S32K396::TresosProject::Zipwire_Example_Master_S32K396::config::Platform.xdm, category=SWCFG
          short-label=examples::EBT::S32K396::Zipwire_Example_Master_S32K396::TresosProject::Zipwire_Example_Master_S32K396::config::Port.xdm, category=SWCFG
          short-label=examples::EBT::S32K396::Zipwire_Example_Master_S32K396::TresosProject::Zipwire_Example_Master_S32K396::config::Resource.xdm, category=SWCFG
          short-label=examples::EBT::S32K396::Zipwire_Example_Master_S32K396::TresosProject::Zipwire_Example_Master_S32K396::config::Zipwire.xdm, category=SWCFG
          short-label=examples::EBT::S32K396::Zipwire_Example_Slave_S32K396::generate::epc::BaseNXP.xdm, category=SWCFG
          short-label=examples::EBT::S32K396::Zipwire_Example_Slave_S32K396::generate::epc::Mcu.xdm, category=SWCFG
          short-label=examples::EBT::S32K396::Zipwire_Example_Slave_S32K396::generate::epc::Platform.xdm, category=SWCFG
          short-label=examples::EBT::S32K396::Zipwire_Example_Slave_S32K396::generate::epc::Port.xdm, category=SWCFG
          short-label=examples::EBT::S32K396::Zipwire_Example_Slave_S32K396::generate::epc::Resource.xdm, category=SWCFG
          short-label=examples::EBT::S32K396::Zipwire_Example_Slave_S32K396::generate::epc::Zipwire.xdm, category=SWCFG
          short-label=examples::EBT::S32K396::Zipwire_Example_Slave_S32K396::include::check_example.h, category=SWHDR
          short-label=examples::EBT::S32K396::Zipwire_Example_Slave_S32K396::src::main.c, category=SWSRC
          short-label=examples::EBT::S32K396::Zipwire_Example_Slave_S32K396::TresosProject::Zipwire_Example_Slave_S32K396::.prefs::preferences.xdm, category=SWCFG
          short-label=examples::EBT::S32K396::Zipwire_Example_Slave_S32K396::TresosProject::Zipwire_Example_Slave_S32K396::config::BaseNXP.xdm, category=SWCFG
          short-label=examples::EBT::S32K396::Zipwire_Example_Slave_S32K396::TresosProject::Zipwire_Example_Slave_S32K396::config::EcuC.xdm, category=SWCFG
          short-label=examples::EBT::S32K396::Zipwire_Example_Slave_S32K396::TresosProject::Zipwire_Example_Slave_S32K396::config::Mcu.xdm, category=SWCFG
          short-label=examples::EBT::S32K396::Zipwire_Example_Slave_S32K396::TresosProject::Zipwire_Example_Slave_S32K396::config::Platform.xdm, category=SWCFG
          short-label=examples::EBT::S32K396::Zipwire_Example_Slave_S32K396::TresosProject::Zipwire_Example_Slave_S32K396::config::Port.xdm, category=SWCFG
          short-label=examples::EBT::S32K396::Zipwire_Example_Slave_S32K396::TresosProject::Zipwire_Example_Slave_S32K396::config::Resource.xdm, category=SWCFG
          short-label=examples::EBT::S32K396::Zipwire_Example_Slave_S32K396::TresosProject::Zipwire_Example_Slave_S32K396::config::Zipwire.xdm, category=SWCFG
          short-label=examples::S32DS::S32K396::Zipwire_Example_Master_S32K396::include::check_example.h, category=SWHDR
          short-label=examples::S32DS::S32K396::Zipwire_Example_Master_S32K396::Project_Settings::Startup_Code::exceptions.c, category=SWSRC
          short-label=examples::S32DS::S32K396::Zipwire_Example_Master_S32K396::Project_Settings::Startup_Code::nvic.c, category=SWSRC
          short-label=examples::S32DS::S32K396::Zipwire_Example_Master_S32K396::Project_Settings::Startup_Code::startup.c, category=SWSRC
          short-label=examples::S32DS::S32K396::Zipwire_Example_Master_S32K396::Project_Settings::Startup_Code::system.c, category=SWSRC
          short-label=examples::S32DS::S32K396::Zipwire_Example_Master_S32K396::src::main.c, category=SWSRC
          short-label=examples::S32DS::S32K396::Zipwire_Example_Slave_S32K396::include::check_example.h, category=SWHDR
          short-label=examples::S32DS::S32K396::Zipwire_Example_Slave_S32K396::Project_Settings::Startup_Code::exceptions.c, category=SWSRC
          short-label=examples::S32DS::S32K396::Zipwire_Example_Slave_S32K396::Project_Settings::Startup_Code::nvic.c, category=SWSRC
          short-label=examples::S32DS::S32K396::Zipwire_Example_Slave_S32K396::Project_Settings::Startup_Code::startup.c, category=SWSRC
          short-label=examples::S32DS::S32K396::Zipwire_Example_Slave_S32K396::Project_Settings::Startup_Code::system.c, category=SWSRC
          short-label=examples::S32DS::S32K396::Zipwire_Example_Slave_S32K396::src::main.c, category=SWSRC
          short-label=examples::S32DS::S32K396::Zipwire_Ip_Example_Master_S32K396::include::check_example.h, category=SWHDR
          short-label=examples::S32DS::S32K396::Zipwire_Ip_Example_Master_S32K396::Project_Settings::Startup_Code::exceptions.c, category=SWSRC
          short-label=examples::S32DS::S32K396::Zipwire_Ip_Example_Master_S32K396::Project_Settings::Startup_Code::nvic.c, category=SWSRC
          short-label=examples::S32DS::S32K396::Zipwire_Ip_Example_Master_S32K396::Project_Settings::Startup_Code::startup.c, category=SWSRC
          short-label=examples::S32DS::S32K396::Zipwire_Ip_Example_Master_S32K396::Project_Settings::Startup_Code::system.c, category=SWSRC
          short-label=examples::S32DS::S32K396::Zipwire_Ip_Example_Master_S32K396::src::main.c, category=SWSRC
          short-label=examples::S32DS::S32K396::Zipwire_Ip_Example_Slave_S32K396::include::check_example.h, category=SWHDR
          short-label=examples::S32DS::S32K396::Zipwire_Ip_Example_Slave_S32K396::Project_Settings::Startup_Code::exceptions.c, category=SWSRC
          short-label=examples::S32DS::S32K396::Zipwire_Ip_Example_Slave_S32K396::Project_Settings::Startup_Code::nvic.c, category=SWSRC
          short-label=examples::S32DS::S32K396::Zipwire_Ip_Example_Slave_S32K396::Project_Settings::Startup_Code::startup.c, category=SWSRC
          short-label=examples::S32DS::S32K396::Zipwire_Ip_Example_Slave_S32K396::Project_Settings::Startup_Code::system.c, category=SWSRC
          short-label=examples::S32DS::S32K396::Zipwire_Ip_Example_Slave_S32K396::src::main.c, category=SWSRC
          short-label=include::CDD_Zipwire.h, category=SWHDR
          short-label=include::Zipwire_Cfg.h, category=SWHDR
          short-label=include::Zipwire_Ip.h, category=SWHDR
          short-label=include::Zipwire_Ipw.h, category=SWHDR
          short-label=include::Zipwire_Ip_DevAssert.h, category=SWHDR
          short-label=include::Zipwire_Ip_Lfast.h, category=SWHDR
          short-label=include::Zipwire_Ip_Lfast_Hw_Access.h, category=SWHDR
          short-label=include::Zipwire_Ip_Sipi_Hw_Access.h, category=SWHDR
          short-label=include::Zipwire_Ip_Sipi_Irq.h, category=SWHDR
          short-label=include::Zipwire_Ip_Types.h, category=SWHDR
          short-label=include::Zipwire_Types.h, category=SWHDR
          short-label=src::CDD_Zipwire.c, category=SWSRC
          short-label=src::Zipwire_Cfg.c, category=SWSRC
          short-label=src::Zipwire_Ip.c, category=SWSRC
          short-label=src::Zipwire_Ip_Lfast.c, category=SWSRC
          short-label=src::Zipwire_Ip_Sipi_Irq.c, category=SWSRC
    4 x compiler:
      DIAB_Compiler:
        name=Windriver Diab
        options=-tARMCORTEXM7MG:simple -mthumb -std=c99 -Oz -g -fstandalone-debug -Wstrict-prototypes -Wsign-compare -Wdouble-promotion -Wunknown-pragmas -Wundef -Wextra -Wall -pedantic -Werror=implicit-function-declaration -fno-common -fno-signed-char -fno-trigraphs -V -c -DS32K3XX -D $ (DERIVATIVE) -DDIAB -DUSE_SW_VECTOR_MODE -DD_CACHE_ENABLE -DI_CACHE_ENABLE -DENABLE_FPU -DMCAL_ENABLE_USER_MODE_SUPPORT
        vendor=Windriver
        version=Wind River Diab Compiler v7.0.4
      GCC_Compiler:
        name=GCC Compiler
        options=-mcpu=cortex-m7 -mthumb -mlittle-endian -mfpu=fpv5-sp-d16 -mfloat-abi=hard -std=c99 -Os -ggdb3 -Wall -Wextra -pedantic -Wstrict-prototypes -Wundef -Wunused -Werror=implicit-function-declaration -Wsign-compare -Wdouble-promotion -fno-short-enums -funsigned-char -funsigned-bitfields -fno-common -fstack-usage -fdump-ipa-all -c -DS32K3XX -D $ (DERIVATIVE) -DGCC -DUSE_SW_VECTOR_MODE -DD_CACHE_ENABLE -DI_CACHE_ENABLE -DENABLE_FPU -DMCAL_ENABLE_USER_MODE_SUPPORT --sysroot=$(NEWLIB_DIR) -specs=nano.specs -specs=nosys.specs
        vendor=GCC Systems
        version=NXP GCC 10.2.0 20200723
      GHS_Compiler:
        name=Green Hills
        options=-cpu=cortexm7 -thumb -fpu=vfpv5_d16 -fsingle -C99 --ghstd=last -Osize --gnu_asm -dual_debug -G -keeptempfiles -Wimplicit-int -Wshadow -Wtrigraphs -Wundef --unsigned_chars --unsigned_fields --no_commons --no_exceptions --no_slash_comment --prototype_errors --incorrect_pragma_warnings -c -DS32K3XX -D $ (DERIVATIVE) -DGHS -DUSE_SW_VECTOR_MODE -DD_CACHE_ENABLE -DI_CACHE_ENABLE -DENABLE_FPU -DMCAL_ENABLE_USER_MODE_SUPPORT
        vendor=Green Hills
        version=Green Hills Multi 7.1.6d / Compiler 2021.1.4
      IAR_Compiler:
        name=IAR Compiler
        options=--cpu Cortex-M7 --cpu_mode thumb --endian little --fpu VFPv5-SP -e -Ohz --debug --no_clustering --no_mem_idioms --do_explicit_zero_opt_in_named_sections --require_prototypes --no_wrap_diagnostics --diag_suppress Pa050 -DS32K3XX -D $ (DERIVATIVE) -DIAR -DUSE_SW_VECTOR_MODE -DD_CACHE_ENABLE -DI_CACHE_ENABLE -DENABLE_FPU -DMCAL_ENABLE_USER_MODE_SUPPORT
        vendor=IAR Systems
        version=IAR ANSI C/C++ Compiler v.8.50.10 (safety version)
    generated-artifacts:
      dependency on artifact Zipwire_Ip_Cfg_h: artifact-descriptor={short-label=generate_PC::include::Zipwire_Ip_Cfg.h, category=SWHDR}, usages=COMPILE
      dependency on artifact Zipwire_Ip_CfgDefines_h: artifact-descriptor={short-label=generate_PC::include::Zipwire_Ip_CfgDefines.h, category=SWHDR}, usages=COMPILE
      dependency on artifact Zipwire_Ip_Cfg_c: artifact-descriptor={short-label=generate_PC::src::Zipwire_Ip_Cfg.c, category=SWSRC}, usages=COMPILE
    4 x linker:
      DIAB_Linker: name=Windriver Diab, options=-e Reset_Handler linker_script_file.dld -m30 -Xstack-usage -Xpreprocess-lecl -Llibrary_path -lc -lm -tARMCORTEXM7MG:simple, vendor=Windriver, version=Wind River Diab Compiler v7.0.4
      GCC_Linker: name=GCC Compiler, options=-Wl,-Map,filename -T linkerfile --entry=Reset_Handler -nostartfiles -mcpu=cortexm7 -mthumb -mfpu=fpv5-sp-d16 -mfloat-abi=hard -mlittle-endian -ggdb3 -lc -lm -lgcc -specs=nano.specs -specs=nosys.specs, vendor=GCC Systems, version=NXP GCC 10.2.0 20200723
      GHS_Linker: name=Green Hills, options=-e Reset_Handler -T linker_script_file.ld -map -keepmap -Mn -delete -ignore_debug_references -Llibrary_path -larch -lstartup -lind_sd -v -keep=C40_Ip_AccessCode -nostartfiles, vendor=Green Hills, version=Green Hills Multi 7.1.6d / Compiler 2021.1.4
      IAR_Linker: name=IAR Compiler, options=--map filename --config linkerfile --cpu=Cortex-M7 --fpu VFPv5-SP --entry _start --enable_stack_usage --skip_dynamic_initialization --no_wrap_diagnostics, vendor=IAR Systems, version=IAR ANSI C/C++ Compiler v.8.50.10 (safety version)
    resource consumption ResourceConsumption
      6 x memory section, all with alignment=UNSPECIFIED:
        ZIPWIRE_CODE: sw-addrmethod=CODE, symbol=CODE
        ZIPWIRE_CONFIG_DATA_UNSPECIFIED: sw-addrmethod=CONFIG_DATA, symbol=CONFIG_DATA_UNSPECIFIED
        ZIPWIRE_CONST_UNSPECIFIED: sw-addrmethod=CONST, symbol=CONST_UNSPECIFIED
        ZIPWIRE_VAR_CLEARED_UNSPECIFIED: sw-addrmethod=VAR_CLEARED, symbol=VAR_CLEARED_UNSPECIFIED
        ZIPWIRE_VAR_CLEARED_UNSPECIFIED_NO_CACHEABLE: sw-addrmethod=VAR_CLEARED_NO_CACHEABLE, symbol=VAR_CLEARED_UNSPECIFIED_NO_CACHEABLE
        ZIPWIRE_VAR_INIT_UNSPECIFIED: sw-addrmethod=VAR_INIT, symbol=VAR_INIT_UNSPECIFIED
