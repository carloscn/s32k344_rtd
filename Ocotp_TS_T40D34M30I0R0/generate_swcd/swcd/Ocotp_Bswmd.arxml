AUTOSAR XML (schema 00050)
package /AUTOSAR_Ocotp/BswModuleDescriptions
  bsw module description Ocotp: module-id=255, provided-entrys=[Ocotp_Deinit, Ocotp_Init, Ocotp_ReadEFuse, Ocotp_ReadMirrorRegister, Ocotp_WriteMirrorRegister]
    bsw internal behavior InternalBehavior_0
      exclusive area OCOTP_EXCLUSIVE_AREA_01
      5 x bsw called entity:
        Ocotp_Deinit: implemented-entry=Ocotp_Deinit
        Ocotp_Init: implemented-entry=Ocotp_Init
        Ocotp_ReadEFuse: can-enter-exclusive-area=OCOTP_EXCLUSIVE_AREA_01, implemented-entry=Ocotp_ReadEFuse
        Ocotp_ReadMirrorRegister: implemented-entry=Ocotp_ReadMirrorRegister
        Ocotp_WriteMirrorRegister: implemented-entry=Ocotp_WriteMirrorRegister
package /AUTOSAR_Ocotp/BswModuleEntrys
  5 x bsw module entry, all with is-synchronous=true, call-type=REGULAR, execution-context=UNSPECIFIED, sw-service-impl-policy=STANDARD:
    Ocotp_Deinit: service-id=0x01, is-reentrant=false
    Ocotp_Init: service-id=0x00, is-reentrant=false
    Ocotp_ReadEFuse: service-id=0x04, is-reentrant=true
    Ocotp_ReadMirrorRegister: service-id=0x11, is-reentrant=false
    Ocotp_WriteMirrorRegister: service-id=0x10, is-reentrant=false
package /Ocotp_TS_T40D34M30I0R0/Implementations
  bsw implementation BswImplementation_0: programming-language=C, sw-version=3.0.0, vendor-id=43, ar-release-version=4.7.0, behavior=InternalBehavior_0, vendor-specific-module-def=Ocotp
    code-descriptors:
      code Files
        artifact-descriptors:
          short-label=config::Ocotp.xdm, category=SWCFG
          short-label=doc::RTD_OCOTP_IM.pdf, category=SWDOC
          short-label=doc::RTD_OCOTP_UM.pdf, category=SWDOC
          short-label=examples::EBT::S32M276::Ocotp_Example_S32M276::generate::epc::Ae.xdm, category=SWCFG
          short-label=examples::EBT::S32M276::Ocotp_Example_S32M276::generate::epc::BaseNXP.xdm, category=SWCFG
          short-label=examples::EBT::S32M276::Ocotp_Example_S32M276::generate::epc::EcuC.xdm, category=SWCFG
          short-label=examples::EBT::S32M276::Ocotp_Example_S32M276::generate::epc::Mcu.xdm, category=SWCFG
          short-label=examples::EBT::S32M276::Ocotp_Example_S32M276::generate::epc::Ocotp.xdm, category=SWCFG
          short-label=examples::EBT::S32M276::Ocotp_Example_S32M276::generate::epc::Port.xdm, category=SWCFG
          short-label=examples::EBT::S32M276::Ocotp_Example_S32M276::generate::epc::Resource.xdm, category=SWCFG
          short-label=examples::EBT::S32M276::Ocotp_Example_S32M276::generate::epc::Spi.xdm, category=SWCFG
          short-label=examples::EBT::S32M276::Ocotp_Example_S32M276::include::check_example.h, category=SWHDR
          short-label=examples::EBT::S32M276::Ocotp_Example_S32M276::src::main.c, category=SWSRC
          short-label=examples::EBT::S32M276::Ocotp_Example_S32M276::TresosProject::Ocotp_Example_S32M276::.prefs::preferences.xdm, category=SWCFG
          short-label=examples::EBT::S32M276::Ocotp_Example_S32M276::TresosProject::Ocotp_Example_S32M276::config::Ae.xdm, category=SWCFG
          short-label=examples::EBT::S32M276::Ocotp_Example_S32M276::TresosProject::Ocotp_Example_S32M276::config::BaseNXP.xdm, category=SWCFG
          short-label=examples::EBT::S32M276::Ocotp_Example_S32M276::TresosProject::Ocotp_Example_S32M276::config::EcuC.xdm, category=SWCFG
          short-label=examples::EBT::S32M276::Ocotp_Example_S32M276::TresosProject::Ocotp_Example_S32M276::config::Mcu.xdm, category=SWCFG
          short-label=examples::EBT::S32M276::Ocotp_Example_S32M276::TresosProject::Ocotp_Example_S32M276::config::Ocotp.xdm, category=SWCFG
          short-label=examples::EBT::S32M276::Ocotp_Example_S32M276::TresosProject::Ocotp_Example_S32M276::config::Port.xdm, category=SWCFG
          short-label=examples::EBT::S32M276::Ocotp_Example_S32M276::TresosProject::Ocotp_Example_S32M276::config::Resource.xdm, category=SWCFG
          short-label=examples::EBT::S32M276::Ocotp_Example_S32M276::TresosProject::Ocotp_Example_S32M276::config::Spi.xdm, category=SWCFG
          short-label=examples::S32DS::S32M276::Mem_Otp_Ip_Example_S32M276::include::check_example.h, category=SWHDR
          short-label=examples::S32DS::S32M276::Mem_Otp_Ip_Example_S32M276::Project_Settings::Startup_Code::exceptions.c, category=SWSRC
          short-label=examples::S32DS::S32M276::Mem_Otp_Ip_Example_S32M276::Project_Settings::Startup_Code::nvic.c, category=SWSRC
          short-label=examples::S32DS::S32M276::Mem_Otp_Ip_Example_S32M276::Project_Settings::Startup_Code::startup.c, category=SWSRC
          short-label=examples::S32DS::S32M276::Mem_Otp_Ip_Example_S32M276::Project_Settings::Startup_Code::system.c, category=SWSRC
          short-label=examples::S32DS::S32M276::Mem_Otp_Ip_Example_S32M276::src::main.c, category=SWSRC
          short-label=examples::S32DS::S32M276::Ocotp_Example_S32M276::include::check_example.h, category=SWHDR
          short-label=examples::S32DS::S32M276::Ocotp_Example_S32M276::Project_Settings::Startup_Code::exceptions.c, category=SWSRC
          short-label=examples::S32DS::S32M276::Ocotp_Example_S32M276::Project_Settings::Startup_Code::nvic.c, category=SWSRC
          short-label=examples::S32DS::S32M276::Ocotp_Example_S32M276::Project_Settings::Startup_Code::startup.c, category=SWSRC
          short-label=examples::S32DS::S32M276::Ocotp_Example_S32M276::Project_Settings::Startup_Code::system.c, category=SWSRC
          short-label=examples::S32DS::S32M276::Ocotp_Example_S32M276::src::main.c, category=SWSRC
          short-label=include::CDD_Ocotp.h, category=SWHDR
          short-label=include::Mem_Otp_Ip.h, category=SWHDR
          short-label=include::Mem_Otp_Ip_Defines.h, category=SWHDR
          short-label=include::Mem_Otp_Ip_Types.h, category=SWHDR
          short-label=include::Ocotp_IPW.h, category=SWHDR
          short-label=include::Ocotp_Types.h, category=SWHDR
          short-label=src::CDD_Ocotp.c, category=SWSRC
          short-label=src::Mem_Otp_Ip.c, category=SWSRC
          short-label=src::Ocotp_IPW.c, category=SWSRC
    4 x compiler:
      DIAB_Compiler:
        name=Windriver Diab
        options=-tARMCORTEXM7MG:simple -mthumb -std=c99 -Oz -g -fstandalone-debug -Wstrict-prototypes -Wsign-compare -Wdouble-promotion -Wunknown-pragmas -Wundef -Wextra -Wall -pedantic -Werror=implicit-function-declaration -fno-common -fno-signed-char -fno-trigraphs -V -c -DS32K3XX -D $ (DERIVATIVE) -DDIAB -DUSE_SW_VECTOR_MODE -DD_CACHE_ENABLE -DI_CACHE_ENABLE -DENABLE_FPU -DMCAL_ENABLE_USER_MODE_SUPPORT
        vendor=Windriver
        version=Wind River Diab Compiler v7.0.4
      GCC_Compiler:
        name=GCC Compiler
        options=-mcpu=cortex-m7 -mthumb -mlittle-endian -mfpu=fpv5-sp-d16 -mfloat-abi=hard -std=c99 -Os -ggdb3 -Wall -Wextra -pedantic -Wstrict-prototypes -Wundef -Wunused -Werror=implicit-function-declaration -Wsign-compare -Wdouble-promotion -fno-short-enums -funsigned-char -funsigned-bitfields -fno-common -fstack-usage -fdump-ipa-all -c -DS32K3XX -D $ (DERIVATIVE) -DGCC -DUSE_SW_VECTOR_MODE -DD_CACHE_ENABLE -DI_CACHE_ENABLE -DENABLE_FPU -DMCAL_ENABLE_USER_MODE_SUPPORT --sysroot=$(NEWLIB_DIR) -specs=nano.specs -specs=nosys.specs
        vendor=GCC Systems
        version=NXP GCC 10.2.0 20200723
      GHS_Compiler:
        name=Green Hills
        options=-cpu=cortexm7 -thumb -fpu=vfpv5_d16 -fsingle -C99 --ghstd=last -Osize --gnu_asm -dual_debug -G -keeptempfiles -Wimplicit-int -Wshadow -Wtrigraphs -Wundef --unsigned_chars --unsigned_fields --no_commons --no_exceptions --no_slash_comment --prototype_errors --incorrect_pragma_warnings -c -DS32K3XX -D $ (DERIVATIVE) -DGHS -DUSE_SW_VECTOR_MODE -DD_CACHE_ENABLE -DI_CACHE_ENABLE -DENABLE_FPU -DMCAL_ENABLE_USER_MODE_SUPPORT
        vendor=Green Hills
        version=Green Hills Multi 7.1.6d / Compiler 2021.1.4
      IAR_Compiler:
        name=IAR Compiler
        options=--cpu Cortex-M7 --cpu_mode thumb --endian little --fpu VFPv5-SP -e -Ohz --debug --no_clustering --no_mem_idioms --do_explicit_zero_opt_in_named_sections --require_prototypes --no_wrap_diagnostics --diag_suppress Pa050 -DS32K3XX -D $ (DERIVATIVE) -DIAR -DUSE_SW_VECTOR_MODE -DD_CACHE_ENABLE -DI_CACHE_ENABLE -DENABLE_FPU -DMCAL_ENABLE_USER_MODE_SUPPORT
        vendor=IAR Systems
        version=IAR ANSI C/C++ Compiler v.8.50.10 (safety version)
    generated-artifacts:
      6 x dependency on artifact:
        Ocotp_PBcfg_h: artifact-descriptor={short-label=generate_PB::include::Ocotp_PBcfg.h, category=SWHDR}, usages=EXECUTE
        Mem_Otp_Ip_PBcfg_c: artifact-descriptor={short-label=generate_PB::src::Mem_Otp_Ip_PBcfg.c, category=SWSRC}, usages=EXECUTE
        Ocotp_PBcfg_c: artifact-descriptor={short-label=generate_PB::src::Ocotp_PBcfg.c, category=SWSRC}, usages=EXECUTE
        Mem_Otp_Ip_Cfg_h: artifact-descriptor={short-label=generate_PC::include::Mem_Otp_Ip_Cfg.h, category=SWHDR}, usages=COMPILE
        Ocotp_Cfg_h: artifact-descriptor={short-label=generate_PC::include::Ocotp_Cfg.h, category=SWHDR}, usages=COMPILE
        Ocotp_Cfg_c: artifact-descriptor={short-label=generate_PC::src::Ocotp_Cfg.c, category=SWSRC}, usages=COMPILE
    4 x linker:
      DIAB_Linker: name=Windriver Diab, options=-e Reset_Handler linker_script_file.dld -m30 -Xstack-usage -Xpreprocess-lecl -Llibrary_path -lc -lm -tARMCORTEXM7MG:simple, vendor=Windriver, version=Wind River Diab Compiler v7.0.4
      GCC_Linker: name=GCC Compiler, options=-Wl,-Map,filename -T linkerfile --entry=Reset_Handler -nostartfiles -mcpu=cortexm7 -mthumb -mfpu=fpv5-sp-d16 -mfloat-abi=hard -mlittle-endian -ggdb3 -lc -lm -lgcc -specs=nano.specs -specs=nosys.specs, vendor=GCC Systems, version=NXP GCC 10.2.0 20200723
      GHS_Linker: name=Green Hills, options=-e Reset_Handler -T linker_script_file.ld -map -keepmap -Mn -delete -ignore_debug_references -Llibrary_path -larch -lstartup -lind_sd -v -keep=C40_Ip_AccessCode -nostartfiles, vendor=Green Hills, version=Green Hills Multi 7.1.6d / Compiler 2021.1.4
      IAR_Linker: name=IAR Compiler, options=--map filename --config linkerfile --cpu=Cortex-M7 --fpu VFPv5-SP --entry _start --enable_stack_usage --skip_dynamic_initialization --no_wrap_diagnostics, vendor=IAR Systems, version=IAR ANSI C/C++ Compiler v.8.50.10 (safety version)
    resource consumption ResourceConsumption
      4 x memory section, all with alignment=UNSPECIFIED:
        OCOTP_CODE: sw-addrmethod=CODE, symbol=CODE
        OCOTP_CONFIG_DATA_UNSPECIFIED: sw-addrmethod=CONFIG_DATA, symbol=CONFIG_DATA_UNSPECIFIED
        OCOTP_VAR_CLEARED_UNSPECIFIED_NO_CACHEABLE: sw-addrmethod=VAR_CLEARED_NO_CACHEABLE, symbol=VAR_CLEARED_UNSPECIFIED_NO_CACHEABLE
        OCOTP_VAR_INIT_UNSPECIFIED: sw-addrmethod=VAR_INIT, symbol=VAR_INIT_UNSPECIFIED
