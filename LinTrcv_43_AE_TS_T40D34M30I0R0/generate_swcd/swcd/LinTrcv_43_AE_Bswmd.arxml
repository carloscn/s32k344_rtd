AUTOSAR XML (schema 00050)
package /AUTOSAR_LinTrcv_43_AE/BswModuleDescriptions
  bsw module description LinTrcv: module-id=64
package /LinTrcv_43_AE_TS_T40D34M30I0R0/Implementations
  bsw implementation BswImplementation_0: programming-language=C, sw-version=3.0.0, vendor-id=43, ar-release-version=4.7.0, behavior=InternalBehavior_0, vendor-api-infix=AE, vendor-specific-module-def=LinTrcv
    code-descriptors:
      code Files
        artifact-descriptors:
          short-label=config::LinTrcv_43_AE.xdm, category=SWCFG
          short-label=doc::RTD_LINTRCV_IM.pdf, category=SWDOC
          short-label=doc::RTD_LINTRCV_UM.pdf, category=SWDOC
          short-label=include::AeLinPhy_LinTrcv_Ip.h, category=SWHDR
          short-label=include::AeLinPhy_LinTrcv_Ip_Types.h, category=SWHDR
          short-label=include::LinTrcv_43_AE.h, category=SWHDR
          short-label=include::LinTrcv_43_AE_Ipw.h, category=SWHDR
          short-label=include::LinTrcv_43_AE_Ipw_Types.h, category=SWHDR
          short-label=include::LinTrcv_43_AE_Types.h, category=SWHDR
          short-label=src::AeLinPhy_LinTrcv_Ip.c, category=SWSRC
          short-label=src::LinTrcv_43_AE.c, category=SWSRC
          short-label=src::LinTrcv_43_AE_Ipw.c, category=SWSRC
    4 x compiler:
      DIAB_Compiler:
        name=Windriver Diab
        options=-tARMCORTEXM7MG:simple -mthumb -std=c99 -Oz -g -fstandalone-debug -Wstrict-prototypes -Wsign-compare -Wdouble-promotion -Wunknown-pragmas -Wundef -Wextra -Wall -pedantic -Werror=implicit-function-declaration -fno-common -fno-signed-char -fno-trigraphs -V -c -DS32K3XX -D $ (DERIVATIVE) -DDIAB -DUSE_SW_VECTOR_MODE -DD_CACHE_ENABLE -DI_CACHE_ENABLE -DENABLE_FPU -DMCAL_ENABLE_USER_MODE_SUPPORT
        vendor=Windriver
        version=Wind River Diab Compiler v7.0.4
      GCC_Compiler:
        name=GCC Compiler
        options=-mcpu=cortex-m7 -mthumb -mlittle-endian -mfpu=fpv5-sp-d16 -mfloat-abi=hard -std=c99 -Os -ggdb3 -Wall -Wextra -pedantic -Wstrict-prototypes -Wundef -Wunused -Werror=implicit-function-declaration -Wsign-compare -Wdouble-promotion -fno-short-enums -funsigned-char -funsigned-bitfields -fno-common -fstack-usage -fdump-ipa-all -c -DS32K3XX -D $ (DERIVATIVE) -DGCC -DUSE_SW_VECTOR_MODE -DD_CACHE_ENABLE -DI_CACHE_ENABLE -DENABLE_FPU -DMCAL_ENABLE_USER_MODE_SUPPORT --sysroot=$(NEWLIB_DIR) -specs=nano.specs -specs=nosys.specs
        vendor=GCC Systems
        version=NXP GCC 10.2.0 20200723
      GHS_Compiler:
        name=Green Hills
        options=-cpu=cortexm7 -thumb -fpu=vfpv5_d16 -fsingle -C99 --ghstd=last -Osize --gnu_asm -dual_debug -G -keeptempfiles -Wimplicit-int -Wshadow -Wtrigraphs -Wundef --unsigned_chars --unsigned_fields --no_commons --no_exceptions --no_slash_comment --prototype_errors --incorrect_pragma_warnings -c -DS32K3XX -D $ (DERIVATIVE) -DGHS -DUSE_SW_VECTOR_MODE -DD_CACHE_ENABLE -DI_CACHE_ENABLE -DENABLE_FPU -DMCAL_ENABLE_USER_MODE_SUPPORT
        vendor=Green Hills
        version=Green Hills Multi 7.1.6d / Compiler 2021.1.4
      IAR_Compiler:
        name=IAR Compiler
        options=--cpu Cortex-M7 --cpu_mode thumb --endian little --fpu VFPv5-SP -e -Ohz --debug --no_clustering --no_mem_idioms --do_explicit_zero_opt_in_named_sections --require_prototypes --no_wrap_diagnostics --diag_suppress Pa050 -DS32K3XX -D $ (DERIVATIVE) -DIAR -DUSE_SW_VECTOR_MODE -DD_CACHE_ENABLE -DI_CACHE_ENABLE -DENABLE_FPU -DMCAL_ENABLE_USER_MODE_SUPPORT
        vendor=IAR Systems
        version=IAR ANSI C/C++ Compiler v.8.50.10 (safety version)
    generated-artifacts:
      6 x dependency on artifact, all with usages=COMPILE:
        AeLinPhy_LinTrcv_Ip_Cfg_h: artifact-descriptor={short-label=generate::include::AeLinPhy_LinTrcv_Ip_Cfg.h, category=SWHDR}
        LinTrcv_43_AE_Cfg_h: artifact-descriptor={short-label=generate::include::LinTrcv_43_AE_Cfg.h, category=SWHDR}
        LinTrcv_43_AE_Ipw_Cfg_h: artifact-descriptor={short-label=generate::include::LinTrcv_43_AE_Ipw_Cfg.h, category=SWHDR}
        AeLinPhy_LinTrcv_Ip_Cfg_c: artifact-descriptor={short-label=generate::src::AeLinPhy_LinTrcv_Ip_Cfg.c, category=SWSRC}
        LinTrcv_43_AE_Cfg_c: artifact-descriptor={short-label=generate::src::LinTrcv_43_AE_Cfg.c, category=SWSRC}
        LinTrcv_43_AE_Ipw_Cfg_c: artifact-descriptor={short-label=generate::src::LinTrcv_43_AE_Ipw_Cfg.c, category=SWSRC}
    4 x linker:
      DIAB_Linker: name=Windriver Diab, options=-e Reset_Handler linker_script_file.dld -m30 -Xstack-usage -Xpreprocess-lecl -Llibrary_path -lc -lm -tARMCORTEXM7MG:simple, vendor=Windriver, version=Wind River Diab Compiler v7.0.4
      GCC_Linker: name=GCC Compiler, options=-Wl,-Map,filename -T linkerfile --entry=Reset_Handler -nostartfiles -mcpu=cortexm7 -mthumb -mfpu=fpv5-sp-d16 -mfloat-abi=hard -mlittle-endian -ggdb3 -lc -lm -lgcc -specs=nano.specs -specs=nosys.specs, vendor=GCC Systems, version=NXP GCC 10.2.0 20200723
      GHS_Linker: name=Green Hills, options=-e Reset_Handler -T linker_script_file.ld -map -keepmap -Mn -delete -ignore_debug_references -Llibrary_path -larch -lstartup -lind_sd -v -keep=C40_Ip_AccessCode -nostartfiles, vendor=Green Hills, version=Green Hills Multi 7.1.6d / Compiler 2021.1.4
      IAR_Linker: name=IAR Compiler, options=--map filename --config linkerfile --cpu=Cortex-M7 --fpu VFPv5-SP --entry _start --enable_stack_usage --skip_dynamic_initialization --no_wrap_diagnostics, vendor=IAR Systems, version=IAR ANSI C/C++ Compiler v.8.50.10 (safety version)
    resource consumption ResourceConsumption
      6 x memory section:
        LINTRCV_43_AE_CODE: alignment=UNSPECIFIED, sw-addrmethod=CODE, symbol=CODE
        LINTRCV_43_AE_CONFIG_DATA_UNSPECIFIED: alignment=UNSPECIFIED, sw-addrmethod=CONFIG_DATA, symbol=CONFIG_DATA_UNSPECIFIED
        LINTRCV_43_AE_CONST_UNSPECIFIED: alignment=UNSPECIFIED, sw-addrmethod=CONST, symbol=CONST_UNSPECIFIED
        LINTRCV_43_AE_VAR_CLEARED_8: alignment=8, sw-addrmethod=VAR_CLEARED, symbol=VAR_CLEARED_8
        LINTRCV_43_AE_VAR_CLEARED_UNSPECIFIED: alignment=UNSPECIFIED, sw-addrmethod=VAR_CLEARED, symbol=VAR_CLEARED_UNSPECIFIED
        LINTRCV_43_AE_VAR_INIT_8: alignment=8, sw-addrmethod=VAR_INIT, symbol=VAR_INIT_8
