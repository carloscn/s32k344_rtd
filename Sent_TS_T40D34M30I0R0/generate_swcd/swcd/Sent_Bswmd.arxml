AUTOSAR XML (schema 00050)
package /AUTOSAR_Sent/BswModuleDescriptions
  bsw module description Sent: module-id=125
    provided-entrys:
      Sent_DeInit
      Sent_GetFastChannelMsgData
      Sent_GetFastMsgData
      Sent_GetSerialChannelMsgData
      Sent_GetSerialMsgData
      Sent_GetVersionInfo
      Sent_Init
      Sent_StartChannelReceiving
      Sent_StopChannelReceiving
    bsw internal behavior InternalBehavior_0
      9 x bsw called entity:
        Sent_DeInit: implemented-entry=Sent_DeInit
        Sent_GetFastChannelMsgData: implemented-entry=Sent_GetFastChannelMsgData
        Sent_GetFastMsgData: implemented-entry=Sent_GetFastMsgData
        Sent_GetSerialChannelMsgData: implemented-entry=Sent_GetSerialChannelMsgData
        Sent_GetSerialMsgData: implemented-entry=Sent_GetSerialMsgData
        Sent_GetVersionInfo: implemented-entry=Sent_GetVersionInfo
        Sent_Init: implemented-entry=Sent_Init
        Sent_StartChannelReceiving: implemented-entry=Sent_StartChannelReceiving
        Sent_StopChannelReceiving: implemented-entry=Sent_StopChannelReceiving
package /AUTOSAR_Sent/BswModuleEntrys
  9 x bsw module entry, all with is-synchronous=true, call-type=REGULAR, execution-context=UNSPECIFIED, sw-service-impl-policy=STANDARD:
    Sent_DeInit: service-id=0x01, is-reentrant=false
    Sent_GetFastChannelMsgData: service-id=0x03, is-reentrant=false
    Sent_GetFastMsgData: service-id=0x05, is-reentrant=false
    Sent_GetSerialChannelMsgData: service-id=0x04, is-reentrant=false
    Sent_GetSerialMsgData: service-id=0x06, is-reentrant=false
    Sent_GetVersionInfo: service-id=0x09, is-reentrant=true
    Sent_Init: service-id=0x02, is-reentrant=false
    Sent_StartChannelReceiving: service-id=0x07, is-reentrant=true
    Sent_StopChannelReceiving: service-id=0x08, is-reentrant=true
package /Sent_TS_T40D34M30I0R0/Implementations
  bsw implementation BswImplementation_0: programming-language=C, sw-version=3.0.0, vendor-id=43, ar-release-version=4.7.0, behavior=InternalBehavior_0, vendor-specific-module-def=Sent
    code-descriptors:
      code Files
        artifact-descriptors:
          short-label=config::Sent.xdm, category=SWCFG
          short-label=doc::RTD_SENT_IM.pdf, category=SWDOC
          short-label=doc::RTD_SENT_UM.pdf, category=SWDOC
          short-label=examples::EBT::S32K358::Sent_Receiver_S32K358::generate::epc::BaseNXP.xdm, category=SWCFG
          short-label=examples::EBT::S32K358::Sent_Receiver_S32K358::generate::epc::EcuC.xdm, category=SWCFG
          short-label=examples::EBT::S32K358::Sent_Receiver_S32K358::generate::epc::Mcl.xdm, category=SWCFG
          short-label=examples::EBT::S32K358::Sent_Receiver_S32K358::generate::epc::Mcu.xdm, category=SWCFG
          short-label=examples::EBT::S32K358::Sent_Receiver_S32K358::generate::epc::Os.xdm, category=SWCFG
          short-label=examples::EBT::S32K358::Sent_Receiver_S32K358::generate::epc::Platform.xdm, category=SWCFG
          short-label=examples::EBT::S32K358::Sent_Receiver_S32K358::generate::epc::Port.xdm, category=SWCFG
          short-label=examples::EBT::S32K358::Sent_Receiver_S32K358::generate::epc::Resource.xdm, category=SWCFG
          short-label=examples::EBT::S32K358::Sent_Receiver_S32K358::generate::epc::Sent.xdm, category=SWCFG
          short-label=examples::EBT::S32K358::Sent_Receiver_S32K358::include::check_example.h, category=SWHDR
          short-label=examples::EBT::S32K358::Sent_Receiver_S32K358::src::main.c, category=SWSRC
          short-label=examples::EBT::S32K358::Sent_Receiver_S32K358::TresosProject::Sent_Receiver_S32K358::.prefs::preferences.xdm, category=SWCFG
          short-label=examples::EBT::S32K358::Sent_Receiver_S32K358::TresosProject::Sent_Receiver_S32K358::config::BaseNXP.xdm, category=SWCFG
          short-label=examples::EBT::S32K358::Sent_Receiver_S32K358::TresosProject::Sent_Receiver_S32K358::config::EcuC.xdm, category=SWCFG
          short-label=examples::EBT::S32K358::Sent_Receiver_S32K358::TresosProject::Sent_Receiver_S32K358::config::Mcl.xdm, category=SWCFG
          short-label=examples::EBT::S32K358::Sent_Receiver_S32K358::TresosProject::Sent_Receiver_S32K358::config::Mcu.xdm, category=SWCFG
          short-label=examples::EBT::S32K358::Sent_Receiver_S32K358::TresosProject::Sent_Receiver_S32K358::config::Os.xdm, category=SWCFG
          short-label=examples::EBT::S32K358::Sent_Receiver_S32K358::TresosProject::Sent_Receiver_S32K358::config::Platform.xdm, category=SWCFG
          short-label=examples::EBT::S32K358::Sent_Receiver_S32K358::TresosProject::Sent_Receiver_S32K358::config::Port.xdm, category=SWCFG
          short-label=examples::EBT::S32K358::Sent_Receiver_S32K358::TresosProject::Sent_Receiver_S32K358::config::Resource.xdm, category=SWCFG
          short-label=examples::EBT::S32K358::Sent_Receiver_S32K358::TresosProject::Sent_Receiver_S32K358::config::Sent.xdm, category=SWCFG
          short-label=examples::EBT::S32K396::Sent_Receiver_S32K396::generate::epc::BaseNXP.xdm, category=SWCFG
          short-label=examples::EBT::S32K396::Sent_Receiver_S32K396::generate::epc::EcuC.xdm, category=SWCFG
          short-label=examples::EBT::S32K396::Sent_Receiver_S32K396::generate::epc::Mcl.xdm, category=SWCFG
          short-label=examples::EBT::S32K396::Sent_Receiver_S32K396::generate::epc::Mcu.xdm, category=SWCFG
          short-label=examples::EBT::S32K396::Sent_Receiver_S32K396::generate::epc::Os.xdm, category=SWCFG
          short-label=examples::EBT::S32K396::Sent_Receiver_S32K396::generate::epc::Platform.xdm, category=SWCFG
          short-label=examples::EBT::S32K396::Sent_Receiver_S32K396::generate::epc::Port.xdm, category=SWCFG
          short-label=examples::EBT::S32K396::Sent_Receiver_S32K396::generate::epc::Resource.xdm, category=SWCFG
          short-label=examples::EBT::S32K396::Sent_Receiver_S32K396::generate::epc::Sent.xdm, category=SWCFG
          short-label=examples::EBT::S32K396::Sent_Receiver_S32K396::include::check_example.h, category=SWHDR
          short-label=examples::EBT::S32K396::Sent_Receiver_S32K396::src::main.c, category=SWSRC
          short-label=examples::EBT::S32K396::Sent_Receiver_S32K396::TresosProject::Sent_Receiver_S32K396::.prefs::preferences.xdm, category=SWCFG
          short-label=examples::EBT::S32K396::Sent_Receiver_S32K396::TresosProject::Sent_Receiver_S32K396::config::BaseNXP.xdm, category=SWCFG
          short-label=examples::EBT::S32K396::Sent_Receiver_S32K396::TresosProject::Sent_Receiver_S32K396::config::EcuC.xdm, category=SWCFG
          short-label=examples::EBT::S32K396::Sent_Receiver_S32K396::TresosProject::Sent_Receiver_S32K396::config::Mcl.xdm, category=SWCFG
          short-label=examples::EBT::S32K396::Sent_Receiver_S32K396::TresosProject::Sent_Receiver_S32K396::config::Mcu.xdm, category=SWCFG
          short-label=examples::EBT::S32K396::Sent_Receiver_S32K396::TresosProject::Sent_Receiver_S32K396::config::Os.xdm, category=SWCFG
          short-label=examples::EBT::S32K396::Sent_Receiver_S32K396::TresosProject::Sent_Receiver_S32K396::config::Platform.xdm, category=SWCFG
          short-label=examples::EBT::S32K396::Sent_Receiver_S32K396::TresosProject::Sent_Receiver_S32K396::config::Port.xdm, category=SWCFG
          short-label=examples::EBT::S32K396::Sent_Receiver_S32K396::TresosProject::Sent_Receiver_S32K396::config::Resource.xdm, category=SWCFG
          short-label=examples::EBT::S32K396::Sent_Receiver_S32K396::TresosProject::Sent_Receiver_S32K396::config::Sent.xdm, category=SWCFG
          short-label=examples::EBT::S32K3XX::Sent_Receiver_S32K344::generate::epc::BaseNXP.xdm, category=SWCFG
          short-label=examples::EBT::S32K3XX::Sent_Receiver_S32K344::generate::epc::EcuC.xdm, category=SWCFG
          short-label=examples::EBT::S32K3XX::Sent_Receiver_S32K344::generate::epc::Mcl.xdm, category=SWCFG
          short-label=examples::EBT::S32K3XX::Sent_Receiver_S32K344::generate::epc::Mcu.xdm, category=SWCFG
          short-label=examples::EBT::S32K3XX::Sent_Receiver_S32K344::generate::epc::Os.xdm, category=SWCFG
          short-label=examples::EBT::S32K3XX::Sent_Receiver_S32K344::generate::epc::Platform.xdm, category=SWCFG
          short-label=examples::EBT::S32K3XX::Sent_Receiver_S32K344::generate::epc::Port.xdm, category=SWCFG
          short-label=examples::EBT::S32K3XX::Sent_Receiver_S32K344::generate::epc::Resource.xdm, category=SWCFG
          short-label=examples::EBT::S32K3XX::Sent_Receiver_S32K344::generate::epc::Sent.xdm, category=SWCFG
          short-label=examples::EBT::S32K3XX::Sent_Receiver_S32K344::include::check_example.h, category=SWHDR
          short-label=examples::EBT::S32K3XX::Sent_Receiver_S32K344::src::main.c, category=SWSRC
          short-label=examples::EBT::S32K3XX::Sent_Receiver_S32K344::TresosProject::Sent_Receiver_S32K344::.prefs::preferences.xdm, category=SWCFG
          short-label=examples::EBT::S32K3XX::Sent_Receiver_S32K344::TresosProject::Sent_Receiver_S32K344::config::BaseNXP.xdm, category=SWCFG
          short-label=examples::EBT::S32K3XX::Sent_Receiver_S32K344::TresosProject::Sent_Receiver_S32K344::config::EcuC.xdm, category=SWCFG
          short-label=examples::EBT::S32K3XX::Sent_Receiver_S32K344::TresosProject::Sent_Receiver_S32K344::config::Mcl.xdm, category=SWCFG
          short-label=examples::EBT::S32K3XX::Sent_Receiver_S32K344::TresosProject::Sent_Receiver_S32K344::config::Mcu.xdm, category=SWCFG
          short-label=examples::EBT::S32K3XX::Sent_Receiver_S32K344::TresosProject::Sent_Receiver_S32K344::config::Os.xdm, category=SWCFG
          short-label=examples::EBT::S32K3XX::Sent_Receiver_S32K344::TresosProject::Sent_Receiver_S32K344::config::Platform.xdm, category=SWCFG
          short-label=examples::EBT::S32K3XX::Sent_Receiver_S32K344::TresosProject::Sent_Receiver_S32K344::config::Port.xdm, category=SWCFG
          short-label=examples::EBT::S32K3XX::Sent_Receiver_S32K344::TresosProject::Sent_Receiver_S32K344::config::Resource.xdm, category=SWCFG
          short-label=examples::EBT::S32K3XX::Sent_Receiver_S32K344::TresosProject::Sent_Receiver_S32K344::config::Sent.xdm, category=SWCFG
          short-label=examples::EBT::S32M276::Sent_Receiver_S32M276::generate::epc::BaseNXP.xdm, category=SWCFG
          short-label=examples::EBT::S32M276::Sent_Receiver_S32M276::generate::epc::EcuC.xdm, category=SWCFG
          short-label=examples::EBT::S32M276::Sent_Receiver_S32M276::generate::epc::Mcl.xdm, category=SWCFG
          short-label=examples::EBT::S32M276::Sent_Receiver_S32M276::generate::epc::Mcu.xdm, category=SWCFG
          short-label=examples::EBT::S32M276::Sent_Receiver_S32M276::generate::epc::Os.xdm, category=SWCFG
          short-label=examples::EBT::S32M276::Sent_Receiver_S32M276::generate::epc::Platform.xdm, category=SWCFG
          short-label=examples::EBT::S32M276::Sent_Receiver_S32M276::generate::epc::Port.xdm, category=SWCFG
          short-label=examples::EBT::S32M276::Sent_Receiver_S32M276::generate::epc::Resource.xdm, category=SWCFG
          short-label=examples::EBT::S32M276::Sent_Receiver_S32M276::generate::epc::Sent.xdm, category=SWCFG
          short-label=examples::EBT::S32M276::Sent_Receiver_S32M276::include::check_example.h, category=SWHDR
          short-label=examples::EBT::S32M276::Sent_Receiver_S32M276::src::main.c, category=SWSRC
          short-label=examples::EBT::S32M276::Sent_Receiver_S32M276::TresosProject::Sent_Receiver_S32M276::.prefs::preferences.xdm, category=SWCFG
          short-label=examples::EBT::S32M276::Sent_Receiver_S32M276::TresosProject::Sent_Receiver_S32M276::config::BaseNXP.xdm, category=SWCFG
          short-label=examples::EBT::S32M276::Sent_Receiver_S32M276::TresosProject::Sent_Receiver_S32M276::config::EcuC.xdm, category=SWCFG
          short-label=examples::EBT::S32M276::Sent_Receiver_S32M276::TresosProject::Sent_Receiver_S32M276::config::Mcl.xdm, category=SWCFG
          short-label=examples::EBT::S32M276::Sent_Receiver_S32M276::TresosProject::Sent_Receiver_S32M276::config::Mcu.xdm, category=SWCFG
          short-label=examples::EBT::S32M276::Sent_Receiver_S32M276::TresosProject::Sent_Receiver_S32M276::config::Os.xdm, category=SWCFG
          short-label=examples::EBT::S32M276::Sent_Receiver_S32M276::TresosProject::Sent_Receiver_S32M276::config::Platform.xdm, category=SWCFG
          short-label=examples::EBT::S32M276::Sent_Receiver_S32M276::TresosProject::Sent_Receiver_S32M276::config::Port.xdm, category=SWCFG
          short-label=examples::EBT::S32M276::Sent_Receiver_S32M276::TresosProject::Sent_Receiver_S32M276::config::Resource.xdm, category=SWCFG
          short-label=examples::EBT::S32M276::Sent_Receiver_S32M276::TresosProject::Sent_Receiver_S32M276::config::Sent.xdm, category=SWCFG
          short-label=examples::S32DS::S32K358::Sent_Receiver_S32K358::include::check_example.h, category=SWHDR
          short-label=examples::S32DS::S32K358::Sent_Receiver_S32K358::Project_Settings::Startup_Code::exceptions.c, category=SWSRC
          short-label=examples::S32DS::S32K358::Sent_Receiver_S32K358::Project_Settings::Startup_Code::nvic.c, category=SWSRC
          short-label=examples::S32DS::S32K358::Sent_Receiver_S32K358::Project_Settings::Startup_Code::startup.c, category=SWSRC
          short-label=examples::S32DS::S32K358::Sent_Receiver_S32K358::Project_Settings::Startup_Code::system.c, category=SWSRC
          short-label=examples::S32DS::S32K358::Sent_Receiver_S32K358::src::main.c, category=SWSRC
          short-label=examples::S32DS::S32K396::Sent_Receiver_S32K396::include::check_example.h, category=SWHDR
          short-label=examples::S32DS::S32K396::Sent_Receiver_S32K396::Project_Settings::Startup_Code::exceptions.c, category=SWSRC
          short-label=examples::S32DS::S32K396::Sent_Receiver_S32K396::Project_Settings::Startup_Code::nvic.c, category=SWSRC
          short-label=examples::S32DS::S32K396::Sent_Receiver_S32K396::Project_Settings::Startup_Code::startup.c, category=SWSRC
          short-label=examples::S32DS::S32K396::Sent_Receiver_S32K396::Project_Settings::Startup_Code::system.c, category=SWSRC
          short-label=examples::S32DS::S32K396::Sent_Receiver_S32K396::src::main.c, category=SWSRC
          short-label=examples::S32DS::S32K3XX::Sent_Receiver_S32K344::include::check_example.h, category=SWHDR
          short-label=examples::S32DS::S32K3XX::Sent_Receiver_S32K344::Project_Settings::Startup_Code::exceptions.c, category=SWSRC
          short-label=examples::S32DS::S32K3XX::Sent_Receiver_S32K344::Project_Settings::Startup_Code::nvic.c, category=SWSRC
          short-label=examples::S32DS::S32K3XX::Sent_Receiver_S32K344::Project_Settings::Startup_Code::startup.c, category=SWSRC
          short-label=examples::S32DS::S32K3XX::Sent_Receiver_S32K344::Project_Settings::Startup_Code::system.c, category=SWSRC
          short-label=examples::S32DS::S32K3XX::Sent_Receiver_S32K344::src::main.c, category=SWSRC
          short-label=include::CDD_Sent.h, category=SWHDR
          short-label=include::Flexio_Sent_Ip.h, category=SWHDR
          short-label=include::Flexio_Sent_Ip_HwAccess.h, category=SWHDR
          short-label=include::Flexio_Sent_Ip_Irq.h, category=SWHDR
          short-label=include::Flexio_Sent_Ip_Types.h, category=SWHDR
          short-label=include::Sent_Ipw.h, category=SWHDR
          short-label=include::Sent_Ipw_Types.h, category=SWHDR
          short-label=include::Sent_Types.h, category=SWHDR
          short-label=src::CDD_Sent.c, category=SWSRC
          short-label=src::Flexio_Sent_Ip.c, category=SWSRC
          short-label=src::Flexio_Sent_Ip_Irq.c, category=SWSRC
          short-label=src::Sent_Ipw.c, category=SWSRC
    4 x compiler:
      DIAB_Compiler:
        name=Windriver Diab
        options=-tARMCORTEXM7MG:simple -mthumb -std=c99 -Oz -g -fstandalone-debug -Wstrict-prototypes -Wsign-compare -Wdouble-promotion -Wunknown-pragmas -Wundef -Wextra -Wall -pedantic -Werror=implicit-function-declaration -fno-common -fno-signed-char -fno-trigraphs -V -c -DS32K3XX -D $ (DERIVATIVE) -DDIAB -DUSE_SW_VECTOR_MODE -DD_CACHE_ENABLE -DI_CACHE_ENABLE -DENABLE_FPU -DMCAL_ENABLE_USER_MODE_SUPPORT
        vendor=Windriver
        version=Wind River Diab Compiler v7.0.4
      GCC_Compiler:
        name=GCC Compiler
        options=-mcpu=cortex-m7 -mthumb -mlittle-endian -mfpu=fpv5-sp-d16 -mfloat-abi=hard -std=c99 -Os -ggdb3 -Wall -Wextra -pedantic -Wstrict-prototypes -Wundef -Wunused -Werror=implicit-function-declaration -Wsign-compare -Wdouble-promotion -fno-short-enums -funsigned-char -funsigned-bitfields -fno-common -fstack-usage -fdump-ipa-all -c -DS32K3XX -D $ (DERIVATIVE) -DGCC -DUSE_SW_VECTOR_MODE -DD_CACHE_ENABLE -DI_CACHE_ENABLE -DENABLE_FPU -DMCAL_ENABLE_USER_MODE_SUPPORT --sysroot=$(NEWLIB_DIR) -specs=nano.specs -specs=nosys.specs
        vendor=GCC Systems
        version=NXP GCC 10.2.0 20200723
      GHS_Compiler:
        name=Green Hills
        options=-cpu=cortexm7 -thumb -fpu=vfpv5_d16 -fsingle -C99 --ghstd=last -Osize --gnu_asm -dual_debug -G -keeptempfiles -Wimplicit-int -Wshadow -Wtrigraphs -Wundef --unsigned_chars --unsigned_fields --no_commons --no_exceptions --no_slash_comment --prototype_errors --incorrect_pragma_warnings -c -DS32K3XX -D $ (DERIVATIVE) -DGHS -DUSE_SW_VECTOR_MODE -DD_CACHE_ENABLE -DI_CACHE_ENABLE -DENABLE_FPU -DMCAL_ENABLE_USER_MODE_SUPPORT
        vendor=Green Hills
        version=Green Hills Multi 7.1.6d / Compiler 2021.1.4
      IAR_Compiler:
        name=IAR Compiler
        options=--cpu Cortex-M7 --cpu_mode thumb --endian little --fpu VFPv5-SP -e -Ohz --debug --no_clustering --no_mem_idioms --do_explicit_zero_opt_in_named_sections --require_prototypes --no_wrap_diagnostics --diag_suppress Pa050 -DS32K3XX -D $ (DERIVATIVE) -DIAR -DUSE_SW_VECTOR_MODE -DD_CACHE_ENABLE -DI_CACHE_ENABLE -DENABLE_FPU -DMCAL_ENABLE_USER_MODE_SUPPORT
        vendor=IAR Systems
        version=IAR ANSI C/C++ Compiler v.8.50.10 (safety version)
    generated-artifacts:
      13 x dependency on artifact:
        Flexio_Sent_Ip_PBcfg_h: artifact-descriptor={short-label=generate_PB::include::Flexio_Sent_Ip_PBcfg.h, category=SWHDR}, usages=EXECUTE
        Sent_Ipw_PBcfg_h: artifact-descriptor={short-label=generate_PB::include::Sent_Ipw_PBcfg.h, category=SWHDR}, usages=EXECUTE
        Sent_PBcfg_h: artifact-descriptor={short-label=generate_PB::include::Sent_PBcfg.h, category=SWHDR}, usages=EXECUTE
        Flexio_Sent_Ip_PBcfg_c: artifact-descriptor={short-label=generate_PB::src::Flexio_Sent_Ip_PBcfg.c, category=SWSRC}, usages=EXECUTE
        Sent_Ipw_PBcfg_c: artifact-descriptor={short-label=generate_PB::src::Sent_Ipw_PBcfg.c, category=SWSRC}, usages=EXECUTE
        Sent_PBcfg_c: artifact-descriptor={short-label=generate_PB::src::Sent_PBcfg.c, category=SWSRC}, usages=EXECUTE
        Flexio_Sent_Ip_Cfg_h: artifact-descriptor={short-label=generate_PC::include::Flexio_Sent_Ip_Cfg.h, category=SWHDR}, usages=COMPILE
        Flexio_Sent_Ip_CfgDefines_h: artifact-descriptor={short-label=generate_PC::include::Flexio_Sent_Ip_CfgDefines.h, category=SWHDR}, usages=COMPILE
        Flexio_Sent_Ip_Defines_h: artifact-descriptor={short-label=generate_PC::include::Flexio_Sent_Ip_Defines.h, category=SWHDR}, usages=COMPILE
        Sent_Cfg_h: artifact-descriptor={short-label=generate_PC::include::Sent_Cfg.h, category=SWHDR}, usages=COMPILE
        Sent_Ipw_Cfg_h: artifact-descriptor={short-label=generate_PC::include::Sent_Ipw_Cfg.h, category=SWHDR}, usages=COMPILE
        Flexio_Sent_Ip_Cfg_c: artifact-descriptor={short-label=generate_PC::src::Flexio_Sent_Ip_Cfg.c, category=SWSRC}, usages=COMPILE
        Sent_Ipw_Cfg_c: artifact-descriptor={short-label=generate_PC::src::Sent_Ipw_Cfg.c, category=SWSRC}, usages=COMPILE
    4 x linker:
      DIAB_Linker: name=Windriver Diab, options=-e Reset_Handler linker_script_file.dld -m30 -Xstack-usage -Xpreprocess-lecl -Llibrary_path -lc -lm -tARMCORTEXM7MG:simple, vendor=Windriver, version=Wind River Diab Compiler v7.0.4
      GCC_Linker: name=GCC Compiler, options=-Wl,-Map,filename -T linkerfile --entry=Reset_Handler -nostartfiles -mcpu=cortexm7 -mthumb -mfpu=fpv5-sp-d16 -mfloat-abi=hard -mlittle-endian -ggdb3 -lc -lm -lgcc -specs=nano.specs -specs=nosys.specs, vendor=GCC Systems, version=NXP GCC 10.2.0 20200723
      GHS_Linker: name=Green Hills, options=-e Reset_Handler -T linker_script_file.ld -map -keepmap -Mn -delete -ignore_debug_references -Llibrary_path -larch -lstartup -lind_sd -v -keep=C40_Ip_AccessCode -nostartfiles, vendor=Green Hills, version=Green Hills Multi 7.1.6d / Compiler 2021.1.4
      IAR_Linker: name=IAR Compiler, options=--map filename --config linkerfile --cpu=Cortex-M7 --fpu VFPv5-SP --entry _start --enable_stack_usage --skip_dynamic_initialization --no_wrap_diagnostics, vendor=IAR Systems, version=IAR ANSI C/C++ Compiler v.8.50.10 (safety version)
    resource consumption ResourceConsumption
      11 x memory section:
        SENT_CODE: alignment=UNSPECIFIED, sw-addrmethod=CODE, symbol=CODE
        SENT_CONFIG_DATA_UNSPECIFIED: alignment=UNSPECIFIED, sw-addrmethod=CONFIG_DATA, symbol=CONFIG_DATA_UNSPECIFIED
        SENT_CONST_UNSPECIFIED: alignment=UNSPECIFIED, sw-addrmethod=CONST, symbol=CONST_UNSPECIFIED
        SENT_VAR_CLEARED_32: alignment=32, sw-addrmethod=VAR_CLEARED, symbol=VAR_CLEARED_32
        SENT_VAR_CLEARED_32_NO_CACHEABLE: alignment=32, sw-addrmethod=VAR_CLEARED_NO_CACHEABLE, symbol=VAR_CLEARED_32_NO_CACHEABLE
        SENT_VAR_CLEARED_8: alignment=8, sw-addrmethod=VAR_CLEARED, symbol=VAR_CLEARED_8
        SENT_VAR_CLEARED_BOOLEAN: alignment=BOOLEAN, sw-addrmethod=VAR_CLEARED, symbol=VAR_CLEARED_BOOLEAN
        SENT_VAR_CLEARED_UNSPECIFIED: alignment=UNSPECIFIED, sw-addrmethod=VAR_CLEARED, symbol=VAR_CLEARED_UNSPECIFIED
        SENT_VAR_CLEARED_UNSPECIFIED_NO_CACHEABLE: alignment=UNSPECIFIED, sw-addrmethod=VAR_CLEARED_NO_CACHEABLE, symbol=VAR_CLEARED_UNSPECIFIED_NO_CACHEABLE
        SENT_VAR_INIT_8: alignment=8, sw-addrmethod=VAR_INIT, symbol=VAR_INIT_8
        SENT_VAR_INIT_UNSPECIFIED: alignment=UNSPECIFIED, sw-addrmethod=VAR_INIT, symbol=VAR_INIT_UNSPECIFIED
