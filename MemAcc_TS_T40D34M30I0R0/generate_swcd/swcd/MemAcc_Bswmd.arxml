AUTOSAR XML (schema 00050)
package /AUTOSAR_MemAcc/BswModuleDescriptions
  bsw module description MemAcc: module-id=41
    provided-entrys:
      MemAcc_ActivateMem
      MemAcc_BlankCheck
      MemAcc_Cancel
      MemAcc_Compare
      MemAcc_DeInit
      MemAcc_DeactivateMem
      MemAcc_Erase
      MemAcc_GetJobInfo
      MemAcc_GetJobResult
      MemAcc_GetJobStatus
      MemAcc_GetMemoryInfo
      MemAcc_GetProcessedLength
      MemAcc_GetVersionInfo
      MemAcc_HwSpecificService
      MemAcc_Init
      MemAcc_MainFunction
      MemAcc_Read
      MemAcc_ReleaseLock
      MemAcc_RequestLock
      MemAcc_Write
    bsw internal behavior InternalBehavior_0
      5 x exclusive area:
        MEMACC_EXCLUSIVE_AREA_{10..14}
      15 x bsw called entity:
        MemAcc_ActivateMem: implemented-entry=MemAcc_ActivateMem
        MemAcc_BlankCheck: can-enter-exclusive-area=MEMACC_EXCLUSIVE_AREA_14, implemented-entry=MemAcc_BlankCheck
        MemAcc_Cancel: implemented-entry=MemAcc_Cancel
        MemAcc_Compare: can-enter-exclusive-area=MEMACC_EXCLUSIVE_AREA_13, implemented-entry=MemAcc_Compare
        MemAcc_DeInit: implemented-entry=MemAcc_DeInit
        MemAcc_DeactivateMem: implemented-entry=MemAcc_DeactivateMem
        MemAcc_Erase: can-enter-exclusive-area=MEMACC_EXCLUSIVE_AREA_10, implemented-entry=MemAcc_Erase
        MemAcc_GetJobInfo: implemented-entry=MemAcc_GetJobInfo
        MemAcc_GetJobResult: implemented-entry=MemAcc_GetJobResult
        MemAcc_GetJobStatus: implemented-entry=MemAcc_GetJobStatus
        MemAcc_GetMemoryInfo: implemented-entry=MemAcc_GetMemoryInfo
        MemAcc_GetProcessedLength: implemented-entry=MemAcc_GetProcessedLength
        MemAcc_GetVersionInfo: implemented-entry=MemAcc_GetVersionInfo
        MemAcc_HwSpecificService: implemented-entry=MemAcc_HwSpecificService
        MemAcc_Init: implemented-entry=MemAcc_Init
      bsw schedulable entity MemAcc_MainFunction: implemented-entry=MemAcc_MainFunction
      4 x bsw called entity:
        MemAcc_Read: can-enter-exclusive-area=MEMACC_EXCLUSIVE_AREA_12, implemented-entry=MemAcc_Read
        MemAcc_ReleaseLock: implemented-entry=MemAcc_ReleaseLock
        MemAcc_RequestLock: implemented-entry=MemAcc_RequestLock
        MemAcc_Write: can-enter-exclusive-area=MEMACC_EXCLUSIVE_AREA_11, implemented-entry=MemAcc_Write
      bsw timing event MemAcc_TimingEvent_MainFunction: starts-on-event=MemAcc_MainFunction, period=0
package /AUTOSAR_MemAcc/BswModuleEntrys
  20 x bsw module entry, all with sw-service-impl-policy=STANDARD:
    MemAcc_ActivateMem: service-id=0x14, is-reentrant=true, is-synchronous=true, call-type=REGULAR, execution-context=UNSPECIFIED
    MemAcc_BlankCheck: service-id=0x0d, is-reentrant=true, is-synchronous=false, call-type=REGULAR, execution-context=UNSPECIFIED
    MemAcc_Cancel: service-id=0x04, is-reentrant=true, is-synchronous=false, call-type=REGULAR, execution-context=UNSPECIFIED
    MemAcc_Compare: service-id=0x0c, is-reentrant=true, is-synchronous=false, call-type=REGULAR, execution-context=UNSPECIFIED
    MemAcc_DeInit: service-id=0x01, is-reentrant=false, is-synchronous=true, call-type=REGULAR, execution-context=UNSPECIFIED
    MemAcc_DeactivateMem: service-id=0x15, is-reentrant=true, is-synchronous=true, call-type=REGULAR, execution-context=UNSPECIFIED
    MemAcc_Erase: service-id=0x0b, is-reentrant=true, is-synchronous=false, call-type=REGULAR, execution-context=UNSPECIFIED
    MemAcc_GetJobInfo: service-id=0x08, is-reentrant=true, is-synchronous=true, call-type=REGULAR, execution-context=UNSPECIFIED
    MemAcc_GetJobResult: service-id=0x05, is-reentrant=true, is-synchronous=true, call-type=REGULAR, execution-context=UNSPECIFIED
    MemAcc_GetJobStatus: service-id=0x05, is-reentrant=true, is-synchronous=true, call-type=REGULAR, execution-context=UNSPECIFIED
    MemAcc_GetMemoryInfo: service-id=0x06, is-reentrant=true, is-synchronous=true, call-type=REGULAR, execution-context=UNSPECIFIED
    MemAcc_GetProcessedLength: service-id=0x07, is-reentrant=true, is-synchronous=true, call-type=REGULAR, execution-context=UNSPECIFIED
    MemAcc_GetVersionInfo: service-id=0x02, is-reentrant=true, is-synchronous=true, call-type=REGULAR, execution-context=UNSPECIFIED
    MemAcc_HwSpecificService: service-id=0xe, is-reentrant=true, is-synchronous=false, call-type=REGULAR, execution-context=UNSPECIFIED
    MemAcc_Init: service-id=0x01, is-reentrant=false, is-synchronous=true, call-type=REGULAR, execution-context=UNSPECIFIED
    MemAcc_MainFunction: service-id=0x03, is-reentrant=false, is-synchronous=true, call-type=SCHEDULED, execution-context=TASK
    MemAcc_Read: service-id=0x09, is-reentrant=true, is-synchronous=false, call-type=REGULAR, execution-context=UNSPECIFIED
    MemAcc_ReleaseLock: service-id=0x12, is-reentrant=true, is-synchronous=true, call-type=REGULAR, execution-context=UNSPECIFIED
    MemAcc_RequestLock: service-id=0x11, is-reentrant=true, is-synchronous=false, call-type=REGULAR, execution-context=UNSPECIFIED
    MemAcc_Write: service-id=0x0a, is-reentrant=true, is-synchronous=false, call-type=REGULAR, execution-context=UNSPECIFIED
package /MemAcc_TS_T40D34M30I0R0/Implementations
  bsw implementation BswImplementation_0: programming-language=C, sw-version=3.0.0, vendor-id=43, ar-release-version=4.7.0, behavior=InternalBehavior_0, vendor-specific-module-def=MemAcc
    code-descriptors:
      code Files
        artifact-descriptors:
          short-label=config::MemAcc.xdm, category=SWCFG
          short-label=doc::RTD_MEMACC_IM.pdf, category=SWDOC
          short-label=doc::RTD_MEMACC_UM.pdf, category=SWDOC
          short-label=examples::EBT::S32K358::MemAcc_Example_S32K358::generate::epc::BaseNXP.xdm, category=SWCFG
          short-label=examples::EBT::S32K358::MemAcc_Example_S32K358::generate::epc::EcuC.xdm, category=SWCFG
          short-label=examples::EBT::S32K358::MemAcc_Example_S32K358::generate::epc::MemAcc.xdm, category=SWCFG
          short-label=examples::EBT::S32K358::MemAcc_Example_S32K358::generate::epc::Mem_43_ExFls.xdm, category=SWCFG
          short-label=examples::EBT::S32K358::MemAcc_Example_S32K358::generate::epc::Resource.xdm, category=SWCFG
          short-label=examples::EBT::S32K358::MemAcc_Example_S32K358::include::check_example.h, category=SWHDR
          short-label=examples::EBT::S32K358::MemAcc_Example_S32K358::src::main.c, category=SWSRC
          short-label=examples::EBT::S32K358::MemAcc_Example_S32K358::TresosProject::MemAcc_Example_S32K358::.prefs::preferences.xdm, category=SWCFG
          short-label=examples::EBT::S32K358::MemAcc_Example_S32K358::TresosProject::MemAcc_Example_S32K358::config::BaseNXP.xdm, category=SWCFG
          short-label=examples::EBT::S32K358::MemAcc_Example_S32K358::TresosProject::MemAcc_Example_S32K358::config::EcuC.xdm, category=SWCFG
          short-label=examples::EBT::S32K358::MemAcc_Example_S32K358::TresosProject::MemAcc_Example_S32K358::config::MemAcc.xdm, category=SWCFG
          short-label=examples::EBT::S32K358::MemAcc_Example_S32K358::TresosProject::MemAcc_Example_S32K358::config::Mem_43_ExFls.xdm, category=SWCFG
          short-label=examples::EBT::S32K358::MemAcc_Example_S32K358::TresosProject::MemAcc_Example_S32K358::config::Resource.xdm, category=SWCFG
          short-label=examples::EBT::S32K396::MemAcc_Example_S32K396::generate::epc::BaseNXP.xdm, category=SWCFG
          short-label=examples::EBT::S32K396::MemAcc_Example_S32K396::generate::epc::EcuC.xdm, category=SWCFG
          short-label=examples::EBT::S32K396::MemAcc_Example_S32K396::generate::epc::MemAcc.xdm, category=SWCFG
          short-label=examples::EBT::S32K396::MemAcc_Example_S32K396::generate::epc::Mem_43_ExFls.xdm, category=SWCFG
          short-label=examples::EBT::S32K396::MemAcc_Example_S32K396::generate::epc::Resource.xdm, category=SWCFG
          short-label=examples::EBT::S32K396::MemAcc_Example_S32K396::include::check_example.h, category=SWHDR
          short-label=examples::EBT::S32K396::MemAcc_Example_S32K396::src::main.c, category=SWSRC
          short-label=examples::EBT::S32K396::MemAcc_Example_S32K396::TresosProject::MemAcc_Example_S32K396::.prefs::preferences.xdm, category=SWCFG
          short-label=examples::EBT::S32K396::MemAcc_Example_S32K396::TresosProject::MemAcc_Example_S32K396::config::BaseNXP.xdm, category=SWCFG
          short-label=examples::EBT::S32K396::MemAcc_Example_S32K396::TresosProject::MemAcc_Example_S32K396::config::EcuC.xdm, category=SWCFG
          short-label=examples::EBT::S32K396::MemAcc_Example_S32K396::TresosProject::MemAcc_Example_S32K396::config::MemAcc.xdm, category=SWCFG
          short-label=examples::EBT::S32K396::MemAcc_Example_S32K396::TresosProject::MemAcc_Example_S32K396::config::Mem_43_ExFls.xdm, category=SWCFG
          short-label=examples::EBT::S32K396::MemAcc_Example_S32K396::TresosProject::MemAcc_Example_S32K396::config::Resource.xdm, category=SWCFG
          short-label=examples::EBT::S32K3XX::MemAcc_Example_S32K344::generate::epc::BaseNXP.xdm, category=SWCFG
          short-label=examples::EBT::S32K3XX::MemAcc_Example_S32K344::generate::epc::EcuC.xdm, category=SWCFG
          short-label=examples::EBT::S32K3XX::MemAcc_Example_S32K344::generate::epc::MemAcc.xdm, category=SWCFG
          short-label=examples::EBT::S32K3XX::MemAcc_Example_S32K344::generate::epc::Mem_43_ExFls.xdm, category=SWCFG
          short-label=examples::EBT::S32K3XX::MemAcc_Example_S32K344::generate::epc::Resource.xdm, category=SWCFG
          short-label=examples::EBT::S32K3XX::MemAcc_Example_S32K344::include::check_example.h, category=SWHDR
          short-label=examples::EBT::S32K3XX::MemAcc_Example_S32K344::src::main.c, category=SWSRC
          short-label=examples::EBT::S32K3XX::MemAcc_Example_S32K344::TresosProject::MemAcc_Example_S32K344::.prefs::preferences.xdm, category=SWCFG
          short-label=examples::EBT::S32K3XX::MemAcc_Example_S32K344::TresosProject::MemAcc_Example_S32K344::config::BaseNXP.xdm, category=SWCFG
          short-label=examples::EBT::S32K3XX::MemAcc_Example_S32K344::TresosProject::MemAcc_Example_S32K344::config::EcuC.xdm, category=SWCFG
          short-label=examples::EBT::S32K3XX::MemAcc_Example_S32K344::TresosProject::MemAcc_Example_S32K344::config::MemAcc.xdm, category=SWCFG
          short-label=examples::EBT::S32K3XX::MemAcc_Example_S32K344::TresosProject::MemAcc_Example_S32K344::config::Mem_43_ExFls.xdm, category=SWCFG
          short-label=examples::EBT::S32K3XX::MemAcc_Example_S32K344::TresosProject::MemAcc_Example_S32K344::config::Resource.xdm, category=SWCFG
          short-label=examples::S32DS::S32K358::MemAcc_Example_S32K358::include::check_example.h, category=SWHDR
          short-label=examples::S32DS::S32K358::MemAcc_Example_S32K358::Project_Settings::Startup_Code::exceptions.c, category=SWSRC
          short-label=examples::S32DS::S32K358::MemAcc_Example_S32K358::Project_Settings::Startup_Code::nvic.c, category=SWSRC
          short-label=examples::S32DS::S32K358::MemAcc_Example_S32K358::Project_Settings::Startup_Code::startup.c, category=SWSRC
          short-label=examples::S32DS::S32K358::MemAcc_Example_S32K358::Project_Settings::Startup_Code::system.c, category=SWSRC
          short-label=examples::S32DS::S32K358::MemAcc_Example_S32K358::src::main.c, category=SWSRC
          short-label=examples::S32DS::S32K396::MemAcc_Example_S32K396::include::check_example.h, category=SWHDR
          short-label=examples::S32DS::S32K396::MemAcc_Example_S32K396::Project_Settings::Startup_Code::exceptions.c, category=SWSRC
          short-label=examples::S32DS::S32K396::MemAcc_Example_S32K396::Project_Settings::Startup_Code::nvic.c, category=SWSRC
          short-label=examples::S32DS::S32K396::MemAcc_Example_S32K396::Project_Settings::Startup_Code::startup.c, category=SWSRC
          short-label=examples::S32DS::S32K396::MemAcc_Example_S32K396::Project_Settings::Startup_Code::system.c, category=SWSRC
          short-label=examples::S32DS::S32K396::MemAcc_Example_S32K396::src::main.c, category=SWSRC
          short-label=examples::S32DS::S32K3XX::MemAcc_Example_S32K344::include::check_example.h, category=SWHDR
          short-label=examples::S32DS::S32K3XX::MemAcc_Example_S32K344::Project_Settings::Startup_Code::exceptions.c, category=SWSRC
          short-label=examples::S32DS::S32K3XX::MemAcc_Example_S32K344::Project_Settings::Startup_Code::nvic.c, category=SWSRC
          short-label=examples::S32DS::S32K3XX::MemAcc_Example_S32K344::Project_Settings::Startup_Code::startup.c, category=SWSRC
          short-label=examples::S32DS::S32K3XX::MemAcc_Example_S32K344::Project_Settings::Startup_Code::system.c, category=SWSRC
          short-label=examples::S32DS::S32K3XX::MemAcc_Example_S32K344::src::main.c, category=SWSRC
          short-label=include::MemAcc.h, category=SWHDR
          short-label=include::MemAcc_Types.h, category=SWHDR
          short-label=src::MemAcc.c, category=SWSRC
    4 x compiler:
      DIAB_Compiler:
        name=Windriver Diab
        options=-tARMCORTEXM7MG:simple -mthumb -std=c99 -Oz -g -fstandalone-debug -Wstrict-prototypes -Wsign-compare -Wdouble-promotion -Wunknown-pragmas -Wundef -Wextra -Wall -pedantic -Werror=implicit-function-declaration -fno-common -fno-signed-char -fno-trigraphs -V -c -DS32K3XX -D $ (DERIVATIVE) -DDIAB -DUSE_SW_VECTOR_MODE -DD_CACHE_ENABLE -DI_CACHE_ENABLE -DENABLE_FPU -DMCAL_ENABLE_USER_MODE_SUPPORT
        vendor=Windriver
        version=Wind River Diab Compiler v7.0.4
      GCC_Compiler:
        name=GCC Compiler
        options=-mcpu=cortex-m7 -mthumb -mlittle-endian -mfpu=fpv5-sp-d16 -mfloat-abi=hard -std=c99 -Os -ggdb3 -Wall -Wextra -pedantic -Wstrict-prototypes -Wundef -Wunused -Werror=implicit-function-declaration -Wsign-compare -Wdouble-promotion -fno-short-enums -funsigned-char -funsigned-bitfields -fno-common -fstack-usage -fdump-ipa-all -c -DS32K3XX -D $ (DERIVATIVE) -DGCC -DUSE_SW_VECTOR_MODE -DD_CACHE_ENABLE -DI_CACHE_ENABLE -DENABLE_FPU -DMCAL_ENABLE_USER_MODE_SUPPORT --sysroot=$(NEWLIB_DIR) -specs=nano.specs -specs=nosys.specs
        vendor=GCC Systems
        version=NXP GCC 10.2.0 20200723
      GHS_Compiler:
        name=Green Hills
        options=-cpu=cortexm7 -thumb -fpu=vfpv5_d16 -fsingle -C99 --ghstd=last -Osize --gnu_asm -dual_debug -G -keeptempfiles -Wimplicit-int -Wshadow -Wtrigraphs -Wundef --unsigned_chars --unsigned_fields --no_commons --no_exceptions --no_slash_comment --prototype_errors --incorrect_pragma_warnings -c -DS32K3XX -D $ (DERIVATIVE) -DGHS -DUSE_SW_VECTOR_MODE -DD_CACHE_ENABLE -DI_CACHE_ENABLE -DENABLE_FPU -DMCAL_ENABLE_USER_MODE_SUPPORT
        vendor=Green Hills
        version=Green Hills Multi 7.1.6d / Compiler 2021.1.4
      IAR_Compiler:
        name=IAR Compiler
        options=--cpu Cortex-M7 --cpu_mode thumb --endian little --fpu VFPv5-SP -e -Ohz --debug --no_clustering --no_mem_idioms --do_explicit_zero_opt_in_named_sections --require_prototypes --no_wrap_diagnostics --diag_suppress Pa050 -DS32K3XX -D $ (DERIVATIVE) -DIAR -DUSE_SW_VECTOR_MODE -DD_CACHE_ENABLE -DI_CACHE_ENABLE -DENABLE_FPU -DMCAL_ENABLE_USER_MODE_SUPPORT
        vendor=IAR Systems
        version=IAR ANSI C/C++ Compiler v.8.50.10 (safety version)
    generated-artifacts:
      5 x dependency on artifact:
        MemAcc_PBcfg_h: artifact-descriptor={short-label=generate_PB::include::MemAcc_PBcfg.h, category=SWHDR}, usages=EXECUTE
        MemAcc_PBcfg_c: artifact-descriptor={short-label=generate_PB::src::MemAcc_PBcfg.c, category=SWSRC}, usages=EXECUTE
        MemAcc_Cfg_h: artifact-descriptor={short-label=generate_PC::include::MemAcc_Cfg.h, category=SWHDR}, usages=COMPILE
        MemAcc_CfgDefines_h: artifact-descriptor={short-label=generate_PC::include::MemAcc_CfgDefines.h, category=SWHDR}, usages=COMPILE
        MemAcc_Cfg_c: artifact-descriptor={short-label=generate_PC::src::MemAcc_Cfg.c, category=SWSRC}, usages=COMPILE
    4 x linker:
      DIAB_Linker: name=Windriver Diab, options=-e Reset_Handler linker_script_file.dld -m30 -Xstack-usage -Xpreprocess-lecl -Llibrary_path -lc -lm -tARMCORTEXM7MG:simple, vendor=Windriver, version=Wind River Diab Compiler v7.0.4
      GCC_Linker: name=GCC Compiler, options=-Wl,-Map,filename -T linkerfile --entry=Reset_Handler -nostartfiles -mcpu=cortexm7 -mthumb -mfpu=fpv5-sp-d16 -mfloat-abi=hard -mlittle-endian -ggdb3 -lc -lm -lgcc -specs=nano.specs -specs=nosys.specs, vendor=GCC Systems, version=NXP GCC 10.2.0 20200723
      GHS_Linker: name=Green Hills, options=-e Reset_Handler -T linker_script_file.ld -map -keepmap -Mn -delete -ignore_debug_references -Llibrary_path -larch -lstartup -lind_sd -v -keep=C40_Ip_AccessCode -nostartfiles, vendor=Green Hills, version=Green Hills Multi 7.1.6d / Compiler 2021.1.4
      IAR_Linker: name=IAR Compiler, options=--map filename --config linkerfile --cpu=Cortex-M7 --fpu VFPv5-SP --entry _start --enable_stack_usage --skip_dynamic_initialization --no_wrap_diagnostics, vendor=IAR Systems, version=IAR ANSI C/C++ Compiler v.8.50.10 (safety version)
    resource consumption ResourceConsumption
      4 x memory section:
        MEMACC_CODE: alignment=UNSPECIFIED, sw-addrmethod=CODE, symbol=CODE
        MEMACC_CONFIG_DATA_UNSPECIFIED: alignment=UNSPECIFIED, sw-addrmethod=CONFIG_DATA, symbol=CONFIG_DATA_UNSPECIFIED
        MEMACC_VAR_CLEARED_16: alignment=16, sw-addrmethod=VAR_CLEARED, symbol=VAR_CLEARED_16
        MEMACC_VAR_CLEARED_UNSPECIFIED: alignment=UNSPECIFIED, sw-addrmethod=VAR_CLEARED, symbol=VAR_CLEARED_UNSPECIFIED
