AUTOSAR XML (schema 00050)
package /AUTOSAR_Wdg/BswModuleDescriptions
  bsw module description Wdg: module-id=102
    provided-entrys:
      Wdg_43_Instance0_ClearResetRequest
      Wdg_43_Instance0_GetVersionInfo
      Wdg_43_Instance0_Init
      Wdg_43_Instance0_Service
      Wdg_43_Instance0_SetMode
      Wdg_43_Instance0_SetTriggerCondition
      Wdg_43_Instance1_ClearResetRequest
      Wdg_43_Instance1_GetVersionInfo
      Wdg_43_Instance1_Init
      Wdg_43_Instance1_Service
      Wdg_43_Instance1_SetMode
      Wdg_43_Instance1_SetTriggerCondition
      Wdg_43_Instance2_ClearResetRequest
      Wdg_43_Instance2_GetVersionInfo
      Wdg_43_Instance2_Init
      Wdg_43_Instance2_Service
      Wdg_43_Instance2_SetMode
      Wdg_43_Instance2_SetTriggerCondition
      Wdg_43_Instance3_ClearResetRequest
      Wdg_43_Instance3_GetVersionInfo
      Wdg_43_Instance3_Init
      Wdg_43_Instance3_Service
      Wdg_43_Instance3_SetMode
      Wdg_43_Instance3_SetTriggerCondition
      Wdg_43_Instance4_ClearResetRequest
      Wdg_43_Instance4_GetVersionInfo
      Wdg_43_Instance4_Init
      Wdg_43_Instance4_Service
      Wdg_43_Instance4_SetMode
      Wdg_43_Instance4_SetTriggerCondition
      Wdg_Cbk_GptNotification0
      Wdg_Cbk_GptNotification1
      Swt_Ip_Swt0_Isr
      Swt_Ip_Swt{10..19}_Isr
      Swt_Ip_Swt1_Isr
      Swt_Ip_Swt{20..24}_Isr
      Swt_Ip_Swt{2..9}_Isr
    bsw internal behavior InternalBehavior_0
      12 x exclusive area:
        WDG_EXCLUSIVE_AREA_{00..11}
      32 x bsw called entity:
        Wdg_43_Instance0_ClearResetRequest: can-enter-exclusive-area=WDG_EXCLUSIVE_AREA_08, implemented-entry=Wdg_43_Instance0_ClearResetRequest
        Wdg_43_Instance0_GetVersionInfo: implemented-entry=Wdg_43_Instance0_GetVersionInfo
        Wdg_43_Instance0_Init: can-enter-exclusive-area=[WDG_EXCLUSIVE_AREA_01, WDG_EXCLUSIVE_AREA_02, WDG_EXCLUSIVE_AREA_06, WDG_EXCLUSIVE_AREA_07], implemented-entry=Wdg_43_Instance0_Init
        Wdg_43_Instance0_Service: can-enter-exclusive-area=WDG_EXCLUSIVE_AREA_09, implemented-entry=Wdg_43_Instance0_Service
        Wdg_43_Instance0_SetMode: can-enter-exclusive-area=[WDG_EXCLUSIVE_AREA_03, WDG_EXCLUSIVE_AREA_04, WDG_EXCLUSIVE_AREA_06, WDG_EXCLUSIVE_AREA_07, WDG_EXCLUSIVE_AREA_10, WDG_EXCLUSIVE_AREA_11], implemented-entry=Wdg_43_Instance0_SetMode
        Wdg_43_Instance0_SetTriggerCondition: can-enter-exclusive-area=WDG_EXCLUSIVE_AREA_05, implemented-entry=Wdg_43_Instance0_SetTriggerCondition
        Wdg_43_Instance1_ClearResetRequest: can-enter-exclusive-area=WDG_EXCLUSIVE_AREA_08, implemented-entry=Wdg_43_Instance1_ClearResetRequest
        Wdg_43_Instance1_GetVersionInfo: implemented-entry=Wdg_43_Instance1_GetVersionInfo
        Wdg_43_Instance1_Init: can-enter-exclusive-area=[WDG_EXCLUSIVE_AREA_01, WDG_EXCLUSIVE_AREA_02, WDG_EXCLUSIVE_AREA_06, WDG_EXCLUSIVE_AREA_07], implemented-entry=Wdg_43_Instance1_Init
        Wdg_43_Instance1_Service: can-enter-exclusive-area=WDG_EXCLUSIVE_AREA_09, implemented-entry=Wdg_43_Instance1_Service
        Wdg_43_Instance1_SetMode: can-enter-exclusive-area=[WDG_EXCLUSIVE_AREA_03, WDG_EXCLUSIVE_AREA_04, WDG_EXCLUSIVE_AREA_06, WDG_EXCLUSIVE_AREA_07, WDG_EXCLUSIVE_AREA_10, WDG_EXCLUSIVE_AREA_11], implemented-entry=Wdg_43_Instance1_SetMode
        Wdg_43_Instance1_SetTriggerCondition: can-enter-exclusive-area=WDG_EXCLUSIVE_AREA_05, implemented-entry=Wdg_43_Instance1_SetTriggerCondition
        Wdg_43_Instance2_ClearResetRequest: can-enter-exclusive-area=WDG_EXCLUSIVE_AREA_08, implemented-entry=Wdg_43_Instance2_ClearResetRequest
        Wdg_43_Instance2_GetVersionInfo: implemented-entry=Wdg_43_Instance2_GetVersionInfo
        Wdg_43_Instance2_Init: can-enter-exclusive-area=[WDG_EXCLUSIVE_AREA_01, WDG_EXCLUSIVE_AREA_02, WDG_EXCLUSIVE_AREA_06, WDG_EXCLUSIVE_AREA_07], implemented-entry=Wdg_43_Instance2_Init
        Wdg_43_Instance2_Service: can-enter-exclusive-area=WDG_EXCLUSIVE_AREA_09, implemented-entry=Wdg_43_Instance2_Service
        Wdg_43_Instance2_SetMode: can-enter-exclusive-area=[WDG_EXCLUSIVE_AREA_03, WDG_EXCLUSIVE_AREA_04, WDG_EXCLUSIVE_AREA_06, WDG_EXCLUSIVE_AREA_07, WDG_EXCLUSIVE_AREA_10, WDG_EXCLUSIVE_AREA_11], implemented-entry=Wdg_43_Instance2_SetMode
        Wdg_43_Instance2_SetTriggerCondition: can-enter-exclusive-area=WDG_EXCLUSIVE_AREA_05, implemented-entry=Wdg_43_Instance2_SetTriggerCondition
        Wdg_43_Instance3_ClearResetRequest: can-enter-exclusive-area=WDG_EXCLUSIVE_AREA_08, implemented-entry=Wdg_43_Instance3_ClearResetRequest
        Wdg_43_Instance3_GetVersionInfo: implemented-entry=Wdg_43_Instance3_GetVersionInfo
        Wdg_43_Instance3_Init: can-enter-exclusive-area=[WDG_EXCLUSIVE_AREA_01, WDG_EXCLUSIVE_AREA_02, WDG_EXCLUSIVE_AREA_06, WDG_EXCLUSIVE_AREA_07], implemented-entry=Wdg_43_Instance3_Init
        Wdg_43_Instance3_Service: can-enter-exclusive-area=WDG_EXCLUSIVE_AREA_09, implemented-entry=Wdg_43_Instance3_Service
        Wdg_43_Instance3_SetMode: can-enter-exclusive-area=[WDG_EXCLUSIVE_AREA_03, WDG_EXCLUSIVE_AREA_04, WDG_EXCLUSIVE_AREA_06, WDG_EXCLUSIVE_AREA_07, WDG_EXCLUSIVE_AREA_10, WDG_EXCLUSIVE_AREA_11], implemented-entry=Wdg_43_Instance3_SetMode
        Wdg_43_Instance3_SetTriggerCondition: can-enter-exclusive-area=WDG_EXCLUSIVE_AREA_05, implemented-entry=Wdg_43_Instance3_SetTriggerCondition
        Wdg_43_Instance4_ClearResetRequest: can-enter-exclusive-area=WDG_EXCLUSIVE_AREA_08, implemented-entry=Wdg_43_Instance4_ClearResetRequest
        Wdg_43_Instance4_GetVersionInfo: implemented-entry=Wdg_43_Instance4_GetVersionInfo
        Wdg_43_Instance4_Init: can-enter-exclusive-area=[WDG_EXCLUSIVE_AREA_01, WDG_EXCLUSIVE_AREA_02, WDG_EXCLUSIVE_AREA_06, WDG_EXCLUSIVE_AREA_07], implemented-entry=Wdg_43_Instance4_Init
        Wdg_43_Instance4_Service: can-enter-exclusive-area=WDG_EXCLUSIVE_AREA_09, implemented-entry=Wdg_43_Instance4_Service
        Wdg_43_Instance4_SetMode: implemented-entry=Wdg_43_Instance4_SetMode
        Wdg_43_Instance4_SetTriggerCondition: can-enter-exclusive-area=WDG_EXCLUSIVE_AREA_05, implemented-entry=Wdg_43_Instance4_SetTriggerCondition
        Wdg_Cbk_GptNotification0: can-enter-exclusive-area=WDG_EXCLUSIVE_AREA_00, implemented-entry=Wdg_Cbk_GptNotification0
        Wdg_Cbk_GptNotification1: can-enter-exclusive-area=WDG_EXCLUSIVE_AREA_00, implemented-entry=Wdg_Cbk_GptNotification1
      25 x bsw interrupt entity, all with interrupt-category=CAT-2, interrupt-source=Hardware:
        Swt_Ip_Swt0_Isr: implemented-entry=Swt_Ip_Swt0_Isr
        Swt_Ip_Swt{10..19}_Isr: implemented-entry=Swt_Ip_Swt{10..19}_Isr
        Swt_Ip_Swt1_Isr: implemented-entry=Swt_Ip_Swt1_Isr
        Swt_Ip_Swt{20..24}_Isr: implemented-entry=Swt_Ip_Swt{20..24}_Isr
        Swt_Ip_Swt{2..9}_Isr: implemented-entry=Swt_Ip_Swt{2..9}_Isr
package /AUTOSAR_Wdg/BswModuleEntrys
  57 x bsw module entry, all with is-synchronous=true, sw-service-impl-policy=STANDARD:
    Wdg_43_Instance0_ClearResetRequest: service-id=0x06, is-reentrant=false, call-type=REGULAR, execution-context=UNSPECIFIED
    Wdg_43_Instance0_GetVersionInfo: service-id=0x04, is-reentrant=true, call-type=REGULAR, execution-context=UNSPECIFIED
    Wdg_43_Instance0_Init: service-id=0x00, is-reentrant=false, call-type=REGULAR, execution-context=UNSPECIFIED
    Wdg_43_Instance0_Service: service-id=0x05, is-reentrant=false, call-type=REGULAR, execution-context=UNSPECIFIED
    Wdg_43_Instance0_SetMode: service-id=0x01, is-reentrant=false, call-type=REGULAR, execution-context=UNSPECIFIED
    Wdg_43_Instance0_SetTriggerCondition: service-id=0x03, is-reentrant=false, call-type=REGULAR, execution-context=UNSPECIFIED
    Wdg_43_Instance1_ClearResetRequest: service-id=0x06, is-reentrant=false, call-type=REGULAR, execution-context=UNSPECIFIED
    Wdg_43_Instance1_GetVersionInfo: service-id=0x04, is-reentrant=true, call-type=REGULAR, execution-context=UNSPECIFIED
    Wdg_43_Instance1_Init: service-id=0x00, is-reentrant=false, call-type=REGULAR, execution-context=UNSPECIFIED
    Wdg_43_Instance1_Service: service-id=0x05, is-reentrant=false, call-type=REGULAR, execution-context=UNSPECIFIED
    Wdg_43_Instance1_SetMode: service-id=0x01, is-reentrant=false, call-type=REGULAR, execution-context=UNSPECIFIED
    Wdg_43_Instance1_SetTriggerCondition: service-id=0x03, is-reentrant=false, call-type=REGULAR, execution-context=UNSPECIFIED
    Wdg_43_Instance2_ClearResetRequest: service-id=0x06, is-reentrant=false, call-type=REGULAR, execution-context=UNSPECIFIED
    Wdg_43_Instance2_GetVersionInfo: service-id=0x04, is-reentrant=true, call-type=REGULAR, execution-context=UNSPECIFIED
    Wdg_43_Instance2_Init: service-id=0x00, is-reentrant=false, call-type=REGULAR, execution-context=UNSPECIFIED
    Wdg_43_Instance2_Service: service-id=0x05, is-reentrant=false, call-type=REGULAR, execution-context=UNSPECIFIED
    Wdg_43_Instance2_SetMode: service-id=0x01, is-reentrant=false, call-type=REGULAR, execution-context=UNSPECIFIED
    Wdg_43_Instance2_SetTriggerCondition: service-id=0x03, is-reentrant=false, call-type=REGULAR, execution-context=UNSPECIFIED
    Wdg_43_Instance3_ClearResetRequest: service-id=0x06, is-reentrant=false, call-type=REGULAR, execution-context=UNSPECIFIED
    Wdg_43_Instance3_GetVersionInfo: service-id=0x04, is-reentrant=true, call-type=REGULAR, execution-context=UNSPECIFIED
    Wdg_43_Instance3_Init: service-id=0x00, is-reentrant=false, call-type=REGULAR, execution-context=UNSPECIFIED
    Wdg_43_Instance3_Service: service-id=0x05, is-reentrant=false, call-type=REGULAR, execution-context=UNSPECIFIED
    Wdg_43_Instance3_SetMode: service-id=0x01, is-reentrant=false, call-type=REGULAR, execution-context=UNSPECIFIED
    Wdg_43_Instance3_SetTriggerCondition: service-id=0x03, is-reentrant=false, call-type=REGULAR, execution-context=UNSPECIFIED
    Wdg_43_Instance4_ClearResetRequest: service-id=0x06, is-reentrant=false, call-type=REGULAR, execution-context=UNSPECIFIED
    Wdg_43_Instance4_GetVersionInfo: service-id=0x04, is-reentrant=true, call-type=REGULAR, execution-context=UNSPECIFIED
    Wdg_43_Instance4_Init: service-id=0x00, is-reentrant=false, call-type=REGULAR, execution-context=UNSPECIFIED
    Wdg_43_Instance4_Service: service-id=0x05, is-reentrant=false, call-type=REGULAR, execution-context=UNSPECIFIED
    Wdg_43_Instance4_SetMode: service-id=0x01, is-reentrant=false, call-type=REGULAR, execution-context=UNSPECIFIED
    Wdg_43_Instance4_SetTriggerCondition: service-id=0x03, is-reentrant=false, call-type=REGULAR, execution-context=UNSPECIFIED
    Wdg_Cbk_GptNotification0: service-id=0x02, is-reentrant=false, call-type=REGULAR, execution-context=UNSPECIFIED
    Wdg_Cbk_GptNotification1: service-id=0x02, is-reentrant=false, call-type=REGULAR, execution-context=UNSPECIFIED
    Swt_Ip_Swt0_Isr: service-id=0, is-reentrant=false, call-type=INTERRUPT, execution-context=INTERRUPT-CAT-2
    Swt_Ip_Swt{10..19}_Isr: service-id=0, is-reentrant=false, call-type=INTERRUPT, execution-context=INTERRUPT-CAT-2
    Swt_Ip_Swt1_Isr: service-id=0, is-reentrant=false, call-type=INTERRUPT, execution-context=INTERRUPT-CAT-2
    Swt_Ip_Swt{20..24}_Isr: service-id=0, is-reentrant=false, call-type=INTERRUPT, execution-context=INTERRUPT-CAT-2
    Swt_Ip_Swt{2..9}_Isr: service-id=0, is-reentrant=false, call-type=INTERRUPT, execution-context=INTERRUPT-CAT-2
package /Wdg_TS_T40D34M30I0R0/Implementations
  bsw implementation BswImplementation_0: programming-language=C, sw-version=3.0.0, vendor-id=43, ar-release-version=4.7.0, behavior=InternalBehavior_0, vendor-specific-module-def=Wdg
    code-descriptors:
      code Files
        artifact-descriptors:
          short-label=config::Wdg.xdm, category=SWCFG
          short-label=doc::RTD_WDG_IM.pdf, category=SWDOC
          short-label=doc::RTD_WDG_UM.pdf, category=SWDOC
          short-label=examples::EBT::S32K358::Wdg_Example_S32K358::generate::epc::BaseNXP.xdm, category=SWCFG
          short-label=examples::EBT::S32K358::Wdg_Example_S32K358::generate::epc::Dem.xdm, category=SWCFG
          short-label=examples::EBT::S32K358::Wdg_Example_S32K358::generate::epc::EcuC.xdm, category=SWCFG
          short-label=examples::EBT::S32K358::Wdg_Example_S32K358::generate::epc::Gpt.xdm, category=SWCFG
          short-label=examples::EBT::S32K358::Wdg_Example_S32K358::generate::epc::Mcu.xdm, category=SWCFG
          short-label=examples::EBT::S32K358::Wdg_Example_S32K358::generate::epc::Os.xdm, category=SWCFG
          short-label=examples::EBT::S32K358::Wdg_Example_S32K358::generate::epc::Platform.xdm, category=SWCFG
          short-label=examples::EBT::S32K358::Wdg_Example_S32K358::generate::epc::Resource.xdm, category=SWCFG
          short-label=examples::EBT::S32K358::Wdg_Example_S32K358::generate::epc::Wdg.xdm, category=SWCFG
          short-label=examples::EBT::S32K358::Wdg_Example_S32K358::include::check_example.h, category=SWHDR
          short-label=examples::EBT::S32K358::Wdg_Example_S32K358::src::main.c, category=SWSRC
          short-label=examples::EBT::S32K358::Wdg_Example_S32K358::TresosProject::Wdg_Example_S32K358::.prefs::preferences.xdm, category=SWCFG
          short-label=examples::EBT::S32K358::Wdg_Example_S32K358::TresosProject::Wdg_Example_S32K358::config::BaseNXP.xdm, category=SWCFG
          short-label=examples::EBT::S32K358::Wdg_Example_S32K358::TresosProject::Wdg_Example_S32K358::config::Dem.xdm, category=SWCFG
          short-label=examples::EBT::S32K358::Wdg_Example_S32K358::TresosProject::Wdg_Example_S32K358::config::EcuC.xdm, category=SWCFG
          short-label=examples::EBT::S32K358::Wdg_Example_S32K358::TresosProject::Wdg_Example_S32K358::config::Gpt.xdm, category=SWCFG
          short-label=examples::EBT::S32K358::Wdg_Example_S32K358::TresosProject::Wdg_Example_S32K358::config::Mcu.xdm, category=SWCFG
          short-label=examples::EBT::S32K358::Wdg_Example_S32K358::TresosProject::Wdg_Example_S32K358::config::Os.xdm, category=SWCFG
          short-label=examples::EBT::S32K358::Wdg_Example_S32K358::TresosProject::Wdg_Example_S32K358::config::Platform.xdm, category=SWCFG
          short-label=examples::EBT::S32K358::Wdg_Example_S32K358::TresosProject::Wdg_Example_S32K358::config::Resource.xdm, category=SWCFG
          short-label=examples::EBT::S32K358::Wdg_Example_S32K358::TresosProject::Wdg_Example_S32K358::config::Wdg.xdm, category=SWCFG
          short-label=examples::EBT::S32K396::Wdg_Example_S32K396::generate::epc::BaseNXP.xdm, category=SWCFG
          short-label=examples::EBT::S32K396::Wdg_Example_S32K396::generate::epc::Dem.xdm, category=SWCFG
          short-label=examples::EBT::S32K396::Wdg_Example_S32K396::generate::epc::EcuC.xdm, category=SWCFG
          short-label=examples::EBT::S32K396::Wdg_Example_S32K396::generate::epc::Gpt.xdm, category=SWCFG
          short-label=examples::EBT::S32K396::Wdg_Example_S32K396::generate::epc::Mcu.xdm, category=SWCFG
          short-label=examples::EBT::S32K396::Wdg_Example_S32K396::generate::epc::Os.xdm, category=SWCFG
          short-label=examples::EBT::S32K396::Wdg_Example_S32K396::generate::epc::Platform.xdm, category=SWCFG
          short-label=examples::EBT::S32K396::Wdg_Example_S32K396::generate::epc::Resource.xdm, category=SWCFG
          short-label=examples::EBT::S32K396::Wdg_Example_S32K396::generate::epc::Wdg.xdm, category=SWCFG
          short-label=examples::EBT::S32K396::Wdg_Example_S32K396::include::check_example.h, category=SWHDR
          short-label=examples::EBT::S32K396::Wdg_Example_S32K396::src::main.c, category=SWSRC
          short-label=examples::EBT::S32K396::Wdg_Example_S32K396::TresosProject::Wdg_Example_S32K396::.prefs::preferences.xdm, category=SWCFG
          short-label=examples::EBT::S32K396::Wdg_Example_S32K396::TresosProject::Wdg_Example_S32K396::config::BaseNXP.xdm, category=SWCFG
          short-label=examples::EBT::S32K396::Wdg_Example_S32K396::TresosProject::Wdg_Example_S32K396::config::Dem.xdm, category=SWCFG
          short-label=examples::EBT::S32K396::Wdg_Example_S32K396::TresosProject::Wdg_Example_S32K396::config::EcuC.xdm, category=SWCFG
          short-label=examples::EBT::S32K396::Wdg_Example_S32K396::TresosProject::Wdg_Example_S32K396::config::Gpt.xdm, category=SWCFG
          short-label=examples::EBT::S32K396::Wdg_Example_S32K396::TresosProject::Wdg_Example_S32K396::config::Mcu.xdm, category=SWCFG
          short-label=examples::EBT::S32K396::Wdg_Example_S32K396::TresosProject::Wdg_Example_S32K396::config::Os.xdm, category=SWCFG
          short-label=examples::EBT::S32K396::Wdg_Example_S32K396::TresosProject::Wdg_Example_S32K396::config::Platform.xdm, category=SWCFG
          short-label=examples::EBT::S32K396::Wdg_Example_S32K396::TresosProject::Wdg_Example_S32K396::config::Resource.xdm, category=SWCFG
          short-label=examples::EBT::S32K396::Wdg_Example_S32K396::TresosProject::Wdg_Example_S32K396::config::Wdg.xdm, category=SWCFG
          short-label=examples::EBT::S32K3XX::Wdg_Example_S32K344::generate::epc::BaseNXP.xdm, category=SWCFG
          short-label=examples::EBT::S32K3XX::Wdg_Example_S32K344::generate::epc::Dem.xdm, category=SWCFG
          short-label=examples::EBT::S32K3XX::Wdg_Example_S32K344::generate::epc::EcuC.xdm, category=SWCFG
          short-label=examples::EBT::S32K3XX::Wdg_Example_S32K344::generate::epc::Gpt.xdm, category=SWCFG
          short-label=examples::EBT::S32K3XX::Wdg_Example_S32K344::generate::epc::Mcu.xdm, category=SWCFG
          short-label=examples::EBT::S32K3XX::Wdg_Example_S32K344::generate::epc::Os.xdm, category=SWCFG
          short-label=examples::EBT::S32K3XX::Wdg_Example_S32K344::generate::epc::Platform.xdm, category=SWCFG
          short-label=examples::EBT::S32K3XX::Wdg_Example_S32K344::generate::epc::Resource.xdm, category=SWCFG
          short-label=examples::EBT::S32K3XX::Wdg_Example_S32K344::generate::epc::Wdg.xdm, category=SWCFG
          short-label=examples::EBT::S32K3XX::Wdg_Example_S32K344::include::check_example.h, category=SWHDR
          short-label=examples::EBT::S32K3XX::Wdg_Example_S32K344::src::main.c, category=SWSRC
          short-label=examples::EBT::S32K3XX::Wdg_Example_S32K344::TresosProject::Wdg_Example_S32K344::.prefs::preferences.xdm, category=SWCFG
          short-label=examples::EBT::S32K3XX::Wdg_Example_S32K344::TresosProject::Wdg_Example_S32K344::config::BaseNXP.xdm, category=SWCFG
          short-label=examples::EBT::S32K3XX::Wdg_Example_S32K344::TresosProject::Wdg_Example_S32K344::config::Dem.xdm, category=SWCFG
          short-label=examples::EBT::S32K3XX::Wdg_Example_S32K344::TresosProject::Wdg_Example_S32K344::config::EcuC.xdm, category=SWCFG
          short-label=examples::EBT::S32K3XX::Wdg_Example_S32K344::TresosProject::Wdg_Example_S32K344::config::Gpt.xdm, category=SWCFG
          short-label=examples::EBT::S32K3XX::Wdg_Example_S32K344::TresosProject::Wdg_Example_S32K344::config::Mcu.xdm, category=SWCFG
          short-label=examples::EBT::S32K3XX::Wdg_Example_S32K344::TresosProject::Wdg_Example_S32K344::config::Os.xdm, category=SWCFG
          short-label=examples::EBT::S32K3XX::Wdg_Example_S32K344::TresosProject::Wdg_Example_S32K344::config::Platform.xdm, category=SWCFG
          short-label=examples::EBT::S32K3XX::Wdg_Example_S32K344::TresosProject::Wdg_Example_S32K344::config::Resource.xdm, category=SWCFG
          short-label=examples::EBT::S32K3XX::Wdg_Example_S32K344::TresosProject::Wdg_Example_S32K344::config::Wdg.xdm, category=SWCFG
          short-label=examples::EBT::S32M276::Wdg_Example_S32M276::generate::epc::Ae.xdm, category=SWCFG
          short-label=examples::EBT::S32M276::Wdg_Example_S32M276::generate::epc::BaseNXP.xdm, category=SWCFG
          short-label=examples::EBT::S32M276::Wdg_Example_S32M276::generate::epc::Dem.xdm, category=SWCFG
          short-label=examples::EBT::S32M276::Wdg_Example_S32M276::generate::epc::EcuC.xdm, category=SWCFG
          short-label=examples::EBT::S32M276::Wdg_Example_S32M276::generate::epc::Gpt.xdm, category=SWCFG
          short-label=examples::EBT::S32M276::Wdg_Example_S32M276::generate::epc::Mcu.xdm, category=SWCFG
          short-label=examples::EBT::S32M276::Wdg_Example_S32M276::generate::epc::Os.xdm, category=SWCFG
          short-label=examples::EBT::S32M276::Wdg_Example_S32M276::generate::epc::Platform.xdm, category=SWCFG
          short-label=examples::EBT::S32M276::Wdg_Example_S32M276::generate::epc::Port.xdm, category=SWCFG
          short-label=examples::EBT::S32M276::Wdg_Example_S32M276::generate::epc::Resource.xdm, category=SWCFG
          short-label=examples::EBT::S32M276::Wdg_Example_S32M276::generate::epc::Spi.xdm, category=SWCFG
          short-label=examples::EBT::S32M276::Wdg_Example_S32M276::generate::epc::Wdg.xdm, category=SWCFG
          short-label=examples::EBT::S32M276::Wdg_Example_S32M276::generate::epc::Wdg_43_Instance4.xdm, category=SWCFG
          short-label=examples::EBT::S32M276::Wdg_Example_S32M276::include::check_example.h, category=SWHDR
          short-label=examples::EBT::S32M276::Wdg_Example_S32M276::src::main.c, category=SWSRC
          short-label=examples::EBT::S32M276::Wdg_Example_S32M276::TresosProject::Wdg_Example_S32M276::.prefs::preferences.xdm, category=SWCFG
          short-label=examples::EBT::S32M276::Wdg_Example_S32M276::TresosProject::Wdg_Example_S32M276::config::Ae.xdm, category=SWCFG
          short-label=examples::EBT::S32M276::Wdg_Example_S32M276::TresosProject::Wdg_Example_S32M276::config::BaseNXP.xdm, category=SWCFG
          short-label=examples::EBT::S32M276::Wdg_Example_S32M276::TresosProject::Wdg_Example_S32M276::config::Dem.xdm, category=SWCFG
          short-label=examples::EBT::S32M276::Wdg_Example_S32M276::TresosProject::Wdg_Example_S32M276::config::EcuC.xdm, category=SWCFG
          short-label=examples::EBT::S32M276::Wdg_Example_S32M276::TresosProject::Wdg_Example_S32M276::config::Gpt.xdm, category=SWCFG
          short-label=examples::EBT::S32M276::Wdg_Example_S32M276::TresosProject::Wdg_Example_S32M276::config::Mcu.xdm, category=SWCFG
          short-label=examples::EBT::S32M276::Wdg_Example_S32M276::TresosProject::Wdg_Example_S32M276::config::Os.xdm, category=SWCFG
          short-label=examples::EBT::S32M276::Wdg_Example_S32M276::TresosProject::Wdg_Example_S32M276::config::Platform.xdm, category=SWCFG
          short-label=examples::EBT::S32M276::Wdg_Example_S32M276::TresosProject::Wdg_Example_S32M276::config::Port.xdm, category=SWCFG
          short-label=examples::EBT::S32M276::Wdg_Example_S32M276::TresosProject::Wdg_Example_S32M276::config::Resource.xdm, category=SWCFG
          short-label=examples::EBT::S32M276::Wdg_Example_S32M276::TresosProject::Wdg_Example_S32M276::config::Spi.xdm, category=SWCFG
          short-label=examples::EBT::S32M276::Wdg_Example_S32M276::TresosProject::Wdg_Example_S32M276::config::Wdg.xdm, category=SWCFG
          short-label=examples::EBT::S32M276::Wdg_Example_S32M276::TresosProject::Wdg_Example_S32M276::config::Wdg_43_Instance4.xdm, category=SWCFG
          short-label=examples::S32DS::S32K358::Swt_Ip_Example_S32K358::include::check_example.h, category=SWHDR
          short-label=examples::S32DS::S32K358::Swt_Ip_Example_S32K358::Project_Settings::Startup_Code::exceptions.c, category=SWSRC
          short-label=examples::S32DS::S32K358::Swt_Ip_Example_S32K358::Project_Settings::Startup_Code::nvic.c, category=SWSRC
          short-label=examples::S32DS::S32K358::Swt_Ip_Example_S32K358::Project_Settings::Startup_Code::startup.c, category=SWSRC
          short-label=examples::S32DS::S32K358::Swt_Ip_Example_S32K358::Project_Settings::Startup_Code::system.c, category=SWSRC
          short-label=examples::S32DS::S32K358::Swt_Ip_Example_S32K358::src::main.c, category=SWSRC
          short-label=examples::S32DS::S32K358::Wdg_Example_S32K358::include::check_example.h, category=SWHDR
          short-label=examples::S32DS::S32K358::Wdg_Example_S32K358::Project_Settings::Startup_Code::exceptions.c, category=SWSRC
          short-label=examples::S32DS::S32K358::Wdg_Example_S32K358::Project_Settings::Startup_Code::nvic.c, category=SWSRC
          short-label=examples::S32DS::S32K358::Wdg_Example_S32K358::Project_Settings::Startup_Code::startup.c, category=SWSRC
          short-label=examples::S32DS::S32K358::Wdg_Example_S32K358::Project_Settings::Startup_Code::system.c, category=SWSRC
          short-label=examples::S32DS::S32K358::Wdg_Example_S32K358::src::main.c, category=SWSRC
          short-label=examples::S32DS::S32K396::Swt_Ip_Example_S32K396::include::check_example.h, category=SWHDR
          short-label=examples::S32DS::S32K396::Swt_Ip_Example_S32K396::Project_Settings::Startup_Code::exceptions.c, category=SWSRC
          short-label=examples::S32DS::S32K396::Swt_Ip_Example_S32K396::Project_Settings::Startup_Code::nvic.c, category=SWSRC
          short-label=examples::S32DS::S32K396::Swt_Ip_Example_S32K396::Project_Settings::Startup_Code::startup.c, category=SWSRC
          short-label=examples::S32DS::S32K396::Swt_Ip_Example_S32K396::Project_Settings::Startup_Code::system.c, category=SWSRC
          short-label=examples::S32DS::S32K396::Swt_Ip_Example_S32K396::src::main.c, category=SWSRC
          short-label=examples::S32DS::S32K396::Wdg_Example_S32K396::include::check_example.h, category=SWHDR
          short-label=examples::S32DS::S32K396::Wdg_Example_S32K396::Project_Settings::Startup_Code::exceptions.c, category=SWSRC
          short-label=examples::S32DS::S32K396::Wdg_Example_S32K396::Project_Settings::Startup_Code::nvic.c, category=SWSRC
          short-label=examples::S32DS::S32K396::Wdg_Example_S32K396::Project_Settings::Startup_Code::startup.c, category=SWSRC
          short-label=examples::S32DS::S32K396::Wdg_Example_S32K396::Project_Settings::Startup_Code::system.c, category=SWSRC
          short-label=examples::S32DS::S32K396::Wdg_Example_S32K396::src::main.c, category=SWSRC
          short-label=examples::S32DS::S32K3XX::Swt_Ip_Example_S32K344::include::check_example.h, category=SWHDR
          short-label=examples::S32DS::S32K3XX::Swt_Ip_Example_S32K344::Project_Settings::Startup_Code::exceptions.c, category=SWSRC
          short-label=examples::S32DS::S32K3XX::Swt_Ip_Example_S32K344::Project_Settings::Startup_Code::nvic.c, category=SWSRC
          short-label=examples::S32DS::S32K3XX::Swt_Ip_Example_S32K344::Project_Settings::Startup_Code::startup.c, category=SWSRC
          short-label=examples::S32DS::S32K3XX::Swt_Ip_Example_S32K344::Project_Settings::Startup_Code::system.c, category=SWSRC
          short-label=examples::S32DS::S32K3XX::Swt_Ip_Example_S32K344::src::main.c, category=SWSRC
          short-label=examples::S32DS::S32K3XX::Wdg_Example_S32K344::include::check_example.h, category=SWHDR
          short-label=examples::S32DS::S32K3XX::Wdg_Example_S32K344::Project_Settings::Startup_Code::exceptions.c, category=SWSRC
          short-label=examples::S32DS::S32K3XX::Wdg_Example_S32K344::Project_Settings::Startup_Code::nvic.c, category=SWSRC
          short-label=examples::S32DS::S32K3XX::Wdg_Example_S32K344::Project_Settings::Startup_Code::startup.c, category=SWSRC
          short-label=examples::S32DS::S32K3XX::Wdg_Example_S32K344::Project_Settings::Startup_Code::system.c, category=SWSRC
          short-label=examples::S32DS::S32K3XX::Wdg_Example_S32K344::src::main.c, category=SWSRC
          short-label=examples::S32DS::S32M276::Wdg_Example_S32M276::include::check_example.h, category=SWHDR
          short-label=examples::S32DS::S32M276::Wdg_Example_S32M276::Project_Settings::Startup_Code::exceptions.c, category=SWSRC
          short-label=examples::S32DS::S32M276::Wdg_Example_S32M276::Project_Settings::Startup_Code::nvic.c, category=SWSRC
          short-label=examples::S32DS::S32M276::Wdg_Example_S32M276::Project_Settings::Startup_Code::startup.c, category=SWSRC
          short-label=examples::S32DS::S32M276::Wdg_Example_S32M276::Project_Settings::Startup_Code::system.c, category=SWSRC
          short-label=examples::S32DS::S32M276::Wdg_Example_S32M276::src::main.c, category=SWSRC
          short-label=examples::S32DS::S32M276::Wdg_Ip_Example_S32M276::include::check_example.h, category=SWHDR
          short-label=examples::S32DS::S32M276::Wdg_Ip_Example_S32M276::Project_Settings::Startup_Code::exceptions.c, category=SWSRC
          short-label=examples::S32DS::S32M276::Wdg_Ip_Example_S32M276::Project_Settings::Startup_Code::nvic.c, category=SWSRC
          short-label=examples::S32DS::S32M276::Wdg_Ip_Example_S32M276::Project_Settings::Startup_Code::startup.c, category=SWSRC
          short-label=examples::S32DS::S32M276::Wdg_Ip_Example_S32M276::Project_Settings::Startup_Code::system.c, category=SWSRC
          short-label=examples::S32DS::S32M276::Wdg_Ip_Example_S32M276::src::main.c, category=SWSRC
          short-label=include::AeWdog_Ip.h, category=SWHDR
          short-label=include::AeWdog_Ip_Types.h, category=SWHDR
          short-label=include::Swt_Ip.h, category=SWHDR
          short-label=include::Swt_Ip_Irq.h, category=SWHDR
          short-label=include::Swt_Ip_Types.h, category=SWHDR
          short-label=include::Wdg_43_Instance{0..4}.h, category=SWHDR
          short-label=include::Wdg_Channel.h, category=SWHDR
          short-label=include::Wdg_ChannelTypes.h, category=SWHDR
          short-label=include::Wdg_EnvCfg.h, category=SWHDR
          short-label=include::Wdg_Ipw.h, category=SWHDR
          short-label=include::Wdg_Ipw_Types.h, category=SWHDR
          short-label=src::AeWdog_Ip.c, category=SWSRC
          short-label=src::AeWdog_Ip_Irq.c, category=SWSRC
          short-label=src::Swt_Ip.c, category=SWSRC
          short-label=src::Swt_Ip_Irq.c, category=SWSRC
          short-label=src::Wdg_43_Instance{0..4}.c, category=SWSRC
          short-label=src::Wdg_Channel.c, category=SWSRC
          short-label=src::Wdg_Ipw.c, category=SWSRC
    4 x compiler:
      DIAB_Compiler:
        name=Windriver Diab
        options=-tARMCORTEXM7MG:simple -mthumb -std=c99 -Oz -g -fstandalone-debug -Wstrict-prototypes -Wsign-compare -Wdouble-promotion -Wunknown-pragmas -Wundef -Wextra -Wall -pedantic -Werror=implicit-function-declaration -fno-common -fno-signed-char -fno-trigraphs -V -c -DS32K3XX -D $ (DERIVATIVE) -DDIAB -DUSE_SW_VECTOR_MODE -DD_CACHE_ENABLE -DI_CACHE_ENABLE -DENABLE_FPU -DMCAL_ENABLE_USER_MODE_SUPPORT
        vendor=Windriver
        version=Wind River Diab Compiler v7.0.4
      GCC_Compiler:
        name=GCC Compiler
        options=-mcpu=cortex-m7 -mthumb -mlittle-endian -mfpu=fpv5-sp-d16 -mfloat-abi=hard -std=c99 -Os -ggdb3 -Wall -Wextra -pedantic -Wstrict-prototypes -Wundef -Wunused -Werror=implicit-function-declaration -Wsign-compare -Wdouble-promotion -fno-short-enums -funsigned-char -funsigned-bitfields -fno-common -fstack-usage -fdump-ipa-all -c -DS32K3XX -D $ (DERIVATIVE) -DGCC -DUSE_SW_VECTOR_MODE -DD_CACHE_ENABLE -DI_CACHE_ENABLE -DENABLE_FPU -DMCAL_ENABLE_USER_MODE_SUPPORT --sysroot=$(NEWLIB_DIR) -specs=nano.specs -specs=nosys.specs
        vendor=GCC Systems
        version=NXP GCC 10.2.0 20200723
      GHS_Compiler:
        name=Green Hills
        options=-cpu=cortexm7 -thumb -fpu=vfpv5_d16 -fsingle -C99 --ghstd=last -Osize --gnu_asm -dual_debug -G -keeptempfiles -Wimplicit-int -Wshadow -Wtrigraphs -Wundef --unsigned_chars --unsigned_fields --no_commons --no_exceptions --no_slash_comment --prototype_errors --incorrect_pragma_warnings -c -DS32K3XX -D $ (DERIVATIVE) -DGHS -DUSE_SW_VECTOR_MODE -DD_CACHE_ENABLE -DI_CACHE_ENABLE -DENABLE_FPU -DMCAL_ENABLE_USER_MODE_SUPPORT
        vendor=Green Hills
        version=Green Hills Multi 7.1.6d / Compiler 2021.1.4
      IAR_Compiler:
        name=IAR Compiler
        options=--cpu Cortex-M7 --cpu_mode thumb --endian little --fpu VFPv5-SP -e -Ohz --debug --no_clustering --no_mem_idioms --do_explicit_zero_opt_in_named_sections --require_prototypes --no_wrap_diagnostics --diag_suppress Pa050 -DS32K3XX -D $ (DERIVATIVE) -DIAR -DUSE_SW_VECTOR_MODE -DD_CACHE_ENABLE -DI_CACHE_ENABLE -DENABLE_FPU -DMCAL_ENABLE_USER_MODE_SUPPORT
        vendor=IAR Systems
        version=IAR ANSI C/C++ Compiler v.8.50.10 (safety version)
    generated-artifacts:
      51 x dependency on artifact:
        AeWdog_Ip_Cfg_h: artifact-descriptor={short-label=generate::include::AeWdog_Ip_Cfg.h, category=SWHDR}, usages=COMPILE
        AeWdog_Ip_Cfg_Defines_h: artifact-descriptor={short-label=generate::include::AeWdog_Ip_Cfg_Defines.h, category=SWHDR}, usages=COMPILE
        AeWdog_Ip_DeviceRegisters_h: artifact-descriptor={short-label=generate::include::AeWdog_Ip_DeviceRegisters.h, category=SWHDR}, usages=COMPILE
        Swt_Ip_Cfg_h: artifact-descriptor={short-label=generate::include::Swt_Ip_Cfg.h, category=SWHDR}, usages=COMPILE
        Swt_Ip_Cfg_Defines_h: artifact-descriptor={short-label=generate::include::Swt_Ip_Cfg_Defines.h, category=SWHDR}, usages=COMPILE
        Swt_Ip_DeviceRegisters_h: artifact-descriptor={short-label=generate::include::Swt_Ip_DeviceRegisters.h, category=SWHDR}, usages=COMPILE
        Wdg_Cfg_h: artifact-descriptor={short-label=generate::include::Wdg_Cfg.h, category=SWHDR}, usages=COMPILE
        Wdg_CfgExt_h: artifact-descriptor={short-label=generate::include::Wdg_CfgExt.h, category=SWHDR}, usages=COMPILE
        Wdg_Cfg_Defines_h: artifact-descriptor={short-label=generate::include::Wdg_Cfg_Defines.h, category=SWHDR}, usages=COMPILE
        Wdg_Ipw_Cfg_Defines_h: artifact-descriptor={short-label=generate::include::Wdg_Ipw_Cfg_Defines.h, category=SWHDR}, usages=COMPILE
        Wdg_CfgExt_c: artifact-descriptor={short-label=generate::src::Wdg_CfgExt.c, category=SWSRC}, usages=COMPILE
        Wdg_43_Instance{0..4}_Lcfg_c: artifact-descriptor={short-label=generate_LT::src::Wdg_43_Instance{0..4}_Lcfg.c, category=SWSRC}, usages=LINK
        AeWdog_Ip_PBcfg_h: artifact-descriptor={short-label=generate_PB::include::AeWdog_Ip_PBcfg.h, category=SWHDR}, usages=EXECUTE
        Swt_43_Instance{0..3}_Ip_PBcfg_h: artifact-descriptor={short-label=generate_PB::include::Swt_43_Instance{0..3}_Ip_PBcfg.h, category=SWHDR}, usages=EXECUTE
        Wdg_43_Instance0_Ipw_PBcfg_h: artifact-descriptor={short-label=generate_PB::include::Wdg_43_Instance0_Ipw_PBcfg.h, category=SWHDR}, usages=EXECUTE
        Wdg_43_Instance0_PBcfg_h: artifact-descriptor={short-label=generate_PB::include::Wdg_43_Instance0_PBcfg.h, category=SWHDR}, usages=EXECUTE
        Wdg_43_Instance1_Ipw_PBcfg_h: artifact-descriptor={short-label=generate_PB::include::Wdg_43_Instance1_Ipw_PBcfg.h, category=SWHDR}, usages=EXECUTE
        Wdg_43_Instance1_PBcfg_h: artifact-descriptor={short-label=generate_PB::include::Wdg_43_Instance1_PBcfg.h, category=SWHDR}, usages=EXECUTE
        Wdg_43_Instance2_Ipw_PBcfg_h: artifact-descriptor={short-label=generate_PB::include::Wdg_43_Instance2_Ipw_PBcfg.h, category=SWHDR}, usages=EXECUTE
        Wdg_43_Instance2_PBcfg_h: artifact-descriptor={short-label=generate_PB::include::Wdg_43_Instance2_PBcfg.h, category=SWHDR}, usages=EXECUTE
        Wdg_43_Instance3_Ipw_PBcfg_h: artifact-descriptor={short-label=generate_PB::include::Wdg_43_Instance3_Ipw_PBcfg.h, category=SWHDR}, usages=EXECUTE
        Wdg_43_Instance3_PBcfg_h: artifact-descriptor={short-label=generate_PB::include::Wdg_43_Instance3_PBcfg.h, category=SWHDR}, usages=EXECUTE
        Wdg_43_Instance4_Ipw_PBcfg_h: artifact-descriptor={short-label=generate_PB::include::Wdg_43_Instance4_Ipw_PBcfg.h, category=SWHDR}, usages=EXECUTE
        Wdg_43_Instance4_PBcfg_h: artifact-descriptor={short-label=generate_PB::include::Wdg_43_Instance4_PBcfg.h, category=SWHDR}, usages=EXECUTE
        AeWdog_Ip_PBcfg_c: artifact-descriptor={short-label=generate_PB::src::AeWdog_Ip_PBcfg.c, category=SWSRC}, usages=EXECUTE
        Swt_43_Instance{0..3}_Ip_PBcfg_c: artifact-descriptor={short-label=generate_PB::src::Swt_43_Instance{0..3}_Ip_PBcfg.c, category=SWSRC}, usages=EXECUTE
        Wdg_43_Instance0_Ipw_PBcfg_c: artifact-descriptor={short-label=generate_PB::src::Wdg_43_Instance0_Ipw_PBcfg.c, category=SWSRC}, usages=EXECUTE
        Wdg_43_Instance0_PBcfg_c: artifact-descriptor={short-label=generate_PB::src::Wdg_43_Instance0_PBcfg.c, category=SWSRC}, usages=EXECUTE
        Wdg_43_Instance1_Ipw_PBcfg_c: artifact-descriptor={short-label=generate_PB::src::Wdg_43_Instance1_Ipw_PBcfg.c, category=SWSRC}, usages=EXECUTE
        Wdg_43_Instance1_PBcfg_c: artifact-descriptor={short-label=generate_PB::src::Wdg_43_Instance1_PBcfg.c, category=SWSRC}, usages=EXECUTE
        Wdg_43_Instance2_Ipw_PBcfg_c: artifact-descriptor={short-label=generate_PB::src::Wdg_43_Instance2_Ipw_PBcfg.c, category=SWSRC}, usages=EXECUTE
        Wdg_43_Instance2_PBcfg_c: artifact-descriptor={short-label=generate_PB::src::Wdg_43_Instance2_PBcfg.c, category=SWSRC}, usages=EXECUTE
        Wdg_43_Instance3_Ipw_PBcfg_c: artifact-descriptor={short-label=generate_PB::src::Wdg_43_Instance3_Ipw_PBcfg.c, category=SWSRC}, usages=EXECUTE
        Wdg_43_Instance3_PBcfg_c: artifact-descriptor={short-label=generate_PB::src::Wdg_43_Instance3_PBcfg.c, category=SWSRC}, usages=EXECUTE
        Wdg_43_Instance4_Ipw_PBcfg_c: artifact-descriptor={short-label=generate_PB::src::Wdg_43_Instance4_Ipw_PBcfg.c, category=SWSRC}, usages=EXECUTE
        Wdg_43_Instance4_PBcfg_c: artifact-descriptor={short-label=generate_PB::src::Wdg_43_Instance4_PBcfg.c, category=SWSRC}, usages=EXECUTE
        Wdg_43_Instance{0..4}_Cfg_c: artifact-descriptor={short-label=generate_PC::src::Wdg_43_Instance{0..4}_Cfg.c, category=SWSRC}, usages=COMPILE
    4 x linker:
      DIAB_Linker: name=Windriver Diab, options=-e Reset_Handler linker_script_file.dld -m30 -Xstack-usage -Xpreprocess-lecl -Llibrary_path -lc -lm -tARMCORTEXM7MG:simple, vendor=Windriver, version=Wind River Diab Compiler v7.0.4
      GCC_Linker: name=GCC Compiler, options=-Wl,-Map,filename -T linkerfile --entry=Reset_Handler -nostartfiles -mcpu=cortexm7 -mthumb -mfpu=fpv5-sp-d16 -mfloat-abi=hard -mlittle-endian -ggdb3 -lc -lm -lgcc -specs=nano.specs -specs=nosys.specs, vendor=GCC Systems, version=NXP GCC 10.2.0 20200723
      GHS_Linker: name=Green Hills, options=-e Reset_Handler -T linker_script_file.ld -map -keepmap -Mn -delete -ignore_debug_references -Llibrary_path -larch -lstartup -lind_sd -v -keep=C40_Ip_AccessCode -nostartfiles, vendor=Green Hills, version=Green Hills Multi 7.1.6d / Compiler 2021.1.4
      IAR_Linker: name=IAR Compiler, options=--map filename --config linkerfile --cpu=Cortex-M7 --fpu VFPv5-SP --entry _start --enable_stack_usage --skip_dynamic_initialization --no_wrap_diagnostics, vendor=IAR Systems, version=IAR ANSI C/C++ Compiler v.8.50.10 (safety version)
    resource consumption ResourceConsumption
      9 x memory section:
        WDG_CODE: alignment=UNSPECIFIED, sw-addrmethod=CODE, symbol=CODE
        WDG_CONFIG_DATA_16: alignment=16, sw-addrmethod=CONFIG_DATA, symbol=CONFIG_DATA_16
        WDG_CONFIG_DATA_32: alignment=32, sw-addrmethod=CONFIG_DATA, symbol=CONFIG_DATA_32
        WDG_CONFIG_DATA_UNSPECIFIED: alignment=UNSPECIFIED, sw-addrmethod=CONFIG_DATA, symbol=CONFIG_DATA_UNSPECIFIED
        WDG_CONST_UNSPECIFIED: alignment=UNSPECIFIED, sw-addrmethod=CONST, symbol=CONST_UNSPECIFIED
        WDG_RAMCODE: alignment=UNSPECIFIED, sw-addrmethod=RAMCODE, symbol=RAMCODE
        WDG_VAR_CLEARED_32: alignment=32, sw-addrmethod=VAR_CLEARED, symbol=VAR_CLEARED_32
        WDG_VAR_CLEARED_UNSPECIFIED: alignment=UNSPECIFIED, sw-addrmethod=VAR_CLEARED, symbol=VAR_CLEARED_UNSPECIFIED
        WDG_VAR_INIT_UNSPECIFIED: alignment=UNSPECIFIED, sw-addrmethod=VAR_INIT, symbol=VAR_INIT_UNSPECIFIED
