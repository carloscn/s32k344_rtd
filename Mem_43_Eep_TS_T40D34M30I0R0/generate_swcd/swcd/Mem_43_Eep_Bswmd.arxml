AUTOSAR XML (schema 00050)
package /AUTOSAR_Mem_43_Eep/BswModuleDescriptions
  bsw module description Mem: module-id=90
    provided-entrys:
      Mem_43_Eep_BlankCheck
      Mem_43_Eep_DeInit
      Mem_43_Eep_Erase
      Mem_43_Eep_GetJobResult
      Mem_43_Eep_GetVersionInfo
      Mem_43_Eep_HwSpecificService
      Mem_43_Eep_Init
      Mem_43_Eep_MainFunction
      Mem_43_Eep_PropagateError
      Mem_43_Eep_Read
      Mem_43_Eep_Resume
      Mem_43_Eep_Suspend
      Mem_43_Eep_Write
      uSDHC0_Isr
    bsw internal behavior InternalBehavior_0
      7 x bsw called entity:
        Mem_43_Eep_BlankCheck: implemented-entry=Mem_43_Eep_BlankCheck
        Mem_43_Eep_DeInit: implemented-entry=Mem_43_Eep_DeInit
        Mem_43_Eep_Erase: implemented-entry=Mem_43_Eep_Erase
        Mem_43_Eep_GetJobResult: implemented-entry=Mem_43_Eep_GetJobResult
        Mem_43_Eep_GetVersionInfo: implemented-entry=Mem_43_Eep_GetVersionInfo
        Mem_43_Eep_HwSpecificService: implemented-entry=Mem_43_Eep_HwSpecificService
        Mem_43_Eep_Init: implemented-entry=Mem_43_Eep_Init
      bsw schedulable entity Mem_43_Eep_MainFunction: implemented-entry=Mem_43_Eep_MainFunction
      5 x bsw called entity:
        Mem_43_Eep_PropagateError: implemented-entry=Mem_43_Eep_PropagateError
        Mem_43_Eep_Read: implemented-entry=Mem_43_Eep_Read
        Mem_43_Eep_Resume: implemented-entry=Mem_43_Eep_Resume
        Mem_43_Eep_Suspend: implemented-entry=Mem_43_Eep_Suspend
        Mem_43_Eep_Write: implemented-entry=Mem_43_Eep_Write
      bsw interrupt entity uSDHC0_Isr: implemented-entry=uSDHC0_Isr, interrupt-category=CAT-2, interrupt-source=Hardware
      bsw timing event Mem_43_Eep_TimingEvent_MainFunction: starts-on-event=Mem_43_Eep_MainFunction, period=0
package /AUTOSAR_Mem_43_Eep/BswModuleEntrys
  14 x bsw module entry, all with sw-service-impl-policy=STANDARD:
    Mem_43_Eep_BlankCheck: service-id=0x9, is-reentrant=false, is-synchronous=false, call-type=REGULAR, execution-context=UNSPECIFIED
    Mem_43_Eep_DeInit: service-id=0x0b, is-reentrant=false, is-synchronous=true, call-type=REGULAR, execution-context=UNSPECIFIED
    Mem_43_Eep_Erase: service-id=0x07, is-reentrant=false, is-synchronous=false, call-type=REGULAR, execution-context=UNSPECIFIED
    Mem_43_Eep_GetJobResult: service-id=0x04, is-reentrant=false, is-synchronous=true, call-type=REGULAR, execution-context=UNSPECIFIED
    Mem_43_Eep_GetVersionInfo: service-id=0x02, is-reentrant=true, is-synchronous=true, call-type=REGULAR, execution-context=UNSPECIFIED
    Mem_43_Eep_HwSpecificService: service-id=0x0a, is-reentrant=false, is-synchronous=false, call-type=REGULAR, execution-context=UNSPECIFIED
    Mem_43_Eep_Init: service-id=0x01, is-reentrant=false, is-synchronous=true, call-type=REGULAR, execution-context=UNSPECIFIED
    Mem_43_Eep_MainFunction: service-id=0x03, is-reentrant=false, is-synchronous=true, call-type=SCHEDULED, execution-context=TASK
    Mem_43_Eep_PropagateError: service-id=0x08, is-reentrant=false, is-synchronous=true, call-type=REGULAR, execution-context=UNSPECIFIED
    Mem_43_Eep_Read: service-id=0x05, is-reentrant=false, is-synchronous=false, call-type=REGULAR, execution-context=UNSPECIFIED
    Mem_43_Eep_Resume: service-id=0x0d, is-reentrant=false, is-synchronous=true, call-type=REGULAR, execution-context=UNSPECIFIED
    Mem_43_Eep_Suspend: service-id=0x0c, is-reentrant=false, is-synchronous=true, call-type=REGULAR, execution-context=UNSPECIFIED
    Mem_43_Eep_Write: service-id=0x06, is-reentrant=false, is-synchronous=false, call-type=REGULAR, execution-context=UNSPECIFIED
    uSDHC0_Isr: service-id=0, is-reentrant=false, is-synchronous=true, call-type=INTERRUPT, execution-context=INTERRUPT-CAT-2
package /Mem_43_Eep_TS_T40D34M30I0R0/Implementations
  bsw implementation BswImplementation_0: programming-language=C, sw-version=3.0.0, vendor-id=43, ar-release-version=4.7.0, behavior=InternalBehavior_0, vendor-api-infix=Eep, vendor-specific-module-def=Mem
    code-descriptors:
      code Files
        artifact-descriptors:
          short-label=config::Mem_43_Eep.xdm, category=SWCFG
          short-label=doc::RTD_MEM_43_EEP_IM.pdf, category=SWDOC
          short-label=doc::RTD_MEM_43_EEP_UM.pdf, category=SWDOC
          short-label=examples::EBT::S32K358::Mem_Eep_Example_S32K358::generate::epc::BaseNXP.xdm, category=SWCFG
          short-label=examples::EBT::S32K358::Mem_Eep_Example_S32K358::generate::epc::Dem.xdm, category=SWCFG
          short-label=examples::EBT::S32K358::Mem_Eep_Example_S32K358::generate::epc::EcuC.xdm, category=SWCFG
          short-label=examples::EBT::S32K358::Mem_Eep_Example_S32K358::generate::epc::Mcu.xdm, category=SWCFG
          short-label=examples::EBT::S32K358::Mem_Eep_Example_S32K358::generate::epc::Mem_43_Eep.xdm, category=SWCFG
          short-label=examples::EBT::S32K358::Mem_Eep_Example_S32K358::generate::epc::Os.xdm, category=SWCFG
          short-label=examples::EBT::S32K358::Mem_Eep_Example_S32K358::generate::epc::Platform.xdm, category=SWCFG
          short-label=examples::EBT::S32K358::Mem_Eep_Example_S32K358::generate::epc::Resource.xdm, category=SWCFG
          short-label=examples::EBT::S32K358::Mem_Eep_Example_S32K358::include::check_example.h, category=SWHDR
          short-label=examples::EBT::S32K358::Mem_Eep_Example_S32K358::src::main.c, category=SWSRC
          short-label=examples::EBT::S32K358::Mem_Eep_Example_S32K358::TresosProject::Mem_Eep_Example_S32K358::.prefs::preferences.xdm, category=SWCFG
          short-label=examples::EBT::S32K358::Mem_Eep_Example_S32K358::TresosProject::Mem_Eep_Example_S32K358::config::BaseNXP.xdm, category=SWCFG
          short-label=examples::EBT::S32K358::Mem_Eep_Example_S32K358::TresosProject::Mem_Eep_Example_S32K358::config::Dem.xdm, category=SWCFG
          short-label=examples::EBT::S32K358::Mem_Eep_Example_S32K358::TresosProject::Mem_Eep_Example_S32K358::config::EcuC.xdm, category=SWCFG
          short-label=examples::EBT::S32K358::Mem_Eep_Example_S32K358::TresosProject::Mem_Eep_Example_S32K358::config::Mcu.xdm, category=SWCFG
          short-label=examples::EBT::S32K358::Mem_Eep_Example_S32K358::TresosProject::Mem_Eep_Example_S32K358::config::Mem_43_Eep.xdm, category=SWCFG
          short-label=examples::EBT::S32K358::Mem_Eep_Example_S32K358::TresosProject::Mem_Eep_Example_S32K358::config::Os.xdm, category=SWCFG
          short-label=examples::EBT::S32K358::Mem_Eep_Example_S32K358::TresosProject::Mem_Eep_Example_S32K358::config::Platform.xdm, category=SWCFG
          short-label=examples::EBT::S32K358::Mem_Eep_Example_S32K358::TresosProject::Mem_Eep_Example_S32K358::config::Resource.xdm, category=SWCFG
          short-label=examples::S32DS::S32K358::Mem_Eep_Example_S32K358::include::check_example.h, category=SWHDR
          short-label=examples::S32DS::S32K358::Mem_Eep_Example_S32K358::Project_Settings::Startup_Code::exceptions.c, category=SWSRC
          short-label=examples::S32DS::S32K358::Mem_Eep_Example_S32K358::Project_Settings::Startup_Code::nvic.c, category=SWSRC
          short-label=examples::S32DS::S32K358::Mem_Eep_Example_S32K358::Project_Settings::Startup_Code::startup.c, category=SWSRC
          short-label=examples::S32DS::S32K358::Mem_Eep_Example_S32K358::Project_Settings::Startup_Code::system.c, category=SWSRC
          short-label=examples::S32DS::S32K358::Mem_Eep_Example_S32K358::src::main.c, category=SWSRC
          short-label=examples::S32DS::S32K358::Usdhc_Ip_Example_S32K358::include::check_example.h, category=SWHDR
          short-label=examples::S32DS::S32K358::Usdhc_Ip_Example_S32K358::Project_Settings::Startup_Code::exceptions.c, category=SWSRC
          short-label=examples::S32DS::S32K358::Usdhc_Ip_Example_S32K358::Project_Settings::Startup_Code::nvic.c, category=SWSRC
          short-label=examples::S32DS::S32K358::Usdhc_Ip_Example_S32K358::Project_Settings::Startup_Code::startup.c, category=SWSRC
          short-label=examples::S32DS::S32K358::Usdhc_Ip_Example_S32K358::Project_Settings::Startup_Code::system.c, category=SWSRC
          short-label=examples::S32DS::S32K358::Usdhc_Ip_Example_S32K358::src::main.c, category=SWSRC
          short-label=include::Mem_43_Eep.h, category=SWHDR
          short-label=include::Mem_43_Eep_InternalTypes.h, category=SWHDR
          short-label=include::Mem_43_Eep_IPW.h, category=SWHDR
          short-label=include::Mem_43_Eep_Types.h, category=SWHDR
          short-label=include::Sd_Emmc_Ip.h, category=SWHDR
          short-label=include::Sd_Emmc_Ip_Types.h, category=SWHDR
          short-label=include::Usdhc_Ip.h, category=SWHDR
          short-label=include::Usdhc_Ip_Types.h, category=SWHDR
          short-label=src::Mem_43_Eep.c, category=SWSRC
          short-label=src::Mem_43_Eep_IPW.c, category=SWSRC
          short-label=src::Sd_Emmc_Ip.c, category=SWSRC
          short-label=src::Usdhc_Ip.c, category=SWSRC
    4 x compiler:
      DIAB_Compiler:
        name=Windriver Diab
        options=-tARMCORTEXM7MG:simple -mthumb -std=c99 -Oz -g -fstandalone-debug -Wstrict-prototypes -Wsign-compare -Wdouble-promotion -Wunknown-pragmas -Wundef -Wextra -Wall -pedantic -Werror=implicit-function-declaration -fno-common -fno-signed-char -fno-trigraphs -V -c -DS32K3XX -D $ (DERIVATIVE) -DDIAB -DUSE_SW_VECTOR_MODE -DD_CACHE_ENABLE -DI_CACHE_ENABLE -DENABLE_FPU -DMCAL_ENABLE_USER_MODE_SUPPORT
        vendor=Windriver
        version=Wind River Diab Compiler v7.0.4
      GCC_Compiler:
        name=GCC Compiler
        options=-mcpu=cortex-m7 -mthumb -mlittle-endian -mfpu=fpv5-sp-d16 -mfloat-abi=hard -std=c99 -Os -ggdb3 -Wall -Wextra -pedantic -Wstrict-prototypes -Wundef -Wunused -Werror=implicit-function-declaration -Wsign-compare -Wdouble-promotion -fno-short-enums -funsigned-char -funsigned-bitfields -fno-common -fstack-usage -fdump-ipa-all -c -DS32K3XX -D $ (DERIVATIVE) -DGCC -DUSE_SW_VECTOR_MODE -DD_CACHE_ENABLE -DI_CACHE_ENABLE -DENABLE_FPU -DMCAL_ENABLE_USER_MODE_SUPPORT --sysroot=$(NEWLIB_DIR) -specs=nano.specs -specs=nosys.specs
        vendor=GCC Systems
        version=NXP GCC 10.2.0 20200723
      GHS_Compiler:
        name=Green Hills
        options=-cpu=cortexm7 -thumb -fpu=vfpv5_d16 -fsingle -C99 --ghstd=last -Osize --gnu_asm -dual_debug -G -keeptempfiles -Wimplicit-int -Wshadow -Wtrigraphs -Wundef --unsigned_chars --unsigned_fields --no_commons --no_exceptions --no_slash_comment --prototype_errors --incorrect_pragma_warnings -c -DS32K3XX -D $ (DERIVATIVE) -DGHS -DUSE_SW_VECTOR_MODE -DD_CACHE_ENABLE -DI_CACHE_ENABLE -DENABLE_FPU -DMCAL_ENABLE_USER_MODE_SUPPORT
        vendor=Green Hills
        version=Green Hills Multi 7.1.6d / Compiler 2021.1.4
      IAR_Compiler:
        name=IAR Compiler
        options=--cpu Cortex-M7 --cpu_mode thumb --endian little --fpu VFPv5-SP -e -Ohz --debug --no_clustering --no_mem_idioms --do_explicit_zero_opt_in_named_sections --require_prototypes --no_wrap_diagnostics --diag_suppress Pa050 -DS32K3XX -D $ (DERIVATIVE) -DIAR -DUSE_SW_VECTOR_MODE -DD_CACHE_ENABLE -DI_CACHE_ENABLE -DENABLE_FPU -DMCAL_ENABLE_USER_MODE_SUPPORT
        vendor=IAR Systems
        version=IAR ANSI C/C++ Compiler v.8.50.10 (safety version)
    generated-artifacts:
      7 x dependency on artifact, all with usages=COMPILE:
        Mem_43_Eep_Cfg_h: artifact-descriptor={short-label=generate_PC::include::Mem_43_Eep_Cfg.h, category=SWHDR}
        Sd_Emmc_Ip_Cfg_h: artifact-descriptor={short-label=generate_PC::include::Sd_Emmc_Ip_Cfg.h, category=SWHDR}
        Usdhc_Ip_Cfg_h: artifact-descriptor={short-label=generate_PC::include::Usdhc_Ip_Cfg.h, category=SWHDR}
        Usdhc_Ip_DeviceRegisters_h: artifact-descriptor={short-label=generate_PC::include::Usdhc_Ip_DeviceRegisters.h, category=SWHDR}
        Mem_43_Eep_Cfg_c: artifact-descriptor={short-label=generate_PC::src::Mem_43_Eep_Cfg.c, category=SWSRC}
        Sd_Emmc_Ip_Cfg_c: artifact-descriptor={short-label=generate_PC::src::Sd_Emmc_Ip_Cfg.c, category=SWSRC}
        Usdhc_Ip_Cfg_c: artifact-descriptor={short-label=generate_PC::src::Usdhc_Ip_Cfg.c, category=SWSRC}
    4 x linker:
      DIAB_Linker: name=Windriver Diab, options=-e Reset_Handler linker_script_file.dld -m30 -Xstack-usage -Xpreprocess-lecl -Llibrary_path -lc -lm -tARMCORTEXM7MG:simple, vendor=Windriver, version=Wind River Diab Compiler v7.0.4
      GCC_Linker: name=GCC Compiler, options=-Wl,-Map,filename -T linkerfile --entry=Reset_Handler -nostartfiles -mcpu=cortexm7 -mthumb -mfpu=fpv5-sp-d16 -mfloat-abi=hard -mlittle-endian -ggdb3 -lc -lm -lgcc -specs=nano.specs -specs=nosys.specs, vendor=GCC Systems, version=NXP GCC 10.2.0 20200723
      GHS_Linker: name=Green Hills, options=-e Reset_Handler -T linker_script_file.ld -map -keepmap -Mn -delete -ignore_debug_references -Llibrary_path -larch -lstartup -lind_sd -v -keep=C40_Ip_AccessCode -nostartfiles, vendor=Green Hills, version=Green Hills Multi 7.1.6d / Compiler 2021.1.4
      IAR_Linker: name=IAR Compiler, options=--map filename --config linkerfile --cpu=Cortex-M7 --fpu VFPv5-SP --entry _start --enable_stack_usage --skip_dynamic_initialization --no_wrap_diagnostics, vendor=IAR Systems, version=IAR ANSI C/C++ Compiler v.8.50.10 (safety version)
    resource consumption ResourceConsumption
      11 x memory section:
        MEM_43_EEP_CODE: alignment=43, sw-addrmethod=CODE, symbol=CODE
        MEM_43_EEP_CONFIG_DATA_UNSPECIFIED: alignment=43, sw-addrmethod=CONFIG_DATA, symbol=CONFIG_DATA_UNSPECIFIED
        MEM_43_EEP_CONST_UNSPECIFIED: alignment=43, sw-addrmethod=CONST, symbol=CONST_UNSPECIFIED
        MEM_43_EEP_VAR_CLEARED_32: alignment=32, sw-addrmethod=VAR_CLEARED, symbol=VAR_CLEARED_32
        MEM_43_EEP_VAR_CLEARED_32_NO_CACHEABLE: alignment=32, sw-addrmethod=VAR_CLEARED_NO_CACHEABLE, symbol=VAR_CLEARED_32_NO_CACHEABLE
        MEM_43_EEP_VAR_CLEARED_8: alignment=8, sw-addrmethod=VAR_CLEARED, symbol=VAR_CLEARED_8
        MEM_43_EEP_VAR_CLEARED_8_NO_CACHEABLE: alignment=8, sw-addrmethod=VAR_CLEARED_NO_CACHEABLE, symbol=VAR_CLEARED_8_NO_CACHEABLE
        MEM_43_EEP_VAR_CLEARED_BOOLEAN: alignment=BOOLEAN, sw-addrmethod=VAR_CLEARED, symbol=VAR_CLEARED_BOOLEAN
        MEM_43_EEP_VAR_CLEARED_UNSPECIFIED: alignment=43, sw-addrmethod=VAR_CLEARED, symbol=VAR_CLEARED_UNSPECIFIED
        MEM_43_EEP_VAR_INIT_BOOLEAN: alignment=BOOLEAN, sw-addrmethod=VAR_INIT, symbol=VAR_INIT_BOOLEAN
        MEM_43_EEP_VAR_INIT_UNSPECIFIED: alignment=43, sw-addrmethod=VAR_INIT, symbol=VAR_INIT_UNSPECIFIED
