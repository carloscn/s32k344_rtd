AUTOSAR XML (schema 00050)
package /AUTOSAR_Mem_43_ExFls/BswModuleDescriptions
  bsw module description Mem: module-id=91
    provided-entrys:
      Mem_BlankCheck
      Mem_DeInit
      Mem_Erase
      Mem_GetJobResult
      Mem_GetVersionInfo
      Mem_HwSpecificService
      Mem_Init
      Mem_MainFunction
      Mem_PropagateError
      Mem_Read
      Mem_Resume
      Mem_Suspend
      Mem_Write
    bsw internal behavior InternalBehavior_0
      4 x exclusive area:
        MEM_EXCLUSIVE_AREA_{10..12}
        MEM_EXCLUSIVE_AREA_14
      7 x bsw called entity:
        Mem_43_ExFls_BlankCheck: can-enter-exclusive-area=MEM_EXCLUSIVE_AREA_14, implemented-entry=Mem_BlankCheck
        Mem_43_ExFls_DeInit: implemented-entry=Mem_DeInit
        Mem_43_ExFls_Erase: can-enter-exclusive-area=MEM_EXCLUSIVE_AREA_10, implemented-entry=Mem_Erase
        Mem_43_ExFls_GetJobResult: implemented-entry=Mem_GetJobResult
        Mem_43_ExFls_GetVersionInfo: implemented-entry=Mem_GetVersionInfo
        Mem_43_ExFls_HwSpecificService: implemented-entry=Mem_HwSpecificService
        Mem_43_ExFls_Init: implemented-entry=Mem_Init
      bsw schedulable entity Mem_43_ExFls_MainFunction: implemented-entry=Mem_MainFunction
      5 x bsw called entity:
        Mem_43_ExFls_PropagateError: implemented-entry=Mem_PropagateError
        Mem_43_ExFls_Read: can-enter-exclusive-area=MEM_EXCLUSIVE_AREA_12, implemented-entry=Mem_Read
        Mem_43_ExFls_Resume: implemented-entry=Mem_Resume
        Mem_43_ExFls_Suspend: implemented-entry=Mem_Suspend
        Mem_43_ExFls_Write: can-enter-exclusive-area=MEM_EXCLUSIVE_AREA_11, implemented-entry=Mem_Write
      bsw timing event Mem_43_ExFls_TimingEvent_MainFunction: starts-on-event=Mem_43_ExFls_MainFunction, period=0
package /AUTOSAR_Mem_43_ExFls/BswModuleEntrys
  13 x bsw module entry, all with sw-service-impl-policy=STANDARD:
    Mem_BlankCheck: service-id=0x9, is-reentrant=false, is-synchronous=false, call-type=REGULAR, execution-context=UNSPECIFIED
    Mem_DeInit: service-id=0x0b, is-reentrant=false, is-synchronous=true, call-type=REGULAR, execution-context=UNSPECIFIED
    Mem_Erase: service-id=0x07, is-reentrant=false, is-synchronous=false, call-type=REGULAR, execution-context=UNSPECIFIED
    Mem_GetJobResult: service-id=0x04, is-reentrant=false, is-synchronous=true, call-type=REGULAR, execution-context=UNSPECIFIED
    Mem_GetVersionInfo: service-id=0x02, is-reentrant=true, is-synchronous=true, call-type=REGULAR, execution-context=UNSPECIFIED
    Mem_HwSpecificService: service-id=0x0a, is-reentrant=false, is-synchronous=false, call-type=REGULAR, execution-context=UNSPECIFIED
    Mem_Init: service-id=0x01, is-reentrant=false, is-synchronous=true, call-type=REGULAR, execution-context=UNSPECIFIED
    Mem_MainFunction: service-id=0x03, is-reentrant=false, is-synchronous=true, call-type=SCHEDULED, execution-context=TASK
    Mem_PropagateError: service-id=0x08, is-reentrant=false, is-synchronous=true, call-type=REGULAR, execution-context=UNSPECIFIED
    Mem_Read: service-id=0x05, is-reentrant=false, is-synchronous=false, call-type=REGULAR, execution-context=UNSPECIFIED
    Mem_Resume: service-id=0x0d, is-reentrant=false, is-synchronous=true, call-type=REGULAR, execution-context=UNSPECIFIED
    Mem_Suspend: service-id=0x0c, is-reentrant=false, is-synchronous=true, call-type=REGULAR, execution-context=UNSPECIFIED
    Mem_Write: service-id=0x06, is-reentrant=false, is-synchronous=false, call-type=REGULAR, execution-context=UNSPECIFIED
package /Mem_43_ExFls_TS_T40D34M30I0R0/Implementations
  bsw implementation BswImplementation_0: programming-language=C, sw-version=3.0.0, vendor-id=43, ar-release-version=4.7.0, behavior=InternalBehavior_0, vendor-api-infix=ExFls, vendor-specific-module-def=Mem
    code-descriptors:
      code Files
        artifact-descriptors:
          short-label=config::Mem_43_ExFls.xdm, category=SWCFG
          short-label=doc::RTD_MEM_43_EXFLS_IM.pdf, category=SWDOC
          short-label=doc::RTD_MEM_43_EXFLS_UM.pdf, category=SWDOC
          short-label=examples::EBT::S32K358::Mem_43_ExFls_Example_S32K358::generate::epc::BaseNXP.xdm, category=SWCFG
          short-label=examples::EBT::S32K358::Mem_43_ExFls_Example_S32K358::generate::epc::EcuC.xdm, category=SWCFG
          short-label=examples::EBT::S32K358::Mem_43_ExFls_Example_S32K358::generate::epc::Mem_43_ExFls.xdm, category=SWCFG
          short-label=examples::EBT::S32K358::Mem_43_ExFls_Example_S32K358::generate::epc::Resource.xdm, category=SWCFG
          short-label=examples::EBT::S32K358::Mem_43_ExFls_Example_S32K358::include::check_example.h, category=SWHDR
          short-label=examples::EBT::S32K358::Mem_43_ExFls_Example_S32K358::src::main.c, category=SWSRC
          short-label=examples::EBT::S32K358::Mem_43_ExFls_Example_S32K358::TresosProject::Mem_43_ExFls_Example_S32K358::.prefs::preferences.xdm, category=SWCFG
          short-label=examples::EBT::S32K358::Mem_43_ExFls_Example_S32K358::TresosProject::Mem_43_ExFls_Example_S32K358::config::BaseNXP.xdm, category=SWCFG
          short-label=examples::EBT::S32K358::Mem_43_ExFls_Example_S32K358::TresosProject::Mem_43_ExFls_Example_S32K358::config::EcuC.xdm, category=SWCFG
          short-label=examples::EBT::S32K358::Mem_43_ExFls_Example_S32K358::TresosProject::Mem_43_ExFls_Example_S32K358::config::Mem_43_ExFls.xdm, category=SWCFG
          short-label=examples::EBT::S32K358::Mem_43_ExFls_Example_S32K358::TresosProject::Mem_43_ExFls_Example_S32K358::config::Resource.xdm, category=SWCFG
          short-label=examples::EBT::S32K396::Mem_43_ExFls_Example_S32K396::generate::epc::BaseNXP.xdm, category=SWCFG
          short-label=examples::EBT::S32K396::Mem_43_ExFls_Example_S32K396::generate::epc::EcuC.xdm, category=SWCFG
          short-label=examples::EBT::S32K396::Mem_43_ExFls_Example_S32K396::generate::epc::Mem_43_ExFls.xdm, category=SWCFG
          short-label=examples::EBT::S32K396::Mem_43_ExFls_Example_S32K396::generate::epc::Resource.xdm, category=SWCFG
          short-label=examples::EBT::S32K396::Mem_43_ExFls_Example_S32K396::include::check_example.h, category=SWHDR
          short-label=examples::EBT::S32K396::Mem_43_ExFls_Example_S32K396::src::main.c, category=SWSRC
          short-label=examples::EBT::S32K396::Mem_43_ExFls_Example_S32K396::TresosProject::Mem_43_ExFls_Example_S32K396::.prefs::preferences.xdm, category=SWCFG
          short-label=examples::EBT::S32K396::Mem_43_ExFls_Example_S32K396::TresosProject::Mem_43_ExFls_Example_S32K396::config::BaseNXP.xdm, category=SWCFG
          short-label=examples::EBT::S32K396::Mem_43_ExFls_Example_S32K396::TresosProject::Mem_43_ExFls_Example_S32K396::config::EcuC.xdm, category=SWCFG
          short-label=examples::EBT::S32K396::Mem_43_ExFls_Example_S32K396::TresosProject::Mem_43_ExFls_Example_S32K396::config::Mem_43_ExFls.xdm, category=SWCFG
          short-label=examples::EBT::S32K396::Mem_43_ExFls_Example_S32K396::TresosProject::Mem_43_ExFls_Example_S32K396::config::Resource.xdm, category=SWCFG
          short-label=examples::EBT::S32K3XX::Mem_43_ExFls_Example_S32K344::generate::epc::BaseNXP.xdm, category=SWCFG
          short-label=examples::EBT::S32K3XX::Mem_43_ExFls_Example_S32K344::generate::epc::EcuC.xdm, category=SWCFG
          short-label=examples::EBT::S32K3XX::Mem_43_ExFls_Example_S32K344::generate::epc::Mem_43_ExFls.xdm, category=SWCFG
          short-label=examples::EBT::S32K3XX::Mem_43_ExFls_Example_S32K344::generate::epc::Resource.xdm, category=SWCFG
          short-label=examples::EBT::S32K3XX::Mem_43_ExFls_Example_S32K344::include::check_example.h, category=SWHDR
          short-label=examples::EBT::S32K3XX::Mem_43_ExFls_Example_S32K344::src::main.c, category=SWSRC
          short-label=examples::EBT::S32K3XX::Mem_43_ExFls_Example_S32K344::TresosProject::Mem_43_ExFls_Example_S32K344::.prefs::preferences.xdm, category=SWCFG
          short-label=examples::EBT::S32K3XX::Mem_43_ExFls_Example_S32K344::TresosProject::Mem_43_ExFls_Example_S32K344::config::BaseNXP.xdm, category=SWCFG
          short-label=examples::EBT::S32K3XX::Mem_43_ExFls_Example_S32K344::TresosProject::Mem_43_ExFls_Example_S32K344::config::EcuC.xdm, category=SWCFG
          short-label=examples::EBT::S32K3XX::Mem_43_ExFls_Example_S32K344::TresosProject::Mem_43_ExFls_Example_S32K344::config::Mem_43_ExFls.xdm, category=SWCFG
          short-label=examples::EBT::S32K3XX::Mem_43_ExFls_Example_S32K344::TresosProject::Mem_43_ExFls_Example_S32K344::config::Resource.xdm, category=SWCFG
          short-label=examples::S32DS::S32K358::Mem_43_ExFls_Example_S32K358::include::check_example.h, category=SWHDR
          short-label=examples::S32DS::S32K358::Mem_43_ExFls_Example_S32K358::Project_Settings::Startup_Code::exceptions.c, category=SWSRC
          short-label=examples::S32DS::S32K358::Mem_43_ExFls_Example_S32K358::Project_Settings::Startup_Code::nvic.c, category=SWSRC
          short-label=examples::S32DS::S32K358::Mem_43_ExFls_Example_S32K358::Project_Settings::Startup_Code::startup.c, category=SWSRC
          short-label=examples::S32DS::S32K358::Mem_43_ExFls_Example_S32K358::Project_Settings::Startup_Code::system.c, category=SWSRC
          short-label=examples::S32DS::S32K358::Mem_43_ExFls_Example_S32K358::src::main.c, category=SWSRC
          short-label=examples::S32DS::S32K358::Mem_43_ExFls_Example_S32K358::src::sys_init.c, category=SWSRC
          short-label=examples::S32DS::S32K358::Qspi_Ip_Example_S32K358::include::check_example.h, category=SWHDR
          short-label=examples::S32DS::S32K358::Qspi_Ip_Example_S32K358::Project_Settings::Startup_Code::exceptions.c, category=SWSRC
          short-label=examples::S32DS::S32K358::Qspi_Ip_Example_S32K358::Project_Settings::Startup_Code::nvic.c, category=SWSRC
          short-label=examples::S32DS::S32K358::Qspi_Ip_Example_S32K358::Project_Settings::Startup_Code::startup.c, category=SWSRC
          short-label=examples::S32DS::S32K358::Qspi_Ip_Example_S32K358::Project_Settings::Startup_Code::system.c, category=SWSRC
          short-label=examples::S32DS::S32K358::Qspi_Ip_Example_S32K358::src::main.c, category=SWSRC
          short-label=examples::S32DS::S32K358::Qspi_Ip_Example_S32K358::src::sys_init.c, category=SWSRC
          short-label=examples::S32DS::S32K396::Mem_43_ExFls_Example_S32K396::include::check_example.h, category=SWHDR
          short-label=examples::S32DS::S32K396::Mem_43_ExFls_Example_S32K396::Project_Settings::Startup_Code::exceptions.c, category=SWSRC
          short-label=examples::S32DS::S32K396::Mem_43_ExFls_Example_S32K396::Project_Settings::Startup_Code::nvic.c, category=SWSRC
          short-label=examples::S32DS::S32K396::Mem_43_ExFls_Example_S32K396::Project_Settings::Startup_Code::startup.c, category=SWSRC
          short-label=examples::S32DS::S32K396::Mem_43_ExFls_Example_S32K396::Project_Settings::Startup_Code::system.c, category=SWSRC
          short-label=examples::S32DS::S32K396::Mem_43_ExFls_Example_S32K396::src::main.c, category=SWSRC
          short-label=examples::S32DS::S32K396::Mem_43_ExFls_Example_S32K396::src::sys_init.c, category=SWSRC
          short-label=examples::S32DS::S32K396::Qspi_Ip_Example_S32K396::include::check_example.h, category=SWHDR
          short-label=examples::S32DS::S32K396::Qspi_Ip_Example_S32K396::Project_Settings::Startup_Code::exceptions.c, category=SWSRC
          short-label=examples::S32DS::S32K396::Qspi_Ip_Example_S32K396::Project_Settings::Startup_Code::nvic.c, category=SWSRC
          short-label=examples::S32DS::S32K396::Qspi_Ip_Example_S32K396::Project_Settings::Startup_Code::startup.c, category=SWSRC
          short-label=examples::S32DS::S32K396::Qspi_Ip_Example_S32K396::Project_Settings::Startup_Code::system.c, category=SWSRC
          short-label=examples::S32DS::S32K396::Qspi_Ip_Example_S32K396::src::main.c, category=SWSRC
          short-label=examples::S32DS::S32K396::Qspi_Ip_Example_S32K396::src::sys_init.c, category=SWSRC
          short-label=examples::S32DS::S32K3XX::Mem_43_ExFls_Example_S32K344::include::check_example.h, category=SWHDR
          short-label=examples::S32DS::S32K3XX::Mem_43_ExFls_Example_S32K344::Project_Settings::Startup_Code::exceptions.c, category=SWSRC
          short-label=examples::S32DS::S32K3XX::Mem_43_ExFls_Example_S32K344::Project_Settings::Startup_Code::nvic.c, category=SWSRC
          short-label=examples::S32DS::S32K3XX::Mem_43_ExFls_Example_S32K344::Project_Settings::Startup_Code::startup.c, category=SWSRC
          short-label=examples::S32DS::S32K3XX::Mem_43_ExFls_Example_S32K344::Project_Settings::Startup_Code::system.c, category=SWSRC
          short-label=examples::S32DS::S32K3XX::Mem_43_ExFls_Example_S32K344::src::main.c, category=SWSRC
          short-label=examples::S32DS::S32K3XX::Mem_43_ExFls_Example_S32K344::src::sys_init.c, category=SWSRC
          short-label=examples::S32DS::S32K3XX::Qspi_Ip_Example_S32K344::include::check_example.h, category=SWHDR
          short-label=examples::S32DS::S32K3XX::Qspi_Ip_Example_S32K344::Project_Settings::Startup_Code::exceptions.c, category=SWSRC
          short-label=examples::S32DS::S32K3XX::Qspi_Ip_Example_S32K344::Project_Settings::Startup_Code::nvic.c, category=SWSRC
          short-label=examples::S32DS::S32K3XX::Qspi_Ip_Example_S32K344::Project_Settings::Startup_Code::startup.c, category=SWSRC
          short-label=examples::S32DS::S32K3XX::Qspi_Ip_Example_S32K344::Project_Settings::Startup_Code::system.c, category=SWSRC
          short-label=examples::S32DS::S32K3XX::Qspi_Ip_Example_S32K344::src::main.c, category=SWSRC
          short-label=examples::S32DS::S32K3XX::Qspi_Ip_Example_S32K344::src::sys_init.c, category=SWSRC
          short-label=include::Mem_43_ExFls.h, category=SWHDR
          short-label=include::Mem_43_ExFls_Ipw.h, category=SWHDR
          short-label=include::Mem_43_ExFls_Types.h, category=SWHDR
          short-label=include::Qspi_Ip.h, category=SWHDR
          short-label=include::Qspi_Ip_Common.h, category=SWHDR
          short-label=include::Qspi_Ip_Controller.h, category=SWHDR
          short-label=include::Qspi_Ip_HwAccess.h, category=SWHDR
          short-label=include::Qspi_Ip_Hyperflash.h, category=SWHDR
          short-label=include::Qspi_Ip_HyperflashRegs.h, category=SWHDR
          short-label=include::Qspi_Ip_HyperflashTypes.h, category=SWHDR
          short-label=include::Qspi_Ip_TrustedFunctions.h, category=SWHDR
          short-label=include::Qspi_Ip_Types.h, category=SWHDR
          short-label=src::Mem_43_ExFls.c, category=SWSRC
          short-label=src::Mem_43_ExFls_Ipw.c, category=SWSRC
          short-label=src::Qspi_Ip.c, category=SWSRC
          short-label=src::Qspi_Ip_Controller.c, category=SWSRC
          short-label=src::Qspi_Ip_Hyperflash.c, category=SWSRC
          short-label=src::Qspi_Ip_Sfdp.c, category=SWSRC
    4 x compiler:
      DIAB_Compiler:
        name=Windriver Diab
        options=-tARMCORTEXM7MG:simple -mthumb -std=c99 -Oz -g -fstandalone-debug -Wstrict-prototypes -Wsign-compare -Wdouble-promotion -Wunknown-pragmas -Wundef -Wextra -Wall -pedantic -Werror=implicit-function-declaration -fno-common -fno-signed-char -fno-trigraphs -V -c -DS32K3XX -D $ (DERIVATIVE) -DDIAB -DUSE_SW_VECTOR_MODE -DD_CACHE_ENABLE -DI_CACHE_ENABLE -DENABLE_FPU -DMCAL_ENABLE_USER_MODE_SUPPORT
        vendor=Windriver
        version=Wind River Diab Compiler v7.0.4
      GCC_Compiler:
        name=GCC Compiler
        options=-mcpu=cortex-m7 -mthumb -mlittle-endian -mfpu=fpv5-sp-d16 -mfloat-abi=hard -std=c99 -Os -ggdb3 -Wall -Wextra -pedantic -Wstrict-prototypes -Wundef -Wunused -Werror=implicit-function-declaration -Wsign-compare -Wdouble-promotion -fno-short-enums -funsigned-char -funsigned-bitfields -fno-common -fstack-usage -fdump-ipa-all -c -DS32K3XX -D $ (DERIVATIVE) -DGCC -DUSE_SW_VECTOR_MODE -DD_CACHE_ENABLE -DI_CACHE_ENABLE -DENABLE_FPU -DMCAL_ENABLE_USER_MODE_SUPPORT --sysroot=$(NEWLIB_DIR) -specs=nano.specs -specs=nosys.specs
        vendor=GCC Systems
        version=NXP GCC 10.2.0 20200723
      GHS_Compiler:
        name=Green Hills
        options=-cpu=cortexm7 -thumb -fpu=vfpv5_d16 -fsingle -C99 --ghstd=last -Osize --gnu_asm -dual_debug -G -keeptempfiles -Wimplicit-int -Wshadow -Wtrigraphs -Wundef --unsigned_chars --unsigned_fields --no_commons --no_exceptions --no_slash_comment --prototype_errors --incorrect_pragma_warnings -c -DS32K3XX -D $ (DERIVATIVE) -DGHS -DUSE_SW_VECTOR_MODE -DD_CACHE_ENABLE -DI_CACHE_ENABLE -DENABLE_FPU -DMCAL_ENABLE_USER_MODE_SUPPORT
        vendor=Green Hills
        version=Green Hills Multi 7.1.6d / Compiler 2021.1.4
      IAR_Compiler:
        name=IAR Compiler
        options=--cpu Cortex-M7 --cpu_mode thumb --endian little --fpu VFPv5-SP -e -Ohz --debug --no_clustering --no_mem_idioms --do_explicit_zero_opt_in_named_sections --require_prototypes --no_wrap_diagnostics --diag_suppress Pa050 -DS32K3XX -D $ (DERIVATIVE) -DIAR -DUSE_SW_VECTOR_MODE -DD_CACHE_ENABLE -DI_CACHE_ENABLE -DENABLE_FPU -DMCAL_ENABLE_USER_MODE_SUPPORT
        vendor=IAR Systems
        version=IAR ANSI C/C++ Compiler v.8.50.10 (safety version)
    generated-artifacts:
      7 x dependency on artifact, all with usages=COMPILE:
        Mem_43_ExFls_Cfg_h: artifact-descriptor={short-label=generate_PC::include::Mem_43_ExFls_Cfg.h, category=SWHDR}
        Mem_43_ExFls_CfgDefines_h: artifact-descriptor={short-label=generate_PC::include::Mem_43_ExFls_CfgDefines.h, category=SWHDR}
        Qspi_Ip_Cfg_h: artifact-descriptor={short-label=generate_PC::include::Qspi_Ip_Cfg.h, category=SWHDR}
        Qspi_Ip_CfgDefines_h: artifact-descriptor={short-label=generate_PC::include::Qspi_Ip_CfgDefines.h, category=SWHDR}
        Qspi_Ip_Features_h: artifact-descriptor={short-label=generate_PC::include::Qspi_Ip_Features.h, category=SWHDR}
        Mem_43_ExFls_Cfg_c: artifact-descriptor={short-label=generate_PC::src::Mem_43_ExFls_Cfg.c, category=SWSRC}
        Qspi_Ip_Cfg_c: artifact-descriptor={short-label=generate_PC::src::Qspi_Ip_Cfg.c, category=SWSRC}
    4 x linker:
      DIAB_Linker: name=Windriver Diab, options=-e Reset_Handler linker_script_file.dld -m30 -Xstack-usage -Xpreprocess-lecl -Llibrary_path -lc -lm -tARMCORTEXM7MG:simple, vendor=Windriver, version=Wind River Diab Compiler v7.0.4
      GCC_Linker: name=GCC Compiler, options=-Wl,-Map,filename -T linkerfile --entry=Reset_Handler -nostartfiles -mcpu=cortexm7 -mthumb -mfpu=fpv5-sp-d16 -mfloat-abi=hard -mlittle-endian -ggdb3 -lc -lm -lgcc -specs=nano.specs -specs=nosys.specs, vendor=GCC Systems, version=NXP GCC 10.2.0 20200723
      GHS_Linker: name=Green Hills, options=-e Reset_Handler -T linker_script_file.ld -map -keepmap -Mn -delete -ignore_debug_references -Llibrary_path -larch -lstartup -lind_sd -v -keep=C40_Ip_AccessCode -nostartfiles, vendor=Green Hills, version=Green Hills Multi 7.1.6d / Compiler 2021.1.4
      IAR_Linker: name=IAR Compiler, options=--map filename --config linkerfile --cpu=Cortex-M7 --fpu VFPv5-SP --entry _start --enable_stack_usage --skip_dynamic_initialization --no_wrap_diagnostics, vendor=IAR Systems, version=IAR ANSI C/C++ Compiler v.8.50.10 (safety version)
    resource consumption ResourceConsumption
      10 x memory section:
        MEM_43_EXFLS_CODE: alignment=UNSPECIFIED, sw-addrmethod=CODE, symbol=CODE
        MEM_43_EXFLS_CONFIG_DATA_UNSPECIFIED: alignment=UNSPECIFIED, sw-addrmethod=CONFIG_DATA, symbol=CONFIG_DATA_UNSPECIFIED
        MEM_43_EXFLS_CONST_UNSPECIFIED: alignment=UNSPECIFIED, sw-addrmethod=CONST, symbol=CONST_UNSPECIFIED
        MEM_43_EXFLS_VAR_CLEARED_16: alignment=16, sw-addrmethod=VAR_CLEARED, symbol=VAR_CLEARED_16
        MEM_43_EXFLS_VAR_CLEARED_8: alignment=8, sw-addrmethod=VAR_CLEARED, symbol=VAR_CLEARED_8
        MEM_43_EXFLS_VAR_CLEARED_BOOLEAN: alignment=BOOLEAN, sw-addrmethod=VAR_CLEARED, symbol=VAR_CLEARED_BOOLEAN
        MEM_43_EXFLS_VAR_CLEARED_UNSPECIFIED: alignment=UNSPECIFIED, sw-addrmethod=VAR_CLEARED, symbol=VAR_CLEARED_UNSPECIFIED
        MEM_43_EXFLS_VAR_INIT_8: alignment=8, sw-addrmethod=VAR_INIT, symbol=VAR_INIT_8
        MEM_43_EXFLS_VAR_INIT_BOOLEAN: alignment=BOOLEAN, sw-addrmethod=VAR_INIT, symbol=VAR_INIT_BOOLEAN
        MEM_43_EXFLS_VAR_INIT_UNSPECIFIED: alignment=UNSPECIFIED, sw-addrmethod=VAR_INIT, symbol=VAR_INIT_UNSPECIFIED
