AUTOSAR XML (schema 00050)
package /AUTOSAR_Ae/BswModuleDescriptions
  bsw module description Ae: module-id=250
    provided-entrys:
      Ae_AdcMeasureConfig
      Ae_DecodeGlobalHeathStatus
      Ae_DigitalInputEventConfig
      Ae_FaultsEventsProccess
      Ae_Frame_Counter
      Ae_GetVersionInfo
      Ae_Init
      Ae_ReadFaultsEventsStatus
      Ae_ReadRegister
      Ae_VoltageMonitorConfig
      Ae_WriteRegister
      Aec_Ip_DecodeGlobalHeathStatus
      Aec_Ip_Init
      Aec_Ip_SpiRead
      Aec_Ip_SpiWrite
      Aec_Ip_Spi_Frame_Counter
      Hvm_Ip_AdcMeasureConfig
      Hvm_Ip_DigitalInputEventConfig
      Hvm_Ip_FaultsEventsProccess
      Hvm_Ip_Init
      Hvm_Ip_ReadFaultsEventsStatus
      Hvm_Ip_VoltageMonitorConfig
      AEC_Common_IRQHandler
    bsw internal behavior InternalBehavior_0
      exclusive area AE_EXCLUSIVE_AREA_00
      22 x bsw called entity:
        Ae_AdcMeasureConfig: implemented-entry=Ae_AdcMeasureConfig
        Ae_DecodeGlobalHeathStatus: implemented-entry=Ae_DecodeGlobalHeathStatus
        Ae_DigitalInputEventConfig: implemented-entry=Ae_DigitalInputEventConfig
        Ae_FaultsEventsProccess: implemented-entry=Ae_FaultsEventsProccess
        Ae_Frame_Counter: implemented-entry=Ae_Frame_Counter
        Ae_GetVersionInfo: implemented-entry=Ae_GetVersionInfo
        Ae_Init: implemented-entry=Ae_Init
        Ae_ReadFaultsEventsStatus: implemented-entry=Ae_ReadFaultsEventsStatus
        Ae_ReadRegister: can-enter-exclusive-area=AE_EXCLUSIVE_AREA_00, implemented-entry=Ae_ReadRegister
        Ae_VoltageMonitorConfig: implemented-entry=Ae_VoltageMonitorConfig
        Ae_WriteRegister: can-enter-exclusive-area=AE_EXCLUSIVE_AREA_00, implemented-entry=Ae_WriteRegister
        Aec_Ip_DecodeGlobalHeathStatus: implemented-entry=Aec_Ip_DecodeGlobalHeathStatus
        Aec_Ip_Init: implemented-entry=Aec_Ip_Init
        Aec_Ip_SpiRead: can-enter-exclusive-area=AE_EXCLUSIVE_AREA_00, implemented-entry=Aec_Ip_SpiRead
        Aec_Ip_SpiWrite: can-enter-exclusive-area=AE_EXCLUSIVE_AREA_00, implemented-entry=Aec_Ip_SpiWrite
        Aec_Ip_Spi_Frame_Counter: implemented-entry=Aec_Ip_Spi_Frame_Counter
        Hvm_Ip_AdcMeasureConfig: implemented-entry=Hvm_Ip_AdcMeasureConfig
        Hvm_Ip_DigitalInputEventConfig: implemented-entry=Hvm_Ip_DigitalInputEventConfig
        Hvm_Ip_FaultsEventsProccess: implemented-entry=Hvm_Ip_FaultsEventsProccess
        Hvm_Ip_Init: implemented-entry=Hvm_Ip_Init
        Hvm_Ip_ReadFaultsEventsStatus: implemented-entry=Hvm_Ip_ReadFaultsEventsStatus
        Hvm_Ip_VoltageMonitorConfig: implemented-entry=Hvm_Ip_VoltageMonitorConfig
      bsw interrupt entity AEC_Common_IRQHandler: implemented-entry=AEC_Common_IRQHandler, interrupt-category=CAT-2, interrupt-source=Hardware
package /AUTOSAR_Ae/BswModuleEntrys
  23 x bsw module entry, all with is-synchronous=true, sw-service-impl-policy=STANDARD:
    Ae_AdcMeasureConfig: service-id=0x05, is-reentrant=true, call-type=REGULAR, execution-context=UNSPECIFIED
    Ae_DecodeGlobalHeathStatus: service-id=0x03, is-reentrant=true, call-type=REGULAR, execution-context=UNSPECIFIED
    Ae_DigitalInputEventConfig: service-id=0x06, is-reentrant=true, call-type=REGULAR, execution-context=UNSPECIFIED
    Ae_FaultsEventsProccess: service-id=0x08, is-reentrant=true, call-type=REGULAR, execution-context=UNSPECIFIED
    Ae_Frame_Counter: service-id=0x04, is-reentrant=true, call-type=REGULAR, execution-context=UNSPECIFIED
    Ae_GetVersionInfo: service-id=0x0a, is-reentrant=true, call-type=REGULAR, execution-context=UNSPECIFIED
    Ae_Init: service-id=0x00, is-reentrant=false, call-type=REGULAR, execution-context=UNSPECIFIED
    Ae_ReadFaultsEventsStatus: service-id=0x09, is-reentrant=true, call-type=REGULAR, execution-context=UNSPECIFIED
    Ae_ReadRegister: service-id=0x01, is-reentrant=true, call-type=REGULAR, execution-context=UNSPECIFIED
    Ae_VoltageMonitorConfig: service-id=0x07, is-reentrant=true, call-type=REGULAR, execution-context=UNSPECIFIED
    Ae_WriteRegister: service-id=0x02, is-reentrant=true, call-type=REGULAR, execution-context=UNSPECIFIED
    Aec_Ip_DecodeGlobalHeathStatus: service-id=0x0e, is-reentrant=true, call-type=REGULAR, execution-context=UNSPECIFIED
    Aec_Ip_Init: service-id=0x0b, is-reentrant=true, call-type=REGULAR, execution-context=UNSPECIFIED
    Aec_Ip_SpiRead: service-id=0x0c, is-reentrant=true, call-type=REGULAR, execution-context=UNSPECIFIED
    Aec_Ip_SpiWrite: service-id=0x0d, is-reentrant=true, call-type=REGULAR, execution-context=UNSPECIFIED
    Aec_Ip_Spi_Frame_Counter: service-id=0x0f, is-reentrant=true, call-type=REGULAR, execution-context=UNSPECIFIED
    Hvm_Ip_AdcMeasureConfig: service-id=0x11, is-reentrant=true, call-type=REGULAR, execution-context=UNSPECIFIED
    Hvm_Ip_DigitalInputEventConfig: service-id=0x12, is-reentrant=true, call-type=REGULAR, execution-context=UNSPECIFIED
    Hvm_Ip_FaultsEventsProccess: service-id=0x14, is-reentrant=true, call-type=REGULAR, execution-context=UNSPECIFIED
    Hvm_Ip_Init: service-id=0x10, is-reentrant=true, call-type=REGULAR, execution-context=UNSPECIFIED
    Hvm_Ip_ReadFaultsEventsStatus: service-id=0x15, is-reentrant=true, call-type=REGULAR, execution-context=UNSPECIFIED
    Hvm_Ip_VoltageMonitorConfig: service-id=0x13, is-reentrant=true, call-type=REGULAR, execution-context=UNSPECIFIED
    AEC_Common_IRQHandler: service-id=0, is-reentrant=false, call-type=INTERRUPT, execution-context=INTERRUPT-CAT-2
package /Ae_TS_T40D34M30I0R0/Implementations
  bsw implementation BswImplementation_0: programming-language=C, sw-version=3.0.0, vendor-id=43, ar-release-version=4.7.0, behavior=InternalBehavior_0, vendor-specific-module-def=Ae
    code-descriptors:
      code Files
        artifact-descriptors:
          short-label=config::Ae.xdm, category=SWCFG
          short-label=doc::RTD_AE_IM.pdf, category=SWDOC
          short-label=doc::RTD_AE_UM.pdf, category=SWDOC
          short-label=examples::EBT::S32M276::Ae_Handler_Faults_Example_EB_001_S32M276::generate::epc::Ae.xdm, category=SWCFG
          short-label=examples::EBT::S32M276::Ae_Handler_Faults_Example_EB_001_S32M276::generate::epc::BaseNXP.xdm, category=SWCFG
          short-label=examples::EBT::S32M276::Ae_Handler_Faults_Example_EB_001_S32M276::generate::epc::Icu.xdm, category=SWCFG
          short-label=examples::EBT::S32M276::Ae_Handler_Faults_Example_EB_001_S32M276::generate::epc::Mcu.xdm, category=SWCFG
          short-label=examples::EBT::S32M276::Ae_Handler_Faults_Example_EB_001_S32M276::generate::epc::Platform.xdm, category=SWCFG
          short-label=examples::EBT::S32M276::Ae_Handler_Faults_Example_EB_001_S32M276::generate::epc::Port.xdm, category=SWCFG
          short-label=examples::EBT::S32M276::Ae_Handler_Faults_Example_EB_001_S32M276::generate::epc::Resource.xdm, category=SWCFG
          short-label=examples::EBT::S32M276::Ae_Handler_Faults_Example_EB_001_S32M276::generate::epc::Spi.xdm, category=SWCFG
          short-label=examples::EBT::S32M276::Ae_Handler_Faults_Example_EB_001_S32M276::include::check_example.h, category=SWHDR
          short-label=examples::EBT::S32M276::Ae_Handler_Faults_Example_EB_001_S32M276::src::main.c, category=SWSRC
          short-label=examples::EBT::S32M276::Ae_Handler_Faults_Example_EB_001_S32M276::TresosProject::Ae_Handler_Faults_Example_EB_001_S32M276::.prefs::preferences.xdm, category=SWCFG
          short-label=examples::EBT::S32M276::Ae_Handler_Faults_Example_EB_001_S32M276::TresosProject::Ae_Handler_Faults_Example_EB_001_S32M276::config::Ae.xdm, category=SWCFG
          short-label=examples::EBT::S32M276::Ae_Handler_Faults_Example_EB_001_S32M276::TresosProject::Ae_Handler_Faults_Example_EB_001_S32M276::config::BaseNXP.xdm, category=SWCFG
          short-label=examples::EBT::S32M276::Ae_Handler_Faults_Example_EB_001_S32M276::TresosProject::Ae_Handler_Faults_Example_EB_001_S32M276::config::EcuC.xdm, category=SWCFG
          short-label=examples::EBT::S32M276::Ae_Handler_Faults_Example_EB_001_S32M276::TresosProject::Ae_Handler_Faults_Example_EB_001_S32M276::config::Icu.xdm, category=SWCFG
          short-label=examples::EBT::S32M276::Ae_Handler_Faults_Example_EB_001_S32M276::TresosProject::Ae_Handler_Faults_Example_EB_001_S32M276::config::Mcu.xdm, category=SWCFG
          short-label=examples::EBT::S32M276::Ae_Handler_Faults_Example_EB_001_S32M276::TresosProject::Ae_Handler_Faults_Example_EB_001_S32M276::config::Platform.xdm, category=SWCFG
          short-label=examples::EBT::S32M276::Ae_Handler_Faults_Example_EB_001_S32M276::TresosProject::Ae_Handler_Faults_Example_EB_001_S32M276::config::Port.xdm, category=SWCFG
          short-label=examples::EBT::S32M276::Ae_Handler_Faults_Example_EB_001_S32M276::TresosProject::Ae_Handler_Faults_Example_EB_001_S32M276::config::Resource.xdm, category=SWCFG
          short-label=examples::EBT::S32M276::Ae_Handler_Faults_Example_EB_001_S32M276::TresosProject::Ae_Handler_Faults_Example_EB_001_S32M276::config::Spi.xdm, category=SWCFG
          short-label=examples::EBT::S32M276::Ae_Spi_Example_EB_001_S32M276::generate::epc::Ae.xdm, category=SWCFG
          short-label=examples::EBT::S32M276::Ae_Spi_Example_EB_001_S32M276::generate::epc::BaseNXP.xdm, category=SWCFG
          short-label=examples::EBT::S32M276::Ae_Spi_Example_EB_001_S32M276::generate::epc::Mcu.xdm, category=SWCFG
          short-label=examples::EBT::S32M276::Ae_Spi_Example_EB_001_S32M276::generate::epc::Platform.xdm, category=SWCFG
          short-label=examples::EBT::S32M276::Ae_Spi_Example_EB_001_S32M276::generate::epc::Port.xdm, category=SWCFG
          short-label=examples::EBT::S32M276::Ae_Spi_Example_EB_001_S32M276::generate::epc::Resource.xdm, category=SWCFG
          short-label=examples::EBT::S32M276::Ae_Spi_Example_EB_001_S32M276::generate::epc::Spi.xdm, category=SWCFG
          short-label=examples::EBT::S32M276::Ae_Spi_Example_EB_001_S32M276::include::check_example.h, category=SWHDR
          short-label=examples::EBT::S32M276::Ae_Spi_Example_EB_001_S32M276::src::main.c, category=SWSRC
          short-label=examples::EBT::S32M276::Ae_Spi_Example_EB_001_S32M276::TresosProject::Ae_Spi_Example_EB_001_S32M276::.prefs::preferences.xdm, category=SWCFG
          short-label=examples::EBT::S32M276::Ae_Spi_Example_EB_001_S32M276::TresosProject::Ae_Spi_Example_EB_001_S32M276::config::Ae.xdm, category=SWCFG
          short-label=examples::EBT::S32M276::Ae_Spi_Example_EB_001_S32M276::TresosProject::Ae_Spi_Example_EB_001_S32M276::config::BaseNXP.xdm, category=SWCFG
          short-label=examples::EBT::S32M276::Ae_Spi_Example_EB_001_S32M276::TresosProject::Ae_Spi_Example_EB_001_S32M276::config::EcuC.xdm, category=SWCFG
          short-label=examples::EBT::S32M276::Ae_Spi_Example_EB_001_S32M276::TresosProject::Ae_Spi_Example_EB_001_S32M276::config::Mcu.xdm, category=SWCFG
          short-label=examples::EBT::S32M276::Ae_Spi_Example_EB_001_S32M276::TresosProject::Ae_Spi_Example_EB_001_S32M276::config::Platform.xdm, category=SWCFG
          short-label=examples::EBT::S32M276::Ae_Spi_Example_EB_001_S32M276::TresosProject::Ae_Spi_Example_EB_001_S32M276::config::Port.xdm, category=SWCFG
          short-label=examples::EBT::S32M276::Ae_Spi_Example_EB_001_S32M276::TresosProject::Ae_Spi_Example_EB_001_S32M276::config::Resource.xdm, category=SWCFG
          short-label=examples::EBT::S32M276::Ae_Spi_Example_EB_001_S32M276::TresosProject::Ae_Spi_Example_EB_001_S32M276::config::Spi.xdm, category=SWCFG
          short-label=examples::S32DS::S32M276::Aec_Ip_Spi_Example_DS_001_S32M276::include::check_example.h, category=SWHDR
          short-label=examples::S32DS::S32M276::Aec_Ip_Spi_Example_DS_001_S32M276::Project_Settings::Startup_Code::exceptions.c, category=SWSRC
          short-label=examples::S32DS::S32M276::Aec_Ip_Spi_Example_DS_001_S32M276::Project_Settings::Startup_Code::nvic.c, category=SWSRC
          short-label=examples::S32DS::S32M276::Aec_Ip_Spi_Example_DS_001_S32M276::Project_Settings::Startup_Code::startup.c, category=SWSRC
          short-label=examples::S32DS::S32M276::Aec_Ip_Spi_Example_DS_001_S32M276::Project_Settings::Startup_Code::system.c, category=SWSRC
          short-label=examples::S32DS::S32M276::Aec_Ip_Spi_Example_DS_001_S32M276::src::main.c, category=SWSRC
          short-label=examples::S32DS::S32M276::Ae_Handler_Faults_Example_DS_001_S32M276::include::check_example.h, category=SWHDR
          short-label=examples::S32DS::S32M276::Ae_Handler_Faults_Example_DS_001_S32M276::Project_Settings::Startup_Code::exceptions.c, category=SWSRC
          short-label=examples::S32DS::S32M276::Ae_Handler_Faults_Example_DS_001_S32M276::Project_Settings::Startup_Code::nvic.c, category=SWSRC
          short-label=examples::S32DS::S32M276::Ae_Handler_Faults_Example_DS_001_S32M276::Project_Settings::Startup_Code::startup.c, category=SWSRC
          short-label=examples::S32DS::S32M276::Ae_Handler_Faults_Example_DS_001_S32M276::Project_Settings::Startup_Code::system.c, category=SWSRC
          short-label=examples::S32DS::S32M276::Ae_Handler_Faults_Example_DS_001_S32M276::src::main.c, category=SWSRC
          short-label=examples::S32DS::S32M276::Ae_Spi_Example_DS_001_S32M276::include::check_example.h, category=SWHDR
          short-label=examples::S32DS::S32M276::Ae_Spi_Example_DS_001_S32M276::Project_Settings::Startup_Code::exceptions.c, category=SWSRC
          short-label=examples::S32DS::S32M276::Ae_Spi_Example_DS_001_S32M276::Project_Settings::Startup_Code::nvic.c, category=SWSRC
          short-label=examples::S32DS::S32M276::Ae_Spi_Example_DS_001_S32M276::Project_Settings::Startup_Code::startup.c, category=SWSRC
          short-label=examples::S32DS::S32M276::Ae_Spi_Example_DS_001_S32M276::Project_Settings::Startup_Code::system.c, category=SWSRC
          short-label=examples::S32DS::S32M276::Ae_Spi_Example_DS_001_S32M276::src::main.c, category=SWSRC
          short-label=include::Ae.h, category=SWHDR
          short-label=include::Aec_Ip.h, category=SWHDR
          short-label=include::Aec_Ip_Hw_Access.h, category=SWHDR
          short-label=include::Aec_Ip_Irq.h, category=SWHDR
          short-label=include::Aec_Ip_Types.h, category=SWHDR
          short-label=include::Ae_Ipw.h, category=SWHDR
          short-label=include::Hvm_Ip.h, category=SWHDR
          short-label=include::Hvm_Ip_Hw_Access.h, category=SWHDR
          short-label=include::Hvm_Ip_Types.h, category=SWHDR
          short-label=src::Ae.c, category=SWSRC
          short-label=src::Aec_Ip.c, category=SWSRC
          short-label=src::Aec_Ip_Hw_Access.c, category=SWSRC
          short-label=src::Aec_Ip_Irq.c, category=SWSRC
          short-label=src::Ae_Ipw.c, category=SWSRC
          short-label=src::Hvm_Ip.c, category=SWSRC
          short-label=src::Hvm_Ip_Hw_Access.c, category=SWSRC
    4 x compiler:
      DIAB_Compiler:
        name=Windriver Diab
        options=-tARMCORTEXM7MG:simple -mthumb -std=c99 -Oz -g -fstandalone-debug -Wstrict-prototypes -Wsign-compare -Wdouble-promotion -Wunknown-pragmas -Wundef -Wextra -Wall -pedantic -Werror=implicit-function-declaration -fno-common -fno-signed-char -fno-trigraphs -V -c -DS32K3XX -D $ (DERIVATIVE) -DDIAB -DUSE_SW_VECTOR_MODE -DD_CACHE_ENABLE -DI_CACHE_ENABLE -DENABLE_FPU -DMCAL_ENABLE_USER_MODE_SUPPORT
        vendor=Windriver
        version=Wind River Diab Compiler v7.0.4
      GCC_Compiler:
        name=GCC Compiler
        options=-mcpu=cortex-m7 -mthumb -mlittle-endian -mfpu=fpv5-sp-d16 -mfloat-abi=hard -std=c99 -Os -ggdb3 -Wall -Wextra -pedantic -Wstrict-prototypes -Wundef -Wunused -Werror=implicit-function-declaration -Wsign-compare -Wdouble-promotion -fno-short-enums -funsigned-char -funsigned-bitfields -fno-common -fstack-usage -fdump-ipa-all -c -DS32K3XX -D $ (DERIVATIVE) -DGCC -DUSE_SW_VECTOR_MODE -DD_CACHE_ENABLE -DI_CACHE_ENABLE -DENABLE_FPU -DMCAL_ENABLE_USER_MODE_SUPPORT --sysroot=$(NEWLIB_DIR) -specs=nano.specs -specs=nosys.specs
        vendor=GCC Systems
        version=NXP GCC 10.2.0 20200723
      GHS_Compiler:
        name=Green Hills
        options=-cpu=cortexm7 -thumb -fpu=vfpv5_d16 -fsingle -C99 --ghstd=last -Osize --gnu_asm -dual_debug -G -keeptempfiles -Wimplicit-int -Wshadow -Wtrigraphs -Wundef --unsigned_chars --unsigned_fields --no_commons --no_exceptions --no_slash_comment --prototype_errors --incorrect_pragma_warnings -c -DS32K3XX -D $ (DERIVATIVE) -DGHS -DUSE_SW_VECTOR_MODE -DD_CACHE_ENABLE -DI_CACHE_ENABLE -DENABLE_FPU -DMCAL_ENABLE_USER_MODE_SUPPORT
        vendor=Green Hills
        version=Green Hills Multi 7.1.6d / Compiler 2021.1.4
      IAR_Compiler:
        name=IAR Compiler
        options=--cpu Cortex-M7 --cpu_mode thumb --endian little --fpu VFPv5-SP -e -Ohz --debug --no_clustering --no_mem_idioms --do_explicit_zero_opt_in_named_sections --require_prototypes --no_wrap_diagnostics --diag_suppress Pa050 -DS32K3XX -D $ (DERIVATIVE) -DIAR -DUSE_SW_VECTOR_MODE -DD_CACHE_ENABLE -DI_CACHE_ENABLE -DENABLE_FPU -DMCAL_ENABLE_USER_MODE_SUPPORT
        vendor=IAR Systems
        version=IAR ANSI C/C++ Compiler v.8.50.10 (safety version)
    generated-artifacts:
      15 x dependency on artifact:
        Aec_Ip_PBcfg_h: artifact-descriptor={short-label=generate_PB::include::Aec_Ip_PBcfg.h, category=SWHDR}, usages=EXECUTE
        Ae_Ipw_PBcfg_h: artifact-descriptor={short-label=generate_PB::include::Ae_Ipw_PBcfg.h, category=SWHDR}, usages=EXECUTE
        Ae_PBcfg_h: artifact-descriptor={short-label=generate_PB::include::Ae_PBcfg.h, category=SWHDR}, usages=EXECUTE
        Hvm_Ip_PBcfg_h: artifact-descriptor={short-label=generate_PB::include::Hvm_Ip_PBcfg.h, category=SWHDR}, usages=EXECUTE
        Aec_Ip_PBcfg_c: artifact-descriptor={short-label=generate_PB::src::Aec_Ip_PBcfg.c, category=SWSRC}, usages=EXECUTE
        Ae_Ipw_PBcfg_c: artifact-descriptor={short-label=generate_PB::src::Ae_Ipw_PBcfg.c, category=SWSRC}, usages=EXECUTE
        Ae_PBcfg_c: artifact-descriptor={short-label=generate_PB::src::Ae_PBcfg.c, category=SWSRC}, usages=EXECUTE
        Hvm_Ip_PBcfg_c: artifact-descriptor={short-label=generate_PB::src::Hvm_Ip_PBcfg.c, category=SWSRC}, usages=EXECUTE
        Aec_Ip_Cfg_h: artifact-descriptor={short-label=generate_PC::include::Aec_Ip_Cfg.h, category=SWHDR}, usages=COMPILE
        Aec_Ip_Cfg_Defines_h: artifact-descriptor={short-label=generate_PC::include::Aec_Ip_Cfg_Defines.h, category=SWHDR}, usages=COMPILE
        Ae_Cfg_h: artifact-descriptor={short-label=generate_PC::include::Ae_Cfg.h, category=SWHDR}, usages=COMPILE
        Ae_Ipw_Cfg_h: artifact-descriptor={short-label=generate_PC::include::Ae_Ipw_Cfg.h, category=SWHDR}, usages=COMPILE
        Hvm_Ip_Cfg_h: artifact-descriptor={short-label=generate_PC::include::Hvm_Ip_Cfg.h, category=SWHDR}, usages=COMPILE
        Hvm_Ip_Cfg_Defines_h: artifact-descriptor={short-label=generate_PC::include::Hvm_Ip_Cfg_Defines.h, category=SWHDR}, usages=COMPILE
        Aec_Ip_Cfg_c: artifact-descriptor={short-label=generate_PC::src::Aec_Ip_Cfg.c, category=SWSRC}, usages=COMPILE
    4 x linker:
      DIAB_Linker: name=Windriver Diab, options=-e Reset_Handler linker_script_file.dld -m30 -Xstack-usage -Xpreprocess-lecl -Llibrary_path -lc -lm -tARMCORTEXM7MG:simple, vendor=Windriver, version=Wind River Diab Compiler v7.0.4
      GCC_Linker: name=GCC Compiler, options=-Wl,-Map,filename -T linkerfile --entry=Reset_Handler -nostartfiles -mcpu=cortexm7 -mthumb -mfpu=fpv5-sp-d16 -mfloat-abi=hard -mlittle-endian -ggdb3 -lc -lm -lgcc -specs=nano.specs -specs=nosys.specs, vendor=GCC Systems, version=NXP GCC 10.2.0 20200723
      GHS_Linker: name=Green Hills, options=-e Reset_Handler -T linker_script_file.ld -map -keepmap -Mn -delete -ignore_debug_references -Llibrary_path -larch -lstartup -lind_sd -v -keep=C40_Ip_AccessCode -nostartfiles, vendor=Green Hills, version=Green Hills Multi 7.1.6d / Compiler 2021.1.4
      IAR_Linker: name=IAR Compiler, options=--map filename --config linkerfile --cpu=Cortex-M7 --fpu VFPv5-SP --entry _start --enable_stack_usage --skip_dynamic_initialization --no_wrap_diagnostics, vendor=IAR Systems, version=IAR ANSI C/C++ Compiler v.8.50.10 (safety version)
    resource consumption ResourceConsumption
      6 x memory section:
        AE_CODE: alignment=UNSPECIFIED, sw-addrmethod=CODE, symbol=CODE
        AE_CONFIG_DATA_UNSPECIFIED: alignment=UNSPECIFIED, sw-addrmethod=CONFIG_DATA, symbol=CONFIG_DATA_UNSPECIFIED
        AE_CONST_UNSPECIFIED: alignment=UNSPECIFIED, sw-addrmethod=CONST, symbol=CONST_UNSPECIFIED
        AE_VAR_CLEARED_32: alignment=32, sw-addrmethod=VAR_CLEARED, symbol=VAR_CLEARED_32
        AE_VAR_CLEARED_UNSPECIFIED: alignment=UNSPECIFIED, sw-addrmethod=VAR_CLEARED, symbol=VAR_CLEARED_UNSPECIFIED
        AE_VAR_INIT_UNSPECIFIED: alignment=UNSPECIFIED, sw-addrmethod=VAR_INIT, symbol=VAR_INIT_UNSPECIFIED
